//+++++++++++++++++++++++++++++++++++++++++++++++++++++++++++++++++++++++++++++++++++++++++++++++++
//     			 					74HC165
//+++++++++++++++++++++++++++++++++++++++++++++++++++++++++++++++++++++++++++++++++++++++++++++++++
//  ecoins (ecoins@mail.ru) 
//  2022-22-18: Begin version
//+++++++++++++++++++++++++++++++++++++++++++++++++++++++++++++++++++++++++++++++++++++++++++++++++
#ifndef RT_HW_74HC165_h
#define RT_HW_74HC165_h
#define RT_HW_74HC165_VER 	10	//--Library version number;
#include "RT_HW_BASE.h"				//--Connecting the base library;
//+++++++++++++++++++++++++++++++++++++++++++++++++++++++++++++++++++++++++++++++++++++++++++++++++
//									DATA STRUCTURE 74HC595
//+++++++++++++++++++++++++++++++++++++++++++++++++++++++++++++++++++++++++++++++++++++++++++++++++
struct RT_HW_74HC165_DEV{
RT_HW_STRUCT_SPI_DEV dvS;
RT_HW_STRUCT_SPN_DEV dvN;
//-------------------------------------------------------------------------------------------------
char     mi='S';				//--0.Mode interface;
uint8_t  custom=0;				//--1.Setting option;
uint8_t  status=0;				//--2.Status device: =0 no init; =1 Master.MCU->Slave.device; =2 Slave;
uint8_t  link=0;				//--3.Completed transaction flag;
uint8_t  codeErr=0;				//--4.Code error;
//-------------------------------------------------------------------------------------------------	
uint8_t  run;					//--5.Command run; 
uint8_t  dir=0;					//--6.Working  dir for direct();
//-------------------------------------------------------------------------------------------------
uint8_t  fresh=1;				//--6.Updating measured data;
//-------------------------------------------------------------------------------------------------
uint8_t  bitOrder=1;					//--0/1
uint8_t  qnt=1;							//--1,2,3,4;;
uint32_t var;
};
//+++++++++++++++++++++++++++++++++++++++++++++++++++++++++++++++++++++++++++++++++++++++++++++++++
//									CONTROL CLASS 74HC165
//+++++++++++++++++++++++++++++++++++++++++++++++++++++++++++++++++++++++++++++++++++++++++++++++++
class RT_HW_74HC165{
public:
//=================================================================================================
//									1.1.Setting parameters for SPI.
//=================================================================================================
//void setParamS(RT_HW_74HC165_DEV &id, uint8_t cs,  uint8_t bus, uint32_t speed=0){ 	
//if(id.custom){return;}       
//id.mi='S';
//id.dvS.cs=cs;   id.dvS.bus=bus; id.dvS.t2=5;
//if(speed<1000) {id.dvS.speed=RT_HW_Base.spiGetSpeed(bus);} else {id.dvS.speed=speed;}
//id.custom=1;};
//=================================================================================================
//									1.2.Setting parameters for SPN.
//=================================================================================================
//void setParamN(RT_HW_74HC165_DEV &id,uint8_t sck, uint8_t miso, uint8_t cs, uint8_t speed=0){
//if(id.custom){return;}
//id.mi='N';
//id.dvN.userRX=1; 
//id.dvN.userTX=0;
//id.dvN.sck=sck; id.dvN.miso=miso; id.dvN.mosi=255; id.dvN.cs=cs; id.dvN.speed=speed; 
//id.custom=1;};
//=================================================================================================
//									1.Direct device
//=================================================================================================
void direct(RT_HW_74HC165_DEV &id, uint8_t &run){
//-------------------------------------------------------------------------------------------------
if(run>0){id.run=1; run=5;}
//-------------------------------------------------------------------------------------------------
//									1.0.Initting parameters
//-------------------------------------------------------------------------------------------------
if(id.dir==0) {						
if(id.custom!=1) {return;}				//--Exit due to device setup error;
id.dir=10;} 							//--Goto initDevice();
//-------------------------------------------------------------------------------------------------
//									1.10.Initting device
//-------------------------------------------------------------------------------------------------
if(id.dir==10){
if(!id.run)      				 {return;} 
xxxInitDevice(id);	if(!id.link) {return;}				//--Get custom device(SPI or SPN);
if(id.status!=1){id.dir=10;       return;}
id.dir=20;}
//-------------------------------------------------------------------------------------------------
//									1.20.Waitting run 
//-------------------------------------------------------------------------------------------------
if(id.dir==20){
if(!id.run)      				 {return;} id.run=0;
id.dir=30;}
//-------------------------------------------------------------------------------------------------
//									1.30.Process device.
//-------------------------------------------------------------------------------------------------
if(id.dir==30){
xxxRead(id);		if(!id.link) {return;} 
id.var^=0xFFFFFFFF;
if(id.qnt==1){id.var&=0xFF;     if(!id.bitOrder){id.var=RT_HW_Base.reverseV8 (uint8_t(id.var)); }}
if(id.qnt==2){id.var&=0xFFFF;   if(!id.bitOrder){id.var=RT_HW_Base.reverseV16(uint16_t(id.var));}}
if(id.qnt==3){id.var&=0xFFFFFF; if(!id.bitOrder){id.var=RT_HW_Base.reverseV24(uint32_t(id.var));}}
if(id.qnt==4){                  if(!id.bitOrder){id.var=RT_HW_Base.reverseV32(         id.var); }}
//-------------------------------------------------------------------------------------------------
id.fresh=1; id.dir=20; return;
};
//-------------------------------------------------------------------------------------------------
};
//+++++++++++++++++++++++++++++++++++++++++++++++++++++++++++++++++++++++++++++++++++++++++++++++++
//
//									7.Device Link Functions.
//
//+++++++++++++++++++++++++++++++++++++++++++++++++++++++++++++++++++++++++++++++++++++++++++++++++
//=================================================================================================
//									7.1.Getting Interface Device Parameters
//=================================================================================================
void getParamDevice(RT_HW_74HC165_DEV &id){
if(id.mi=='S'){id.codeErr=id.dvS.codeErr; id.status=id.dvS.status; id.link=id.dvS.link; id.var=id.dvS.bf32; return;}
if(id.mi=='N'){id.codeErr=id.dvN.codeErr; id.status=id.dvN.status; id.link=id.dvN.link; id.var=id.dvN.bf32; return;}
			   id.codeErr=0;              id.status=0;             id.link=1;           id.var=0;           return;};
//=================================================================================================
//									7.4.Init Device.
//=================================================================================================
void xxxInitDevice(RT_HW_74HC165_DEV &id){
if(id.mi=='S'){RT_HW_Base.spiInitDevice(id.dvS); 			getParamDevice(id);	return;}
if(id.mi=='N'){RT_HW_Base.spnInitDevice(id.dvN); 			getParamDevice(id);	return;}
getParamDevice(id);};
//=================================================================================================
//									7.5.Read device.
//=================================================================================================
void xxxRead(RT_HW_74HC165_DEV &id){	
if(id.mi=='S'){RT_HW_Base.spiRead74HC165(id.dvS,id.qnt); 	getParamDevice(id);	return;}
if(id.mi=='N'){RT_HW_Base.spnRead74HC165(id.dvN,id.qnt); 	getParamDevice(id);	return;}
getParamDevice(id);};
//=================================================================================================
};	//++++END class RT_HW_74HC165==================================================================
extern RT_HW_74HC165 	RT_HW_74hc165; 						//--Create an object RT_HW_74HC165;
//=================================================================================================
#endif
//=================================================================================================
