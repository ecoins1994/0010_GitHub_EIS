//#################################################################################################
//     						LIBRARY RT_HW_74HC595
//=================================================================================================
//struct RT_HW_STRUCT_SPI_DEV{
//	uint8_t  custom=0;
//  uint8_t  dir;
//	uint8_t  cs=255; 	//--номер пина CS;
//	uint8_t  bus=0; 	//--номер пина MOSI;
//	uint8_t  order=1;
//	uint8_t  mode=0;
//	uint8_t  codeErr=0;
//	uint32_t speed=4000000UL;	//--Скорость шины;	
//};
//-------------------------------------------------------------------------------------------------
//  ecoins (ecoins@mail.ru) 
//  2022-22-18: Begin version
//#################################################################################################
//-------------------------------------------------------------------------------------------------
#ifndef RT_HW_SPI_74HC595_h
#define RT_HW_SPI_74HC595_h
#define RT_HW_SPI_74HC595_VER 10		//--Library version number;
#include "RT_HW_BASE.h"					//--Connecting the base library;
//+++++++++++++++++++++++++++++++++++++++++++++++++++++++++++++++++++++++++++++++++++++++++++++++++
//									DATA STRUCTURE 74HC595
//+++++++++++++++++++++++++++++++++++++++++++++++++++++++++++++++++++++++++++++++++++++++++++++++++
struct RT_HW_74HC595_DEV{
RT_HW_STRUCT_SPI_DEV dvS;
RT_HW_STRUCT_SPN_DEV dvN;
//-------------------------------------------------------------------------------------------------
char     mi='S';				//--0.Mode interface;
uint8_t  custom=0;				//--1.Setting option;
uint8_t  status=0;				//--2.Status device: =0 no init; =1 Master.MCU->Slave.device; =2 Slave;
uint8_t  link=0;				//--3.Completed transaction flag;
uint8_t  codeErr=0;				//--4.Code error;
//-------------------------------------------------------------------------------------------------	
uint8_t  run;					//--5.Command run; 
uint8_t  dir=0;					//--6.Working  dir for direct();
//-------------------------------------------------------------------------------------------------
uint8_t  bitOrder=1;			//--7.Order bit: 0/1;
uint8_t  qnt=1;					//--8.Number of bytes;
uint32_t bf32,var;
};
//+++++++++++++++++++++++++++++++++++++++++++++++++++++++++++++++++++++++++++++++++++++++++++++++++
//									CONTROL CLASS 74HC595
//+++++++++++++++++++++++++++++++++++++++++++++++++++++++++++++++++++++++++++++++++++++++++++++++++
class RT_HW_74HC595{	
public:
//=================================================================================================
//									1.Direct device
//=================================================================================================
void direct(RT_HW_74HC595_DEV &id, uint32_t var, uint8_t &run){
//-------------------------------------------------------------------------------------------------
if(run==2){if(id.bf32!=var){run=1;} else {run=0;}}; 
if(run==1){   id.bf32=var;  run=5;     id.run=1;}; 
//-------------------------------------------------------------------------------------------------
//									1.0.Initting parameters.
//-------------------------------------------------------------------------------------------------
if(id.dir==0) {						
if(id.custom!=1) {return;}				//--Exit due to device setup error;
id.dir=10;} 							//--Goto initDevice();
//-------------------------------------------------------------------------------------------------
//									1.10.Initting device; 
//-------------------------------------------------------------------------------------------------
if(id.dir==10){
if(!id.run)      				 {return;} 
xxxInitDevice(id);	if(!id.link) {return;}				//--Get custom device(SPI or SPN);
if(id.status!=1){id.dir=10;       return;}id.dir=20;}
//-------------------------------------------------------------------------------------------------
//									1.20.Waitting run && Prepare data; 
//-------------------------------------------------------------------------------------------------
if(id.dir==20){
if(!id.run)      				 {return;} id.run=0;
//-------------------------------------------------------------------------------------------------
if((id.qnt==0)||(id.qnt>4)) {id.qnt=1;} 
id.var=id.bf32;
if(id.qnt==1){if(!id.bitOrder){id.var=RT_HW_Base.reverseV8 (uint8_t (id.var&0xFF));    }}
if(id.qnt==2){if(!id.bitOrder){id.var=RT_HW_Base.reverseV16(uint16_t(id.var&0xFFFF));  }}
if(id.qnt==3){if(!id.bitOrder){id.var=RT_HW_Base.reverseV24(uint32_t(id.var&0xFFFFFF));}}
if(id.qnt==4){if(!id.bitOrder){id.var=RT_HW_Base.reverseV32(         id.var);          }}
id.dir=30;} 
//-------------------------------------------------------------------------------------------------
//									1.30.Process device.
//-------------------------------------------------------------------------------------------------
if(id.dir==30){
xxxWrite(id);		if(!id.link) {return;} 
id.dir=20;                        return;}	
//-------------------------------------------------------------------------------------------------
};	//====END direct()=============================================================================

//+++++++++++++++++++++++++++++++++++++++++++++++++++++++++++++++++++++++++++++++++++++++++++++++++
//
//									7.Device Link Functions.
//
//+++++++++++++++++++++++++++++++++++++++++++++++++++++++++++++++++++++++++++++++++++++++++++++++++
//=================================================================================================
//									7.1.Getting Interface Device Parameters
//=================================================================================================
void getParamDevice(RT_HW_74HC595_DEV &id){
if(id.mi=='S'){id.custom=id.dvS.custom; id.codeErr=id.dvS.codeErr; id.status=id.dvS.status; id.link=id.dvS.link; return;}
if(id.mi=='N'){id.custom=id.dvN.custom; id.codeErr=id.dvN.codeErr; id.status=id.dvN.status; id.link=id.dvN.link; return;}
               id.custom=0;             id.codeErr=0;              id.status=0;             id.link=1;           return;};
//=================================================================================================
//									7.2.Init Device.
//=================================================================================================
void xxxInitDevice(RT_HW_74HC595_DEV &id){
if(id.mi=='S'){RT_HW_Base.spiInitDevice(id.dvS); 					getParamDevice(id);	return;}
if(id.mi=='N'){RT_HW_Base.spnInitDevice(id.dvN); 					getParamDevice(id);	return;}
getParamDevice(id);}
//=================================================================================================
//									7.3.Wtite Device.
//=================================================================================================
void xxxWrite(RT_HW_74HC595_DEV &id){	
if(id.mi=='S'){RT_HW_Base.spiWrite(id.dvS,id.var,id.qnt); 			getParamDevice(id);	return;}
if(id.mi=='N'){RT_HW_Base.spnWrite(id.dvN,id.var,id.qnt); 			getParamDevice(id);	return;}
getParamDevice(id);}
//=================================================================================================
};	//++++END class RT_HW_74HC595==================================================================
extern RT_HW_74HC595 	RT_HW_74hc595; 						//--Create an object RT_HW_74HC595;
#endif
//=================================================================================================
