//+++++++++++++++++++++++++++++++++++++++++++++++++++++++++++++++++++++++++++++++++++++++++++++++++
//
//            						PCF8575
//
//+++++++++++++++++++++++++++++++++++++++++++++++++++++++++++++++++++++++++++++++++++++++++++++++++
//  ecoins (ecoins@mail.ru) 
//  21.05.2023: Begin version
//+++++++++++++++++++++++++++++++++++++++++++++++++++++++++++++++++++++++++++++++++++++++++++++++++
//-------------------------------------------------------------------------------------------------
#ifndef RT_HW_PCF8575_h
#define RT_HW_PCF8575_h
#define RT_HW_PCF8575_VER 		 10		//--Library version number;
#include "RT_HW_BASE.h"					//--Connecting the base library;
//-------------------------------------------------------------------------------------------------
//+++++++++++++++++++++++++++++++++++++++++++++++++++++++++++++++++++++++++++++++++++++++++++++++++
struct RT_HW_PCF8575_DEV{
RT_HW_STRUCT_I2C_DEV dvI;
//-------------------------------------------------------------------------------------------------
char     mi='I';				//--0.Mode interface;
uint8_t  custom=0;				//--1.Setting option;	
uint8_t  status=0;				//--2.Status device: =0 no init; =1 Master.MCU->Slave.device; =2 Slave;
uint8_t  link=0;				//--3.Completed transaction flag;
uint8_t  codeErr=0;				//--4.Code error;	
//--------------------------------------------------------------------------------------------------
uint8_t  dir=0;					//--5.Working  dir for direct();
uint8_t  step;					//--6.Working step for add function;
uint8_t  runOut=1,runIn=1;    	//--7.1.Flags to start reading;
uint8_t  invOutA=0xFF, invInA=0xFF;//--7.2.Flags I/O inversion;
uint8_t  invOutB=0xFF, invInB=0xFF;//--7.2.Flags I/O inversion;
uint8_t  ok;					//--7.3.Device ok;
uint8_t  fresh;					//--7.4.Fresh data;
//-------------------------------------------------------------------------------------------------
uint8_t  cnt,cntErr;			//--8.Counters;
uint8_t  err:1,action:1;		//--9.Working flags;
//-------------------------------------------------------------------------------------------------
uint8_t  workDelay=0;			//--10.Working register; 
uint8_t  pointDelay;			//--11.Return point from a function;
uint16_t sizeDelay;				//--12.Size delay;	
uint32_t startDelay;		   	//--13.Working register;
//-------------------------------------------------------------------------------------------------
uint8_t  permitOut=0; 			//--Output permission for registers A,B;
uint8_t  permitIn=0;			//--Input  permission for registers A,B;
uint8_t  cnfgA=0xFF, cnfgB=0xFF;//--Depth bit configuration of registers A,B (0-output, 1-input);
//-------------------------------------------------------------------------------------------------
uint8_t  inA=0,   inB=0; 		//--Registers for reading from registers A,B;
uint8_t  outA,outB; 			//--Registers for writing to   registers A,B;
uint8_t  extA,extB; 			//--Registers of external values for writing to registers A,B;
uint8_t  inAgoA=255,inAgoB=255; //--Registers of storage of the previous values of output registers A,B;
//-------------------------------------------------------------------------------------------------
uint8_t  bf8;					//--Buffer for reading byte;
uint8_t  arr[2];              	//--Buffer for temporary data storage
//-------------------------------------------------------------------------------------------------
};
//+++++++++++++++++++++++++++++++++++++++++++++++++++++++++++++++++++++++++++++++++++++++++++++++++
//=================================================================================================
//                            		CLASS MCP23x17
//=================================================================================================
class RT_HW_PCF8575{
public:
//=================================================================================================
//									2. Direct device.
//=================================================================================================
void direct(RT_HW_PCF8575_DEV &id, uint8_t runIn, uint8_t &runOut){
//-------------------------------------------------------------------------------------------------
if(runOut==2){if((id.outA!=id.extA) || (id.outB!=id.extB)) {id.outA=id.extA; id.outB=id.extB; runOut=5; id.runOut=1;}}; 
//if(runOut==1){                                              id.outA=id.extA; id.outB=id.extB; runOut=5; id.runOut=1;}  
//-------------------------------------------------------------------------------------------------
if(runIn>0)  {                                       runIn=0;  id.runIn=1;}
//-------------------------------------------------------------------------------------------------
//									2.0. Initting parameters. Continue after 50 ms.
//--Register bit direction: =1-input, =0-output;
//--Input modes:=0 invert & pull up to Vcc; =1 invert; =2 - pull-up to Vcc; =3-as is;
//-------------------------------------------------------------------------------------------------
if(id.dir==0) {	
getParamDevice(id);
id.step=id.workDelay=0; id.ok=0;  
//-------------------------------------------------------------------------------------------------
id.permitIn=id.permitOut=0;
if((id.cnfgA!=0)    || (id.cnfgB!=0))    {id.permitIn=1;}   //--Depth bit configuration of register (0-output, 1-input);
if((id.cnfgA!=0xFF) || (id.cnfgB!=0xFF)) {id.permitOut=1;} 

//RT_HW_Base.consoleTest(String(F("PCF8575 permitIn")),id.permitIn,';');
//RT_HW_Base.consoleTest(String(F(" permitOut")),id.permitOut);
//-------------------------------------------------------------------------------------------------
if(id.custom==0){return;} 								id.dir=10;} 
//-------------------------------------------------------------------------------------------------
//									2.10.Waiting run before init()
//-------------------------------------------------------------------------------------------------
if(id.dir==10){
if(id.runOut || id.runIn){
	id.step=0; id.dir=20;} else {return;}} 
//-------------------------------------------------------------------------------------------------
//									2.20.Init device.
//-------------------------------------------------------------------------------------------------
if(id.dir==20){
init(id);  
if(id.err)    {id.dir=200; id.sizeDelay=1000; id.pointDelay=0; return;} 
if(!id.action){id.dir=30;  id.step=0;}}
//-------------------------------------------------------------------------------------------------
//									2.30.Waiting run after init()
//-------------------------------------------------------------------------------------------------
if(id.dir==30){
if(id.runOut || id.runIn){
	id.step=0; id.dir=40;} else {return;}} 
//-------------------------------------------------------------------------------------------------
//									2.40.Process Output.
//-------------------------------------------------------------------------------------------------
if(id.dir==40){
if(id.runOut)				{id.runOut=0; id.step=0; id.dir=41;} else {id.dir=50;}}
//-------------------------------------------------------------------------------------------------
if(id.dir==41){
output(id);
if(id.err)    {id.dir=200; id.sizeDelay=1000; id.pointDelay=0; return;} 
if(!id.action){id.dir=50;  id.step=0;}}
//-------------------------------------------------------------------------------------------------
//									2.40.Process Intput.
//-------------------------------------------------------------------------------------------------
if(id.dir==50){
if(id.runIn)					{id.runIn=0;  id.step=0; id.dir=51;} else {id.dir=90;}}
//-------------------------------------------------------------------------------------------------
if(id.dir==51){
input(id);
if(id.err)    {id.dir=200; id.sizeDelay=1000; id.pointDelay=0; return;} 
if(!id.action){id.dir=90;  id.step=0;}}
//-------------------------------------------------------------------------------------------------
//									2.90.Successful exit
//-------------------------------------------------------------------------------------------------
if(id.dir==90){
id.runOut=id.runIn=0;
id.ok=1;
id.dir=30; return;}
//-------------------------------------------------------------------------------------------------
//									2.200.Fixed Delay.
//-------------------------------------------------------------------------------------------------
if(id.dir==200){
if(!RT_HW_Base.timeDelay(id.startDelay,id.workDelay,id.sizeDelay)){return;} id.dir=id.pointDelay;}	
//-------------------------------------------------------------------------------------------------
};	
//=================================================================================================
//									3.Init device
//=================================================================================================
void init(RT_HW_PCF8575_DEV &id){
if(id.step==0) {	
id.cnt=id.cntErr=id.err=0; id.action=1; 
id.pointDelay=10; id.sizeDelay=50; id.step=200; return;}
//-------------------------------------------------------------------------------------------------
//									3.10. Initting device.	
//-------------------------------------------------------------------------------------------------
if(id.step==10) {	
xxxInitDevice(id);	if(!id.link)	{return;}
if(id.status!=1){id.err=1; id.step=0;return;} 
id.cnt=id.cntErr=0; 
id.step=30;}
//-------------------------------------------------------------------------------------------------
//									3.20. Finding address device		
//-------------------------------------------------------------------------------------------------
if(id.step==20){
xxxFindAdr(id);   	if(!id.link){return;}	
//-------------------------------------------------------------------------------------------------
if(id.codeErr){
id.cnt=0; id.cntErr++;
if(id.cntErr<=3){id.pointDelay=id.step; id.step=200; id.sizeDelay=100+(250*id.cntErr);	return;}	
if(id.cntErr==3){id.pointDelay=id.step; id.step=200; id.sizeDelay=2000; 				return;}
				 id.codeErr=id.step;    id.step=0; 	 id.err=1; 			  		  	  	return;}
//-------------------------------------------------------------------------------------------------
id.cnt++; id.cntErr=0;	
if(id.cnt<3){    id.pointDelay=id.step; id.step=200; id.sizeDelay=40; 					return;}
//-------------------------------------------------------------------------------------------------					
				 id.pointDelay=30;      id.step=200; id.sizeDelay=10;  					return;}
//-------------------------------------------------------------------------------------------------
//									3.30. Setting I/O;		
//-------------------------------------------------------------------------------------------------
if(id.step==30){id.step=31;
id.arr[0]=0xFF^id.invOutA; id.arr[1]=0xFF^id.invOutA;
id.arr[0]=id.cnfgA; id.arr[1]=id.cnfgB;
}
//-------------------------------------------------------------------------------------------------
if(id.step==31){
xxxWrireArr(id,2);		if(checkTransaction(id)){return;}  	//--Exit to continue or to End+err (step=200);
id.sizeDelay=10;        id.pointDelay=90;		 return;}
//-------------------------------------------------------------------------------------------------
//									3.90. Exit		
//-------------------------------------------------------------------------------------------------
if(id.step==90){
id.action=0; id.step=0; return;}
//-------------------------------------------------------------------------------------------------
//									3.200.Fixed Delay
//-------------------------------------------------------------------------------------------------
if(id.step==200){if(!RT_HW_Base.timeDelay(id.startDelay,id.workDelay,id.sizeDelay)){return;} id.step=id.pointDelay;}
//-------------------------------------------------------------------------------------------------
};
//=================================================================================================
//									4. Reading input A,B
//=================================================================================================
void input(RT_HW_PCF8575_DEV &id){
//-------------------------------------------------------------------------------------------------
//									4.0. Initting parameters.
//-------------------------------------------------------------------------------------------------
if(id.step==0) {	
id.cnt=id.cntErr=id.err=0; id.action=1;
if(!id.permitIn){id.action=0; return;}
id.step=20;}
//-------------------------------------------------------------------------------------------------
//									4.20.Read A,B
//-------------------------------------------------------------------------------------------------
if(id.step==20){
xxxReadArr(id, 2);	if(checkTransaction(id)){return;}							
id.inA=(id.arr[0] | (id.cnfgA^0xFF))^id.invInA;
id.inB=(id.arr[1] | (id.cnfgB^0xFF))^id.invInB;
//RT_HW_Base.consoleTest(String(F("PCF8575 input arr[0]")),id.arr[0],';','H');
//RT_HW_Base.consoleTest(String(F(" arr[1]")),id.arr[1],';','H');
//RT_HW_Base.consoleTest(String(F(" inA")),id.inA,';','H');
//RT_HW_Base.consoleTest(String(F(" inB")),id.inB,'E','H');
id.step=90;}
//-------------------------------------------------------------------------------------------------
//									4.90.Successful exit
//-------------------------------------------------------------------------------------------------
if(id.step==90){
id.fresh=1; id.err=id.action=0; id.step=0; return;}	
//-------------------------------------------------------------------------------------------------
//									4.200.Fixed Delay.
//-------------------------------------------------------------------------------------------------
if(id.step==200){
if(!RT_HW_Base.timeDelay(id.startDelay,id.workDelay,id.sizeDelay)){return;} id.step=id.pointDelay;}
};
//=================================================================================================
//									5. Output A,B
//=================================================================================================
void output(RT_HW_PCF8575_DEV &id){
//-------------------------------------------------------------------------------------------------
//									5.0. Initting parameters.
//-------------------------------------------------------------------------------------------------
if(id.step==0) {	
id.cnt=id.cntErr=id.err=0; id.action=1;
if(!id.permitOut){id.action=0; return;}
id.step=20;}
//-------------------------------------------------------------------------------------------------
//									5.20.Output A,B
//-------------------------------------------------------------------------------------------------
if(id.step==20){id.step=21;
id.arr[0]=(id.outA^id.invOutA) | id.cnfgA; 
id.arr[1]=(id.outB^id.invOutB) | id.cnfgB; 
}
//-------------------------------------------------------------------------------------------------
if(id.step==21){
xxxWrireArr(id,2);	if(checkTransaction(id)){return;}							
id.step=90;}
//-------------------------------------------------------------------------------------------------
//									5.90.Successful exit
//-------------------------------------------------------------------------------------------------
if(id.step==90){
id.err=id.action=0; id.step=0; return;}	
//-------------------------------------------------------------------------------------------------
//									5.200.Fixed Delay.
//-------------------------------------------------------------------------------------------------
if(id.step==200){
if(!RT_HW_Base.timeDelay(id.startDelay,id.workDelay,id.sizeDelay)){return;} id.step=id.pointDelay;}
};
//=================================================================================================
//+++++++++++++++++++++++++++++++++++++++++++++++++++++++++++++++++++++++++++++++++++++++++++++++++
//
//									7.Device Link Functions.
//
//+++++++++++++++++++++++++++++++++++++++++++++++++++++++++++++++++++++++++++++++++++++++++++++++++
//=================================================================================================
//									7.0.Function error check.
//=================================================================================================
uint8_t checkTransaction(RT_HW_PCF8575_DEV &id){
if(!id.link) {return 1;}
id.pointDelay=id.step; id.step=200;
if(id.codeErr!=0){id.sizeDelay=40+(10*id.cntErr); id.cntErr++; 
                  if(id.cntErr>3){id.codeErr=id.pointDelay; id.err=1; id.step=0;} 
				  return 1;}
id.cntErr=0; return 0;};
//=================================================================================================
//									7.1.Getting Interface Device Parameters
//=================================================================================================
void getParamDevice(RT_HW_PCF8575_DEV &id){
if(id.mi=='I'){id.custom=id.dvI.custom; id.codeErr=id.dvI.codeErr; id.status=id.dvI.status; id.link=id.dvI.link; id.bf8=id.dvI.bf8;          return;}
			   id.custom=0;             id.codeErr=0;              id.status=0;             id.link=1;           id.bf8=0;                   return;};
//=================================================================================================
//									7.3.Init Device.
//=================================================================================================
void xxxInitDevice(RT_HW_PCF8575_DEV &id){
if(id.mi=='I'){RT_HW_Base.i2cInitDevice(id.dvI); 			getParamDevice(id); return;}	
getParamDevice(id);};
//=================================================================================================
//									7.4.Find address Device.
//=================================================================================================
void xxxFindAdr(RT_HW_PCF8575_DEV &id){
if(id.mi=='I'){RT_HW_Base.i2cFindAdr(id.dvI); 				getParamDevice(id); return;}	
getParamDevice(id);};
//=================================================================================================
//									7.5.Wtite byte to register.
//=================================================================================================
void xxxWrireArr(RT_HW_PCF8575_DEV &id, uint8_t qnt){	
if(id.mi=='I'){RT_HW_Base.i2cWriteArr(id.dvI,id.arr,qnt); 	getParamDevice(id); return;}
getParamDevice(id);};
//=================================================================================================
//									7.6.Get bytes
//=================================================================================================
void xxxReadArr(RT_HW_PCF8575_DEV &id, uint8_t qnt){	
if(id.mi=='I'){RT_HW_Base.i2cReadArr(id.dvI,id.arr,qnt); 		getParamDevice(id); return;};
getParamDevice(id);};
//=================================================================================================
};		//++++END CLASS RT_HW_PCF8575()
//=================================================================================================
extern RT_HW_PCF8575 	RT_HW_pcf8575; 						//--Create an object RT_HW_pcf8575; 						
#endif
//=================================================================================================
