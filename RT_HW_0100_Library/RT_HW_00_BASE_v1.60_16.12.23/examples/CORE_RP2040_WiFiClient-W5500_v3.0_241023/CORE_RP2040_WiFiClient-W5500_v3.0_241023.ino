//+++++++++++++++++++++++++++++++++++++++++++++++++++++++++++++++++++++++++++++++++++++++++++++++++ 
//    Устанавливается TCP-соединение со службой «Цитата дня».
//    Отправляется сообщение «привет», а затем выводятся полученные данные.
//+++++++++++++++++++++++++++++++++++++++++++++++++++++++++++++++++++++++++++++++++++++++++++++++++ 
//=================================================================================================
//                    Подключение библиотек
//=================================================================================================
#include "RT_HW_BASE.h"               //--Базовая библиотека RT_HW_BASEh;
#include <W5500lwIP.h>              //--Вызов библиотеки;
//=================================================================================================
//  Определение целевой платформы
//=================================================================================================
#ifdef ARDUINO_ARCH_AVR
  #define TEST_BOARD "AVR"
  #define _csEth       10
  #define _pinLed      13   
  #define _pinControl 255 
#elif ARDUINO_ARCH_SAM
  #define TEST_BOARD "SAM"
  #define _csEth       10
  #define _pinLed      13    
  #define _pinControl 255 
#elif ARDUINO_ARCH_ESP8266
  #define TEST_BOARD "ESP8266"
  #define _csEth       10 
  #define _pinLed       2    
  #define _pinControl 255 
#elif ARDUINO_ARCH_ESP32
  #define TEST_BOARD "ESP32"
  #define _csEth       15  
  #define _pinLed       2 
  #define _pinControl 255     
#elif ARDUINO_ARCH_RP2040
  #define TEST_BOARD "RP2040"
  #define _csEth       21   
  #define _pinLed      25
  #define _pinControl  28  
#elif ARDUINO_ARCH_STM32
  #define TEST_BOARD "STM32"
  #define _csEth      PD5   //--PD5=10 
  #define _pinLed     PA1 
  #define _pinControl 255     
#else
  #define TEST_BOARD "ANON"
  #define _csEth       10  
  #define _pinLed      13 
  #define _piControl 255 
#endif
//-------------------------------------------------------------------------------------------------
//uint8_t vInit=0;   uint8_t vEthInit=0;                                                                               
//-------------------------------------------------------------------------------------------------
const char* host = "djxmmx.net";    //--Имя сервера;
const uint16_t port = 17;           //--Номер порта;
//-------------------------------------------------------------------------------------------------
uint32_t timeDelay, timeBlink=0;    //--Рабочие таймеры задержек и управления blink;
bool     blink=0, blinkControl=0;   //--Рабочий флаг для генератора меандра и контрольного сигнала;
uint8_t  consoleOk=0;               //--Флаг готовности консоли;
uint16_t cnt;                       //--Счетчик успешных транзакций;
//-------------------------------------------------------------------------------------------------
uint8_t pinControl=255,pinLed=255, csEth=255; //--Пины контрольный(для лог.анализатора), светодиода на плате, cs Ethernet;
//-------------------------------------------------------------------------------------------------
uint8_t  vInit=0;                   //--Флаг инициализации параметров;
uint8_t  first=0;                   //--Флаг выполненной первой транзакциии;
uint8_t  dir=0, agoDir=255;         //--Номер этапа алгоритма управления;
//-------------------------------------------------------------------------------------------------

//=================================================================================================
//                    Создание объекта
//=================================================================================================
  Wiznet5500lwIP eth(_csEth);
  WiFiClient     client;
//=================================================================================================
//                                    1.Секция SETUP()
//=================================================================================================
void setup() {}
//=================================================================================================
//                                    2.Секция LOOP()
//=================================================================================================
void loop() {
//-------------------------------------------------------------------------------------------------
//                                    2.1.Инициализация параметров. 
//                                        Здесь можно переустановить параметры.
//-------------------------------------------------------------------------------------------------
if(!vInit){vInit=1;
//--------------------
#ifdef _pinControl
pinControl=_pinControl;
#endif
//--------------------
#ifdef _pinLed
pinLed=_pinLed;
#endif
//--------------------
#ifdef _csEth
csEth=_csEth;
#endif
//--------------------
if(pinControl!=255){pinMode(pinControl,OUTPUT);}  //--Настройка пина Control на вывод;
if(pinLed!=255)    {pinMode(pinLed,    OUTPUT);}  //--Настройка пина Led     на вывод;
if(csEth!=255)     {pinMode(csEth,     OUTPUT);}  //--Настройка пина сsEth   на вывод;
//--------------------
#ifdef ARDUINO_ARCH_RP2040    //--Перенастройка пинов для RP2040;
  SPI.setSCK(18);
  SPI.setRX(16);
  SPI.setTX(19);
  SPI.setCS(21);
#endif
#ifdef ARDUINO_ARCH_STM32    //--Перенастройка пинов для STM32;
  SPI.setSCLK(PB13);   
  SPI.setMISO(PB14); 
  SPI.setMOSI(PB15);
  SPI.setSS(PB12);
#endif  
//--------------------
//SPI.begin();                //--Инициализация SPI;
Serial.begin(115200);       //--Инициализация UART;
//--------------------
} //--END if(!vInit)
//-------------------------------------------------------------------------------------------------
//                                    2.1.Вывод контрольного сигнала
//-------------------------------------------------------------------------------------------------
blinkControl=!blinkControl; if(pinControl!=255){digitalWrite(pinControl,blinkControl);}
//-------------------------------------------------------------------------------------------------
//                                    2.2.Вывод меандра 500мс на LED
//-------------------------------------------------------------------------------------------------
if((millis()-timeBlink)>500){timeBlink=millis(); blink=!blink;  if(pinLed!=255){digitalWrite(pinLed,blink);}}
//-------------------------------------------------------------------------------------------------
//                                    2.3.Вывод текущего номера этапа (для DEBUG)
//-------------------------------------------------------------------------------------------------
//if(consoleOk){if(agoDir!=dir){agoDir=dir; Serial.print(" dir=");  Serial.print(dir);  Serial.println(';');}}
//-------------------------------------------------------------------------------------------------
//                                    2.4.Управление запросами на сервер
//-------------------------------------------------------------------------------------------------
if(dir==0){if(Serial){consoleOk=1;
            Serial.println("\n\n==========Начало теста Ethernet client->host=djxmmx==========");
            Serial.print("++++"); 
            Serial.print(" pinControl="); Serial.print(pinControl); Serial.print(';');
            Serial.print(" pinLed=");     Serial.print(pinLed);     Serial.print(';');           
            Serial.print(" csEth=");      Serial.print(csEth);      Serial.print(';');
            Serial.println();  dir=20;}}
//-------------------------------------------------------------------------------------------------
if(dir==20){if(eth.begin()) {dir=30;}                         //--Переход на продолжение, если успешная инициализация;
            else{Serial.println("Ethernet не обнаружен. Проверьте пины."); timeDelay=millis(); dir++;}} //--Переход на задержку;
if(dir==21){if((millis()-timeDelay)>2000){dir=20;}}         //--Переход на повторную проверки Ethernet;
//-------------------------------------------------------------------------------------------------
if(dir==30){if(eth.connected()){Serial.print("\nEthernet подключен;"); Serial.println(" IP address: "); Serial.println(eth.localIP()); dir=40;}
            else               {Serial.print(".");   timeDelay=millis(); dir++;}} //--Переход на задержку;
if(dir==31){if((millis()-timeDelay)>500){dir=30;}}         //--Возврат после задержки на повторную проверки подключения;
//-------------------------------------------------------------------------------------------------
if(dir==40){if(client.connect(host, port)){Serial.print("+++++++++ Cоединение с "); Serial.print(host); Serial.print(':'); Serial.print(port); 
                                           Serial.println("; +++++++++"); dir=50;}
            else      {timeDelay=millis(); Serial.print("Ошибка соединения millis()=");  Serial.print(timeDelay); Serial.println(';'); dir++;}}
if(dir==41){if((millis()-timeDelay)>5000) {dir=40;}}        //----Возврат после задержки нп повторную проверку подключения к клиенту;                                    
//-------------------------------------------------------------------------------------------------
//                          Отправка строки на сервер
//-------------------------------------------------------------------------------------------------
if(dir==50){Serial.print("+++++++++ Отправка данных на сервер: qnt="); Serial.print(++cnt); Serial.println("; ++++++++++"); dir++;}
if(dir==51){if(client.connected()) {client.println("hello from RP2040");                    timeDelay=millis();             dir++;}}
if(dir==52){if(client.available()>0) {dir=60;}
            if((millis()-timeDelay)>5000){Serial.print("++++ Остановка по тайм-ауту клиента !!! ++++"); 
                                          client.stop();                                    timeDelay=millis();             dir++;}}
if(dir==53){if((millis()-timeDelay)>30000) {dir=30;}}        //----Возврат после задержки на начало цикла;                                                    
//-------------------------------------------------------------------------------------------------
//                          Чтение и вывод принятого сообщения от сервера
//-------------------------------------------------------------------------------------------------
if(dir==60){while (client.available()) {char ch = static_cast<char>(client.read()); Serial.print(ch);}
            Serial.println();
            timeDelay=millis(); dir++;}
if(dir==61){if((millis()-timeDelay)>10000)                {dir=30;}}        //--Задержка для начало нового цикла;  
//-------------------------------------------------------------------------------------------------
} //++++END loop();
//=================================================================================================
