
//##################################################################################################
//                                      I.СТРУКТУРЫ
//##################################################################################################
//=================================================================================================
//                            1.1.СТРУКТУРА ДЛЯ РАБОТЫ С ETHERNET
//=================================================================================================
struct RT_HW_ETHERNET_DEV{
uint8_t custom=0, customFresh=0;                  //--Параметр настройки: custom=1 - параметры настроены;
//------------------------------------------------------------------------------------------------
uint8_t status=0, statusAgo=255, statusFresh=0;   //--FLPROG_ETHERNET_STATUS_NOTREADY   =0 - устройство не готово (default);
                                                  //  FLPROG_ETHERNET_STATUS_READY      =1 - устройство готово;
                                                  //  FLPROG_ETHERNET_STATUS_WHITE_DHCP =2 - устройство готово и имеет "белый" DHCP;  
//------------------------------------------------------------------------------------------------
uint8_t link=0,   linkAgo=255,   linkFresh=0;     //--FLPROG_ETHERNET_LINK_UNKNOWN      =0 - нет связи с устройством(устр-во не иницировано, также возвращает для W5100 !!!?);
                                                  //  FLPROG_ETHERNET_LINK_ON           =1 - устройство    отвечает на запросы;
                                                  //  FLPROG_ETHERNET_LINK_OFF          =2 - устройство не отвечает на запросы;
//------------------------------------------------------------------------------------------------
uint8_t chip=0;                                   //--FLPROG_ETHERNET_NO_HARDWARE       =0 - устройство не обнаружено;
                                                  //  FLPROG_ETHERNET_W5100             =1 - W5100;
                                                  //  FLPROG_ETHERNET_W5200             =2 - W5200;                                                  
                                                  //  FLPROG_ETHERNET_W5500             =3 - W5500;  
//------------------------------------------------------------------------------------------------
uint8_t  busy=0;                                  //--Занятость устройства (1/0);  
uint16_t busyWD=100;                              //--Период сторожевого таймера занятости шины; 
//------------------------------------------------------------------------------------------------
uint8_t cs=255;  uint8_t bus=0;                   //--SPI.cs W5x00 - cs устройства; SPI.bus - номер шины SPI;
IPAddress ip;                                     //--IP адрес;
//------------------------------------------------------------------------------------------------                       
}; 
//=================================================================================================
//                            1.2.СТРУКТУРА ДЛЯ РАБОТЫ С NTP сервером
//=================================================================================================
struct  RT_HW_TIME_NTP_DEV{
//-------------------------------------------------------------------------------------------------
char     mi='W';          //--0.Тип интерфейса;
uint8_t  custom=0;        //--1.Флаг настройки параметров; 
//--------------------------------------------------------------------------------------------------
uint8_t  dir=0,dirAgo=255;//--5.Этапы управляющей задачи;;
uint8_t  run=1;           //--7.1.Флаг для старта запуска запроса;
uint8_t  ok;              //--7.3.Device ok;
uint8_t  fresh;           //--7.4.Fresh data;
//-------------------------------------------------------------------------------------------------
uint8_t  timeZone=3;                    //--Номер часового пояса
uint32_t time1900,timeUNIX,vr;
uint8_t  timeHour,timeMin,timeSec; 
uint16_t cntRequest=0, cntResponse=0;   //--Счетчики запросов и ответов;
uint8_t  cntWD;                         //--Счетчик для сторожевого таймера;
//-------------------------------------------------------------------------------------------------
uint8_t  workDelay=0;     //--10.Working register; 
uint8_t  pointDelay;      //--11.Return point from a function;
uint16_t sizeDelay;       //--12.Size delay;  
uint32_t startDelay;     //--13.Working register;
//------------------------------------------------------------------------------------------------  
uint16_t  periodNTP=10000;
uint16_t  periodWD=5000;
uint8_t   codeMess=0;
uint16_t  getDataQnt=0;                                 //--Кол-во принятых байт;
//------------------------------------------------------------------------------------------------
uint32_t  localPort = 8888;                             //--Определение порта для UDP пакетов (используется стандартный номер);
uint8_t   packetSize=48;                                //--Неизменный размер буфера; 
uint8_t   packetBuffer[48];                             //--Создание буфера для хранения входящих и исходящих пакетов;
};
//=================================================================================================
//                            1.3.СОЗДАНИЕ ОБЪЕКТОВ
//=================================================================================================
RT_HW_ETHERNET_DEV  ethID;                              //--Объект с данными для работы с Ethernet;
RT_HW_TIME_NTP_DEV  ntpID;                              //--Объект с данными для работы с NTP-сервером; 
RT_HW_STRUCT_SHED_TASK shNTP;                           //--Объект для управления задачей;
uint16_t qntPrintMess=0;
//=================================================================================================


//##################################################################################################
//                                      II.РАБОТА С ETHERNET
//##################################################################################################
//-------------------------------------------------------------------------------------------------
//                           2.1.Инициализация параметров Ethernet
//-------------------------------------------------------------------------------------------------
void  customEthernet(RT_HW_ETHERNET_DEV &id){
if(id.custom==1){return;}                                //--Выход, если параметры инициализированы;   
id.cs=csEthernet;                                        //--Определение cs;
W5100_Interface.setSsPin(id.cs);                         //--Настройка номера пина cs W5x00;  
W5100_Interface.mac(0x78, 0xAC, 0xC0, 0x2C, 0x3E, 0x28); //--Установка MAC-адрес контроллера (лучше адрес прошитый производителем);
id.busy=id.statusFresh=id.linkFresh=0;                 //--Настройка рабочих параметров;
id.busyWD=5000;                                      //--Период watch-dog занятости шины =6000ms;
id.custom=1;                                             //--Установка флагов настройки параметров;
id.statusFresh=1;
};
//-------------------------------------------------------------------------------------------------
//                           2.2.Управление связью с Ethernet
//-------------------------------------------------------------------------------------------------
#ifdef RT_HW_TEST_PERMIT_ETHERNET
//- - - - - - - - - - - - - - - - - - - - - - - - - - - - - - - - - - - - - - - - - - - - - - - - -
void  directEthernet(RT_HW_ETHERNET_DEV &id){
//---------------------------------------------------------------------------------------
W5100_Interface.pool();                                     //--Цикл работы интерфейса
//---------------------------------------------------------------------------------------
id.status=W5100_Interface.isReady();                       //--Чтение текущего состояния         устройства  Ethernet;
id.link  =W5100_Interface.linkStatus();                    //--Чтение текущего состояния связи с устройством Ethernet; 
//-------------------------------------------------------------------------------------------------
if(id.statusAgo!=id.status){                              //--ПРОВЕРКА ИЗМЕНЕНИЯ dvLineStatus:
   id.statusAgo =id.status; id.statusFresh=1;            //--Фиксация изменения параметра lineStatus (лучше это делать непосредственно в функции pool);
   id.chip      =W5100_Interface.hardwareStatus();         //--Обновление типа используемого чипа      (лучше это делать непосредственно в функции pool);                                                                            
   id.ip        =W5100_Interface.localIP();                //--Сохранение IP адреса;
}
//-------------------------------------------------------------------------------------------------
if(id.linkAgo !=id.link){                                 //--ПРОВЕРКА ИЗМЕНЕНИЯ dvLinkStatus:
   id.linkAgo  =id.link;     id.linkFresh=1;             //--Фиксация изменения параметра lineStatus (лучше это делать непосредственно в функции pool);
   id.chip     =W5100_Interface.hardwareStatus();          //--Обновление типа используемого чипа      (лучше это делать непосредственно в функции pool);   
}
//-------------------------------------------------------------------------------------------------
};
//- - - - - - - - - - - - - - - - - - - - - - - - - - - - - - - - - - - - - - - - - - - - - - - - -
#else
void  directEthernet(RT_HW_ETHERNET_DEV &id){;};
#endif
//##################################################################################################
//                                      III.РАБОТА С NTP сервером
//##################################################################################################
//-------------------------------------------------------------------------------------------------
//                           3.1.Инициализация параметров NTP-сервера
//-------------------------------------------------------------------------------------------------
void  customNTP(RT_HW_TIME_NTP_DEV &id){
  if(id.custom==1){return;}                                //--Выход, если параметры инициализированы;   
  id.periodNTP=10000;                                      //--Установка периода    опроса NTP сервера =10000ms;
  id.periodWD=5000;                                       //--Установка периода    сторожевого таймера ответа NTP сервера =5000ms;
  id.timeZone=3;                                           //--Установка часового пояса +3;
  id.custom=1;                             //--Установка флагов настройки параметров;
};
//=================================================================================================
//                           2.3.Управления обменом c NTP-сервером
//=================================================================================================
#ifdef RT_HW_TEST_PERMIT_NTP
//- - - - - - - - - - - - - - - - - - - - - - - - - - - - - - - - - - - - - - - - - - - - - - - - -
void  directNTP(RT_HW_TIME_NTP_DEV &id, uint8_t run){
//-------------------------------------------------------------------------------------------------
if(run>0)  {id.run=1;}
//-------------------------------------------------------------------------------------------------
//                  2.00. Инициализация параметров. Продолжение через 500ms.
//-------------------------------------------------------------------------------------------------
if(id.dir==0) { 
id.workDelay=0; id.ok=0;  
if(id.custom==0){return;} 
id.dir=200; id.sizeDelay=500; id.pointDelay=10; return;} 
//-------------------------------------------------------------------------------------------------
//                  2.10.Ожидание сигнала запуска. Переход через 200ms;
//-------------------------------------------------------------------------------------------------
if(id.dir==10){
if(!id.run){return;} id.run=0;
id.dir=200; id.sizeDelay=500; id.pointDelay=20; return;} 
//-------------------------------------------------------------------------------------------------
//                  2.20.Отправка запроса
//-------------------------------------------------------------------------------------------------
if(id.dir==20){
Udp.begin(id.localPort);                      //--Инициализация UDP (это надо делать всегда? ... надо проверить!!!);
memset(id.packetBuffer, 0, id.packetSize);    //--Очистка буфера
id.packetBuffer[0]  = 0b11100011;             // LI, Version, Mode
id.packetBuffer[1]  = 0;                      // Stratum, or type of clock
id.packetBuffer[2]  = 6;                      // Polling Interval
id.packetBuffer[12] = 49;
id.packetBuffer[13] = 0x4E;
id.packetBuffer[14] = 49;
id.packetBuffer[15] = 52;
Udp.beginPacket(timeServer, 123);             //--Инициализация NTP запроса к порту 123;
Udp.write(id.packetBuffer, id.packetSize);    //--Отправка запроса;
Udp.endPacket();                              //--Завершение запроса;
id.cntRequest++;                              //--Увеличение кол-ва отправленных запросов;
id.codeMess=2;                                //--Код выводмиого сообщения;
id.cntWD=0; 
id.dir=200; id.sizeDelay=100; id.pointDelay=30; 
return;} 
//-------------------------------------------------------------------------------------------------
//                  2.30.Проверка ответа каждые 100ms до значения сторожевого таймера;
//-------------------------------------------------------------------------------------------------
if(id.dir==30){
id.getDataQnt=Udp.parsePacket();                          //--Получение кол-ва принятых байт в последнем запросе;
if(id.getDataQnt>0)      {id.dir=40; return;} //--Переход на обработку ответа(dir=50) при наличии данных (сколько принятых данных должно быть???);
//-------------------------------------------------------------------------------------------------
if(++id.cntWD>(id.periodWD/100)){
id.codeMess=3;  id.run=1; 
id.dir=200; id.sizeDelay=100; id.pointDelay=10; return;} 
//--------------------------------------------------------------------------------------------------
id.dir=200; id.sizeDelay=100; id.pointDelay=30; return;}
//-------------------------------------------------------------------------------------------------
//                  2.40.Чтение ответа;
//-------------------------------------------------------------------------------------------------
if(id.dir==40){ 
Udp.read(id.packetBuffer,id.packetSize);                  //--Чтение пакета. В байтах 40-43 находятся сведения о времени;
id.cntResponse++;                                         //--Увеличение счетчика прочитанных пакетов;            
id.time1900=((uint32_t)id.packetBuffer[40]<<24) | ((uint32_t)id.packetBuffer[41]<<16) | ((uint16_t)id.packetBuffer[42]<<8) | id.packetBuffer[43];                  
id.timeUNIX=id.time1900-2208988800UL;                     //--Unix-time время в сек от 01.01.1970, что соответствует 2208988800;
id.fresh=1;                                                //--Установка флага принятых обновленных данных;
//                 dev.busy=0;                                                        //--Освобождении шины;
id.codeMess=4;                                                    //--Код выводимого сообщения;
id.dir=90; return;}                                               //--Возврат на новый запрос к серверу NTP;
//-------------------------------------------------------------------------------------------------
//                  2.90.Successful exit
//-------------------------------------------------------------------------------------------------
if(id.dir==90){
id.timeUNIX=id.time1900-2208988800UL;                     //--Unix-time время в сек от 01.01.1970, что соответствует 2208988800;
id.fresh=1;                                                //--Установка флага принятых обновленных данных;
id.dir=10; return;}
//-------------------------------------------------------------------------------------------------
//                  2.200.Fixed Delay.
//-------------------------------------------------------------------------------------------------
if(id.dir==200){
if(!RT_HW_Base.timeDelay(id.startDelay,id.workDelay,id.sizeDelay)){return;} id.dir=id.pointDelay;}  
//-------------------------------------------------------------------------------------------------
};
//- - - - - - - - - - - - - - - - - - - - - - - - - - - - - - - - - - - - - - - - - - - - - - - - -
#else
void directNTP(RT_HW_TIME_NTP_DEV &id, uint8_t run){if(run){return;}};
#endif


//=================================================================================================
//##################################################################################################
//                                III.ФУНКЦИИ ВЫВОДА НА КОНСОЛЬ
//##################################################################################################
//=================================================================================================
//                                3.1.Вывод состояния Ethernet
//=================================================================================================
void printEthernet(RT_HW_ETHERNET_DEV &id){
if(!RT_HW_Base.console.ok)                    {return;} //--Выход, если консоль не готова;
if((id.statusFresh==0) && (id.linkFresh==0))  {return;} //--Ожидание изменения системных флагов;
  id.statusFresh=id.linkFresh=0;                        //--Очистка флагов состояния
  qntPrintMess++;                                       //--Увеличение числа выводимых диагностических сообщений;
//------------------------------------------------------------------------------------------------  
  RT_HW_Base.consoleVar(qntPrintMess, '.',4,'U');
  RT_HW_Base.consoleVar(String(F(" time=")));; RT_HW_Base.consoleVar(vMotorSec, ';',6,'U');
//------------------------------------------------------------------------------------------------  
  RT_HW_Base.consoleVar(String(F(" Ethernet: ")));
  RT_HW_Base.consoleVar(String(F(" Status=")));  
  if(id.status==1){RT_HW_Base.consoleVar(String(F("Включен; ")));} 
  else             {RT_HW_Base.consoleVar(String(F("Выключен;")));} 
//------------------------------------------------------------------------------------------------  
  RT_HW_Base.mess.alig='L';
  RT_HW_Base.consoleVar(String(F(" Link=")));
       if(id.link==FLPROG_ETHERNET_LINK_UNKNOWN){RT_HW_Base.consoleVar(String(F("Нет инициализации")),   ';',20);} 
  else if(id.link==FLPROG_ETHERNET_LINK_ON)     {RT_HW_Base.consoleVar(String(F("Связь установлена")),   ';',20);} 
  else if(id.link==FLPROG_ETHERNET_LINK_OFF)    {RT_HW_Base.consoleVar(String(F("Нет ответа на запрос")),';',20);}    
  else                                           {RT_HW_Base.consoleVar(String(F("Неизвестная ошибка")),  ';',20);} 
//------------------------------------------------------------------------------------------------   
  RT_HW_Base.consoleVar(String(F(" chip="))); RT_HW_Base.mess.modePin='A';
       if(id.chip==FLPROG_ETHERNET_NO_HARDWARE){RT_HW_Base.consoleVar(String(F("Wxxxx")),';');}
  else if(id.chip==FLPROG_ETHERNET_W5100)      {RT_HW_Base.consoleVar(String(F("W5100")),';');}
  else if(id.chip==FLPROG_ETHERNET_W5200)      {RT_HW_Base.consoleVar(String(F("W5200")),';');}
  else if(id.chip==FLPROG_ETHERNET_W5500)      {RT_HW_Base.consoleVar(String(F("W5500")),';');}
  else                                          {RT_HW_Base.consoleVar(String(F("xxxxx")),';');}
//------------------------------------------------------------------------------------------------    
  RT_HW_Base.mess.modePin='A';  
  RT_HW_Base.consoleTest(String(F(" cs")),id.cs,',','P'); 
  RT_HW_Base.consoleVar(String(F(" IP="))); Serial.print(id.ip);   Serial.print(';'); 
  RT_HW_Base.consoleCR();
};
//=================================================================================================
//                                3.2.Вывод сообщений теста UdpNtpClient(); 
//=================================================================================================
void printTestNTP(RT_HW_TIME_NTP_DEV &id){
if(!RT_HW_Base.console.ok)                    {return;} //--Выход, если консоль не готова;
if(id.codeMess==0)                            {return;} //--Ожидание номера сообщения;
  qntPrintMess++;                                       //--Увеличение номера выводимого сообщения;
//-------------------------------------------------------------------------------------------------
  RT_HW_Base.consoleVar(qntPrintMess,'.',4,'U');
  RT_HW_Base.consoleVar(String(F(" time=")));; RT_HW_Base.consoleVar(vMotorSec, ';',6,'U');
  RT_HW_Base.consoleVar(String(F(" UDP->NTP: ")));
//-------------------------------------------------------------------------------------------------
if(id.codeMess==1){ RT_HW_Base.consoleVar (String(F(" Начало теста v.01 19.08.23г."))); 
                    RT_HW_Base.consoleTest(String(F(" Период запросов(сек)")),  (uint16_t)(id.periodNTP/10), ';');
                    RT_HW_Base.consoleTest(String(F(" Watch-dog ответов(сек)")),(uint16_t)(id.periodWD/10),';'); 
                    RT_HW_Base.consoleCR();
                    id.codeMess=0; return;}  
//-------------------------------------------------------------------------------------------------
if(id.codeMess==2){ RT_HW_Base.consoleVar(String(F(" Запрос в NTP сервер."))); 
                    RT_HW_Base.consoleCR(); 
                    id.codeMess=0; return;}  
//-------------------------------------------------------------------------------------------------
if(id.codeMess==3){ RT_HW_Base.consoleVar(String(F(" Завершение по тайм-ауту ответа от NTP сервера."))); 
                    RT_HW_Base.consoleCR(); 
                    id.codeMess=0; return;}   
//-------------------------------------------------------------------------------------------------
if(id.codeMess==4){ RT_HW_Base.consoleVar(String(F(" Greenwich +0:")));       RT_HW_Base.consoleVar(char(' '));                //--Вывод заголовка;
                    id.vr=(id.timeUNIX % 86400L)/3600;                        RT_HW_Base.consoleVar((uint8_t)id.vr,':',0,'T'); //--Вывод часов (86400 сек в сутках);
                    id.vr=(id.timeUNIX % 3600)  /60;                          RT_HW_Base.consoleVar((uint8_t)id.vr,':',0,'T'); //--Вывод минут (3600 сек в минуте);
                    id.vr= id.timeUNIX % 60;                                  RT_HW_Base.consoleVar((uint8_t)id.vr,';',0,'T'); //--Вывод сек;                   
                    RT_HW_Base.consoleVar(String(F(" +")));                         RT_HW_Base.consoleVar(id.timeZone,':');    //--Вывод заголовка;
                                                                                    RT_HW_Base.consoleVar(char(' '));             
                    id.timeHour=((id.timeUNIX+(id.timeZone*3600UL)) % 86400L)/3600; RT_HW_Base.consoleVar(id.timeHour,':',0,'T'); //--Вывод часов (86400 сек в сутках);
                    id.timeMin= ((id.timeUNIX+(id.timeZone*3600UL)) % 3600)  /60;   RT_HW_Base.consoleVar(id.timeMin,':',0,'T'); //--Вывод минут (3600 сек в минуте);
                    id.timeSec= (id.timeUNIX+(id.timeZone*3600UL))  % 60;           RT_HW_Base.consoleVar(id.timeSec,';',0,'T'); //--Вывод сек;   
                    RT_HW_Base.consoleTest(String(F(" Packet")),id.cntResponse,  '/'); RT_HW_Base.consoleVar(id.cntRequest,';');                        
                    //RT_HW_Base.consoleTest(String(F(" 01.01.1900")),id.time1900, ';');   //--Вывод абсолютного времени в сек(с 01.01.1990);
                    RT_HW_Base.consoleTest(String(F(" Unix")),     id.timeUNIX, ';');   //--Вывод UNIX времени (с 01.01.1970)
                    RT_HW_Base.consoleCR();
                    id.codeMess=0; return;}                                
//------------------------------------------------------------------------------------------------
                    RT_HW_Base.consoleTest(String(F(" Неизвестное тестовое сообщение")),id.codeMess,'E');  
                    RT_HW_Base.consoleCR(); 
                    id.codeMess=0; return;                  
};



//=================================================================================================
//                                3.2.Вывод диагностических сообщений теста UdpNtpClient(); 
//=================================================================================================
void printDebugNTP(RT_HW_TIME_NTP_DEV &id){
if(!RT_HW_Base.console.ok)                    {return;} //--Выход, если консоль не готова;
  if(id.dirAgo!=id.dir){id.dirAgo=id.dir; RT_HW_Base.consoleTest(String(F("dir")),id.dir,'E','U');}};
//##################################################################################################
