//=================================================================================================
//                              3.Test Ethernet
//  3.Web сервер.
//=================================================================================================          
#include <flprogEthernet.h>
//-------------------------------------------------------------------------------------------------

//-------------------------------------------------------------------------------------------------
//          1.1.Создание объект шины SPI под контроллер Ethernet типа  W5100,W5200,W5500
//-----------------------------------------------------------------------------------------
  FLProgSPI            spiBus(0);                     //--Создание объекта для привязки к требуемой шине SPI;//
  FlprogW5100Interface W5100_Interface(&spiBus, 10);  //--Создание объекта для работы с чипом     W5100(W5200,W5500), 
                                                      //   параметры могут быть изменены функцией W5100_Interface.init(&spiBus,cs);
//FlprogW5100Interface W5100_Interface();             //--Создание объекта для работы с чипом     W5100(W5200,W5500);
  IPAddress ip(192, 168, 199, 177);                   //--Создание IP адреса сервера;
  FlprogEthernetServer server(&W5100_Interface, 80);  //--Создание объекта сервера с портом 80;
  uint8_t mac[]={0xDE, 0xAD, 0xBE, 0xEF, 0xFE, 0xED}; //--Установка MAC-адрес контроллера (лучше адрес прошитый производителем);

//  const char timeServer[] = "time.nist.gov";          //--Имя NTP сервера - сервер точного времени;
//  const int NTP_PACKET_SIZE = 48;                     //--Установка размера буфера (отметка времени NTP находится в первых 48 байтах сообщения);
//  uint8_t   packetBuffer[NTP_PACKET_SIZE];            //--Создание буфера для хранения входящих и исходящих пакетов;
  uint8_t   cs=255;                                   //--Номер пина cs для SPI Ethernet; 
//  uint16_t  cntGettingNTP=0;                          //--Cчетчик принятых пакетов;
//----------------------------------------------------------------------------------------
//          1.2.Создание объекта UDP для отправки и получения пакетов по UDP
//   Создаётся объект для чипа W5100,W5200,W5500(библиотека предусматривает расширение на иные чипы)
//   При создание объекта(конструктор) в него передается объект шины SPI и номер пина cs 
//----------------------------------------------------------------------------------------
#ifdef ARDUINO_ARCH_AVR
  #define test_cs         10
  #define test_board      "AVR"
#elif  ARDUINO_ARCH_SAM
  #define test_cs         53
  #define test board      "SAM"
#elif ARDUINO_ARCH_ESP8266
  #define test_cs         15
  #define test_board      "ESP8266"
#elif ARDUINO_ARCH_ESP32
  #define test_cs         33
  #define test_board      "ESP32"
#elif ARDUINO_ARCH_RP2040
  #define test_cs         5
  #define test_board      "RP2040"
#elif ARDUINO_ARCH_STM32
  #define test_cs         PB15
  #define test_board      "STM32"
#else
  #define test_cs         255
  #define test_board      "ANON"
#endif
//------------------------------------------------------------------------------------------------------------

//-----------------------------------------------------------------------------------------
//          1.3.Определение рабочих параметров и функций
//-----------------------------------------------------------------------------------------
uint8_t  dir=0;                                           //--Параметр управления тестовой программы;
uint32_t timeBegin,timeEnd;                               //--Рабочие параметры;
uint8_t  event=0;                                         //--Событие (для точного генератора событий);
uint8_t  cntTime,cntTime1;                                //--Счетчики для отсчета времени;
void     sendNTPpacket(const char *nameSever);            //--Предопределение функции;
void     printDataFromNTP();                              //--Предопределение функции;                
uint8_t  periodMs(uint32_t period);                       //--Предопределение функции;   
//=================================================================================================
void setup(){};
//=================================================================================================
void loop(){
//-------------------------------------------------------------------------------------------------
event=periodMs(100);
if(event){cntTime++;}
//------------------------------------------------------------------------------------------------- 
//                  0.Инициализация параметров
//------------------------------------------------------------------------------------------------- 
if(dir==0){  
cs=test_cs;                         //--Здесь можно переопределить номер пина для cs;
W5100_Interface.init(&spiBus,cs);   //--Инициализация Ethernet c привязкой шины SPI и cs;
cntTime=cntTime1=0;                 //--Инициализация счетчиков времен;
dir=10;}
//------------------------------------------------------------------------------------------------- 
//                  1. Настройка UART для вывода сообщений
//------------------------------------------------------------------------------------------------- 
if(dir==10){           Serial.begin(115200);                                    dir=11;}
if(dir==11){if(Serial){Serial.print(String(F("\n-----Тест WebServer для платы ")));
                       Serial.print(String(F(test_board)));  Serial.print(String(F(": cs.SPI="))); Serial.print(cs);
                       Serial.println(String(F("-----")));
                       if(cs==255){dir=12;} else{dir=20;}}
          }
if(dir==12){Serial.println(String(F("***Недопустимый номер cs"))); cntTime=cntTime1=0; dir=13;} 
if(dir==13){if(cntTime>=10){cntTime=0; Serial.print('.'); if(++cntTime1>=3){dir=12;}}}
//------------------------------------------------------------------------------------------------- 
//                  2.Проверка наличия модуля Ethernet, кабеля Ethernet
//                  (проверяется каждые 2 сек до обнаружения подключенного модуля
//-------------------------------------------------------------------------------------------------
if(dir==20){
  if(W5100_Interface.linkStatus()==0){
     Serial.println(String(F("Не удалось настроить Ethernet с помощью DHCP.")));
            if (W5100_Interface.hardwareStatus() == FLPROG_ETHERNET_NO_HARDWARE){Serial.println(F("Ethernet не найден. Дальнейшая работать не возможна :("));}
      else  if (W5100_Interface.linkStatus()     == FLPROG_ETHERNET_LINK_OFF)   {Serial.println(F("Ethernet кабель не соединен"));}
           dir=21;}
     else {dir=30;}
}
if(dir==21){if(cntTime>=10){cntTime=0; Serial.print('.'); if(++cntTime1>=5){ Serial.print('\n');dir=12;}}}   
//------------------------------------------------------------------------------------------------- 
//                  3.Запуск сервера
//-------------------------------------------------------------------------------------------------
if(dir==30){
  server.begin();                                                           //--Запуск сервера;
  Serial.print("server is at "); Serial.println(W5100_Interface.localIP()); //--Вывод IP-адреса;
  dir=40;}
//------------------------------------------------------------------------------------------------- 
//                  4.Запуск сервера
//-------------------------------------------------------------------------------------------------
if(dir==40)
  FlprogEthernetClient client = server.available(); //--Проверка наличия клиентов;
  if (client){
    Serial.println(String(F("Новый клиент")));
    // an http request ends with a blank line
    boolean currentLineIsBlank = true;
    while (client.connected())
    {
      if(client.available())
      {
        char c = client.read();
        Serial.write(c);
//-------------------------------------------------------------------------------------------------
//                4.1.Проверка завершения HTTP-запроса от клиента
//                    (перевод строки или пустая строка)
//-------------------------------------------------------------------------------------------------
        if (c == '\n' && currentLineIsBlank) 
        {
//-------------------------------------------------------------------------------------------------
//                4.1.1.Отправка стандартного заголовка ответа от сервера
//-------------------------------------------------------------------------------------------------
          client.println("HTTP/1.1 200 OK");
          client.println("Content-Type: text/html");
          client.println("Connection: close");      //--Соединение будет закрыто после завершения ответа;
          client.println("Refresh: 5");             //--Автоматическое обновление страницы каждые 5 секунд;
          client.println();
          client.println("<!DOCTYPE HTML>");
          client.println("<html>");
          // output the value of each analog input pin
          
          for (int analogChannel = 0; analogChannel < 6; analogChannel++)
          {
            int sensorReading = 200 + (250*analogChannel);
            client.print("Канал-");
            client.print(analogChannel);
            client.print(" Значение=");
            client.print(sensorReading);
            client.println("<br />");
          }
          client.println("</html>");
          break;
        }
             if(c == '\n'){currentLineIsBlank = true;}    //--Установка флага "Новая линия"
        else if(c != '\r'){currentLineIsBlank = false;}   //--Сброс     флага "Новая линия";
      }
    }
//-------------------------------------------------------------------------------------------------    
    // give the web browser time to receive the data
    delay(1);
    // close the connection:
    // client.stop();
    Serial.println("client disconnected");
  }
 
//-------------------------------------------------------------------------------------------------
}   //======END loop();
//-------------------------------------------------------------------------------------------------
