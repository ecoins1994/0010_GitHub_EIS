//+++++++++++++++++++++++++++++++++++++++++++++++++++++++++++++++++++++++++++++++++++++++++++++++++ 
//                                  TEST Board_70_Device_Max_v1.0_26.01.2024  
//                              ТЕСТИРОВАНИЕ УСТРОЙСТВ С ВЫВОДОМ НА ДИСПЛЕИ Lcd,Nextion,
//                        проверка Ethernet, NTP-сервер через Ethernet, WebServer через Ethernet
//                            (совместим с визуальной системой программирования FLProg)
//    1.1.Настройка параметров в т.ч. тестовые пины, которые могут быть изменены.
//    1.2.В каждом цикле loop() вызывается "Диспетчер задач".
//    1.3.Каждую секунду обрабатываюся секундные параметры - быстродействие проекта, время наработки).
//    2.1.Инициализируется консоль (в терминах Arduino IDE - монитор порта). 
//    2.2.После готовности консоли (проверка консоли особо критична для контроллеров с USB на кристалле - STM32,Raspberry Pi,ESP32-C3,S2,S3),
//        в монитор порта однократно выводяся отчет о проекте (пины, наличие коммуникаций и др.),
//        сканируется шина i2c (SDA,SCL необходимо подтянуть к Vcc резисторами 10-47к).
//    3.1.В каждом цикле loop() меняется значение на пине Control (для логического анализатора).
//    3.2.На пин Led выводится меандр 500ms.
//    4.1.Периодически читается пин ADC(period 100ms). Отфильтрованное значение ADC выводится на пин PWM.
//    4.2.Читается значение пина "Кнопка" с защитой от дребезга 50ms.
//    5.  Сенсоры чере пины: DHT22,DS1820,HC-SR04;
//    6.  Sensors via i2c:  AHTxx(T,H),BMP280(P),SHT3x(T,H),HTU21(T,H); 
//    8.  Extenders via i2c: MCP4725(DAC);
//    9.  Extenders via SPI: 74HC595 "Running 1" ;
//    10. Вывод на Lcd1.i2c(0x27)
//          Кнопка=0:  строка 1:Blink(*),ADC,флаг второго ядра(+/-), счетчик второго ядра, ,Speed/1000.
//                     строка 2:Ok CombiSensor,Temp,Hum(AHTxx).  
//          Кнопка=1:  строка 1:Blink(#),DS1820.ok,DS1280.Temp,HC-SR04.ok,HC-SR04.Len;
//                     строка 2:SHT3x.ok,SHT3x.Temp,SHT3x.Hum.  
//=================================================================================================
//    Подключение к выполнению различных устройств выполняется через снятие символов комментариев(//) 
//    с соответствующего макроса.
//-------------------------------------------------------------------------------------------------
//    Перечень поддерживаемых плат размещен во вкладке Readme.hpp.
//    Там же размещены инструкции по настройке Arduino IDE, 
//    для ESP32 дополнительная инструкция для достижения большего удобства.
//-------------------------------------------------------------------------------------------------
// ecoins@mail.ru 26.01.2024
//+++++++++++++++++++++++++++++++++++++++++++++++++++++++++++++++++++++++++++++++++++++++++++++++++
//+++++++++++++++++++++++++++++++++++++++++++++++++++++++++++++++++++++++++++++++++++++++++++++++++
//                    0.1.Разрешения использования как ПЛК
//+++++++++++++++++++++++++++++++++++++++++++++++++++++++++++++++++++++++++++++++++++++++++++++++++ 
  #define  RT_HW_TEST_PERMIT_PLC_RP2040_55   //--Разрешение использования как ПЛК RP2040 v.5.5; 
//+++++++++++++++++++++++++++++++++++++++++++++++++++++++++++++++++++++++++++++++++++++++++++++++++
//                    0.2.Разрешения использования сенсоров
//+++++++++++++++++++++++++++++++++++++++++++++++++++++++++++++++++++++++++++++++++++++++++++++++++  
  #define RT_HW_TEST_PERMIT_AHTx        //--i2c.Разрешение использования сенсора AHTx; 
  #define RT_HW_TEST_PERMIT_SHT3x       //--i2c.Разрешение использования сенсора SHT3x;
  #define RT_HW_TEST_PERMIT_BH1750      //--i2c.Разрешение использования сенсора BH1750;
//#define RT_HW_TEST_PERMIT_BME280      //--i2c.Разрешение использования сенсора BME280;
//#define RT_HW_TEST_PERMIT_BMP180      //--i2c.Разрешение использования сенсора BMP180;
//+++++++++++++++++++++++++++++++++++++++++++++++++++++++++++++++++++++++++++++++++++++++++++++++++
//                    0.3.Разрешения использования расширителей
//+++++++++++++++++++++++++++++++++++++++++++++++++++++++++++++++++++++++++++++++++++++++++++++++++   
  #define RT_HW_TEST_PERMIT_ADS1115     //--i2c.Разрешение использования расширителя ADS1115(i2c);  
  #define RT_HW_TEST_PERMIT_MCP4725     //--i2c.Разрешение использования расширителя MCP4725; 
//#define RT_HW_TEST_PERMIT_MCP23017    //--i2c.Разрешение использования расширителя MCP23017(i2c);
//#define RT_HW_TEST_PERMIT_PCF8575     //--i2c.Разрешение использования расширителя PCF8575 (i2c);
//-------------------------------------------------------------------------------------------------
  #define RT_HW_TEST_PERMIT_74HC595     //--SPI.Разрешение использования расширителя 74HC595; 
  #define RT_HW_TEST_PERMIT_74HC165     //--SPI.Разрешение использования расширителя 74HC165;
//+++++++++++++++++++++++++++++++++++++++++++++++++++++++++++++++++++++++++++++++++++++++++++++++++
//                    0.4.Разрешения использования дисплеев
//+++++++++++++++++++++++++++++++++++++++++++++++++++++++++++++++++++++++++++++++++++++++++++++++++
  #define RT_HW_TEST_PERMIT_LCD1_i2c    //--Разрешение подключения дисплея Lcd1.i2c  16x2;
  #define RT_HW_TEST_PERMIT_LCD2_i2c    //--Разрешение подключения дисплея Lcd2.i2c  20x4; 
  #define RT_HW_TEST_PERMIT_LCD5_NEXT   //--Разрешение подключения дисплея Lcd5.Next 20x4 (Nextion);
//+++++++++++++++++++++++++++++++++++++++++++++++++++++++++++++++++++++++++++++++++++++++++++++++++
//                    0.4.Разрешения использования работы с Ethernet
//+++++++++++++++++++++++++++++++++++++++++++++++++++++++++++++++++++++++++++++++++++++++++++++++++
  #define RT_HW_TEST_PERMIT_ETHERNET        //--Разрешение тестов работы с Ethernet;
  #define RT_HW_TEST_PERMIT_ETHERNET_NTP    //--Разрешение тестов работы c NTP-cерверами(серверы точного времени);
  #define RT_HW_TEST_PERMIT_ETHERNET_SERVER //--Разрешение тестов работы c cервером;
//+++++++++++++++++++++++++++++++++++++++++++++++++++++++++++++++++++++++++++++++++++++++++++++++++
//                    0.5.Разрешения использования работы с ModBus
//+++++++++++++++++++++++++++++++++++++++++++++++++++++++++++++++++++++++++++++++++++++++++++++++++
  #define RT_HW_TEST_PERMIT_MB_MASTER_RTU   //--Разрешение использования MasterRTU;
  #define RT_HW_TEST_PERMIT_MB_SLAVE_RTU    //--Разрешение использования SlaveRTU;
//#define RT_HW_TEST_PERMIT_ModbusTCP       //----Разрешение тестов работы с Modbus TCP;
//#define RT_HW_TEST_PERMIT_ModbusBridge    //----Разрешение тестов работы с Modbus Bridge(мост);  

//=================================================================================================
//                    0.6.Подключение библиотек
//=================================================================================================
  #include "flprogModbusRTU.h"          //--Подключение библиотеки ModBus RTU (Включает #include RT_HW_BASE.h");  
  #include "RT_HW_BASE.h"               //--Подключение базовой библиотеки;
  #include "RT_HW_LCD44780.h"           //--Подключение библиотеки дисплеев типа HD44780;
  #include "RT_HW_NEXT.h"               //--Подключение библиотеки дисплеев типа Nextion;
  #include "RT_HW_SENSORS.h"            //--Подключение библиотек базовых сенсоров(DHT22,DS1820,HC-SR04,AHTx,BH1750,BME280,BMP180,HTU21,SHT3x,PAJ602U2,MAX6675);
  #include "RT_HW_EXPANDERS.h"          //--Подключение библиотек базовых расширителей(MCP4725,PCF8575,ADS1115,74HC595,74HC165,MCP23x17);
  #include "RT_HW_ETH.h"   
//=================================================================================================
//                    0.7.Подключение внутренних вкладок
//=================================================================================================
  #include "Asys.hpp"                   //--Системные объекты и параметры; 
  #include "Fethernet.hpp"              //--Объекты, параметры и функции Ethernet (Сеть,NTP,WebServer);
  #include "Gmodbus.hpp"                //--Объекты, параметры и функции Modbus ();
//-------------------------------------------------------------------------------------------------
  #include "Bconsole.hpp"               //--Функции вывода на консоль;
  #include "Csensor.hpp"                //--Сенсоры;  
  #include "Dexpander.hpp"              //--Расширители;
  #include "E_PLC.hpp"                  //--Расширители PLC;
//-------------------------------------------------------------------------------------------------
  #include "Lcd1.hpp"                   //--Подключение вкладки Lcd1(i2c) 16x4;       
  #include "Lcd2.hpp"                   //--Подключение вкладки Lcd2(i2c) 20x4; 
//-------------------------------------------------------------------------------------------------
  #include "Nextion.hpp"                //--Подключение вкладки Lcd5_Nxt(дисплей Nextion через UART); 
//=================================================================================================
//                                    I.Секция SETUP()
//=================================================================================================
void setup(){}
//=================================================================================================
//                                    II.Секция LOOP()
//=================================================================================================
void loop(){
//================================================================================================= 
//                     2.1.Инициализация параметров и диспетчер
//================================================================================================= 
//if(isInit==0){RT_HW_Base.uartBegin(2);}
  initProject();                                //--Инициализация параметров;
  RT_HW_Base.sheduler(shed);                    //--Диспетчер задач(CORE0);
//================================================================================================= 
//                     2.2.Управление консолью
//=================================================================================================
if(shed.frdm.num==1){
  RT_HW_Base.consoleBegin();                    //--Инициализация консоли;
  if(RT_HW_Base.console.head){consoleHead();}  //--Однократный вывод отчета по MC;
}
//=================================================================================================
//                     2.3.Управление через Ethernet
//================================================================================================= 
if(shed.frdm.num==2){
  setParamExpEth();                             //--Настройка параметров Ethernet;             
  directExpEth();                               //--Управление модулем   Ethternet;
  messExpEth();                                 //--Вывод диагностических сообщений Ethernet(период в циклах loop);
}
//=================================================================================================
//                    2.4.Управление NTP-сервером через Ethernet
//================================================================================================= 
if(shed.frdm.num==3){
  setParamNtpEth();                             //--Настройка параметров NTP-сервера;
  directNtpEth();                               //--Управление работой с NTP-сервера;
  messNtpEth();                                 //--Вывод диагностических сообщений NTP-сервер;
}
//=================================================================================================
//                    2.5 Управление сервером через Ethernet
//================================================================================================= 
if(shed.frdm.num==4){
  directServerEth(1);                           //--Консоль: =0 Нет вывода; =1-Подключение/отключение; >=2 Все сообщения;
  messServerEth(); 
}
//================================================================================================= 
//                   2.5.Обработка секундных событий
//=================================================================================================
if(shed.eventSec){                               //--Обработка секундных событий:
  vSpeedMCU=shed.cycle;                          //  CORE0: кол-во циклов в сек;
  vSpeedMCUF=FilterSpeed.filtered(vSpeedMCU);    //  CORE0: кол-во циклов в сек с фильтром; 
  vSpeedSmall=round(((float)vSpeedMCUF)/1000);   //  CORE0: кол-во циклов в сек с фильтром/1000;
  vMotorSec=shed.cntSec;                         //  CORE0: кол-во секунд с начала работы программы;
  vspeedMCU=vcoreCntSycle;   vcoreCntSycle=0;    //  CORE1: кол-во циклов в сек;
  vspeedMCUF=filterSpeed.filtered(vspeedMCU);    //  CORE0: кол-во циклов в сек с фильтром; 
  vspeedSmall=round(((float)vspeedMCUF)/1000);   //  CORE1: кол-во циклов в сек /1000;  
  RT_HW_Base.unixID.timeUNIX++;                  //--TIME:  Инкремент UNIX времени;
  RT_HW_Base.unixGetTotal();                     //--TIME:  Получение времени,даты,дня недели;
} //--END if(shed.eventSec);
//================================================================================================= 
//                    2.10.1.Работа системными пинами 
//=================================================================================================
  RT_HW_Base.pinDigitalWrite(idPinControl,pinControl,shed.control); //--Вывод цикла loop() на контрольный пин; 
  RT_HW_Base.pinDigitalWrite(idPinLed,    pinLed,    shed.blink500);//--Вывод меандра 500 ms на светодиод; 
  if(shed.quick.num==1) {fncButton();}                              //--Чтение кнопки с защитой от дребезга;
  if(shed.quick.num==2) {fncADC();}                                 //--Чтение ADC; 
  if(shed.frdm.num== 4) {fncSetStatus();}                           //--Установка флагов системных,устройств; 
  if(shed.slow.num== 1) {fncCounter();}                             //--Тестовый счетчик;
  if(shed.frdm.num== 5) {fncDAC();}                                 //--Генератор для тестирования DAC; 
//================================================================================================= 
//                    2.10.2.Сенсоры
//=================================================================================================  
  if(shed.frdm.num==11) {snsDS1820();}            //--pin.DS1820. При опросе задержка 4-6 ms;   
  if(shed.frdm.num==13) {snsSR04();}              //--pin.HC-SR04(по прерываниям); 
  if(shed.frdm.num==14) {snsAHTxx();}             //--i2c.AHTxx;
  if(shed.frdm.num==15) {snsSHT3x();}             //--i2c.SHT3x;
  if(shed.frdm.num==16) {snsBH1750();}            //--i2c.BH1750
//if(shed.frdm.num==17) {snsBMP180();}            //--i2c.BMP180;
//if(shed.frdm.num==18) {snsBME280();}            //--i2c.BME280;
//================================================================================================= 
//                    2.10.3.Расширители
//================================================================================================= 
  if(shed.frdm.num==20){expADS1115();}            //--i2c.ADS1115 (16-разрядный ADC, 4 канала);
  if(shed.frdm.num==21){expMCP4725();}            //--i2c.MCP4725 (12-разрядный DAC);
//if(shed.frdm.num==22){expMCP23017();}           //--i2c.MCP23017(16-разрядный дискретный ввод-вывод);
//if(shed.frdm.num==23){expPCF8575();}            //--i2c.PCF8575 (16-разрядный дискретный ввод-вывод);     
//-------------------------------------------------------------------------------------------------
//if(shed.frdm.num==24){exp74HC595();}            //--SPI.74HC595;  
//if(shed.frdm.num==25){exp74HC165();}            //--SPI.74HC165;
  if(shed.frdm.num==27){expDotPLC();}             //--pin+SPI.Вывод на выходы PLC;
  if(shed.frdm.num==29){pinDIN=v74HC165;}         //--Вывод на pinDIN;
//=================================================================================================
//                   2.20.ДИСПЛЕИ
//=================================================================================================
  if(shed.frdm.num==40){Lcd1();}            //--Output Lcd1(16x2,i2c,0x27);
  if(shed.frdm.num==41){Lcd2();}            //--Output Lcd2(20x4,i2c,0x3E);
  if(shed.frdm.num==45){Lcd5_Nextion();}    //--Output Lcd5 Nextion(UART);

//+++++++++++++++++++++++++++++++++++++++++++++++++++++++++++++++++++++++++++++++++++++++++++++++++ 
//                            3.Modbus
//+++++++++++++++++++++++++++++++++++++++++++++++++++++++++++++++++++++++++++++++++++++++++++++++++
  #include "MBmasterRTU.hpp"    //==Modbus Master RTU1;
  #include "MBslaveRTU.hpp"     //==Modbus Slave  RTU1;

//-------------------------------------------------------------------------------------------------
//#################################################################################################
//                       III. Переключение на ядро CORE 1 для  RP2040
//#################################################################################################
#if defined(RT_HW_PERMIT_CORE1)
} 
void setup1(){vcoreOk=1;};        
void loop1() {vcoreCntSycle++;                       //--Счетчик циклов второго ядра и флаг подключения второго ядра;
#endif
if(++vcoreTask>50){vcoreTask=1;}
if(vcoreTask==1){};
}; //++++END loop() or loop1=======================================================================
