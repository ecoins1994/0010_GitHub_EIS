//+++++++++++++++++++++++++++++++++++++++++++++++++++++++++++++++++++++++++++++++++++++++++++++++++
//                                     1.СЕНСОРЫ
//+++++++++++++++++++++++++++++++++++++++++++++++++++++++++++++++++++++++++++++++++++++++++++++++++
//=================================================================================================
//                                     1.1.DS1820 через 1-Wire
//=================================================================================================
RT_HW_STRUCT_DS1820_ID  dvDS1820; RT_HW_STRUCT_SHED_TASK shDS1820;  RT_HW_ONEWIRE dvNW;
//-------------------------------------------------------------------------------------------------
#ifdef RT_HW_TEST_PERMIT_DS1820
//- - - - - - - - - - - - - - - - - - - - - - - - - - - - - - - - - - - - - - - - - - - - - - - - -
void snsDS1820(){
if(shDS1820.custom==0){RT_HW_Base.setTaskID(shDS1820,'P',2200); shDS1820.periodLimit=50;} //--Периодический вызов 2.2сек;
if(dvDS1820.custom==0){RT_HW_ds1820.setParam(dvDS1820,pinDS1820);}                        //--Настройка параметров;
dvDS1820.run=RT_HW_Base.directTask(shDS1820);                                             //--Управление задачей;
RT_HW_ds1820.direct(dvNW,dvDS1820);                                                       //--Управление устройством; 
if(dvDS1820.fresh){dvDS1820.fresh=0; vDS1820Temp=dvDS1820.vTemp; vDS1820ok=dvDS1820.ok;}  //--Обновление данных;
};
//- - - - - - - - - - - - - - - - - - - - - - - - - - - - - - - - - - - - - - - - - - - - - - - - -
#else
void snsDS1820(){;};
#endif
//=================================================================================================
//                                     1.2.HC-SR04 через пин Trig (соединить с Echo чере R=470ом) по прерываниям;
//=================================================================================================
RT_HW_STRUCT_SR04_ID  dvSR04;     RT_HW_STRUCT_SHED_TASK shSR04;
RT_HW_FILTER_MEDIAN_3 <uint16_t> ftrSR04;     uint16_t vSR04LenF;   //--Parameters for the HC-SR04 filter (3rd order median);
//------------------------------------------------------------------------------------------------
RT_HW_IRAM_ATTR void RT_HW_IRQ_SR04_handler_dvSR04(){
  if(dvSR04.state==2) {if( RT_HW_PIN_DIR_READ(dvSR04.ddPin)){dvSR04.timeBegin=micros(); dvSR04.state=3;}}
  if(dvSR04.state==3) {if(!RT_HW_PIN_DIR_READ(dvSR04.ddPin)){dvSR04.timeEnd  =micros(); dvSR04.state=4;}}}
//------------------------------------------------------------------------------------------------
#ifdef RT_HW_TEST_PERMIT_SR04
//- - - - - - - - - - - - - - - - - - - - - - - - - - - - - - - - - - - - - - - - - - - - - - - - -
void snsSR04(){
if(shSR04.custom==0){RT_HW_Base.setTaskID(shSR04,'P',75);}                              //--Периодический вызов 75ms;
if(dvSR04.custom==0){dvSR04.custom=1; dvSR04.extPinTrig=pinSR04; dvSR04.maxLen=400;}    //--Настройка параметров;
dvSR04.run=RT_HW_Base.directTask(shSR04);                                               //--Управление задачей; 
RT_HW_sr04.direct(dvSR04);                                                              //--Управление устройством;
if(dvSR04.state==1){dvSR04.state++;  attachInterrupt(dvSR04.numIRQ, RT_HW_IRQ_SR04_handler_dvSR04,CHANGE);}
if(dvSR04.fresh)   {dvSR04.fresh=0;  dvSR04.LenMcs=ftrSR04.filtered(dvSR04.echoMcs);    //--Обновление данных;
                    dvSR04.Len=round(dvSR04.LenMcs * dvSR04.speedSoundAir/10.0) ;  
                 if(dvSR04.Len>dvSR04.maxLen){dvSR04.Len=dvSR04.maxLen;}
                    vSR04Len=dvSR04.Len;  vSR04ok=dvSR04.ok;}         
};
//- - - - - - - - - - - - - - - - - - - - - - - - - - - - - - - - - - - - - - - - - - - - - - - - -
#else
void snsSR04(){;};
#endif
//=================================================================================================
//                                    1.3.AHTxx.i2c (T,H)      
//=================================================================================================
RT_HW_AHTxx_DEV   dvAHTxx;      RT_HW_STRUCT_SHED_TASK shAHTxx; 
#ifdef RT_HW_TEST_PERMIT_AHTx
//- - - - - - - - - - - - - - - - - - - - - - - - - - - - - - - - - - - - - - - - - - - - - - - - -
void snsAHTxx(){
//-------------------------------------------------------------------------------------------------
if(dvAHTxx.custom==0) {dvAHTxx.mi='I';          
                 dvAHTxx.custom=RT_HW_Base.i2cSetParam(dvAHTxx.dvI,i2cAdrAHTxx,0,0);  //--Настройка параметров (адрес i2c, номер шины, скорость);
                 shAHTxx.periodLimit=50;  RT_HW_Base.setTaskID  (shAHTxx,'P',1200);}  //--Периодический вызов 75ms;
//-------------------------------------------------------------------------------------------------
RT_HW_Base.directTask(shAHTxx);                                                       //--Управление задачей;  
RT_HW_ahtxx.direct(dvAHTxx,shAHTxx.run);                                              //--Управление устройством;
//-------------------------------------------------------------------------------------------------
if(dvAHTxx.fresh){
//-------------------------------------------------------------------------------------------------
//if(RT_HW_Base.consoleOk()){  
//sign='-'; if(dvAHTxx.ok){sign='+';} RT_HW_Base.consoleVar(sign);    //--Вывод а консоль;
//RT_HW_Base.consoleTest(String(F("AHTxx  T")),dvAHTxx.vTemp,';'); 
//RT_HW_Base.consoleTest(String(F(" H")),      dvAHTxx.vHum),'E';
//}
//-------------------------------------------------------------------------------------------------
}
if(dvAHTxx.fresh){dvAHTxx.fresh=0; vAHTxx_ok=dvAHTxx.ok; vAHTxx_Temp=dvAHTxx.vTemp; vAHTxx_Hum=dvAHTxx.vHum;}  //--Обновление данных;
};
//- - - - - - - - - - - - - - - - - - - - - - - - - - - - - - - - - - - - - - - - - - - - - - - - -
#else
void snsAHTxx(){;};
#endif
//=================================================================================================
//                                      1.4.SHT3X.i2c
//=================================================================================================
#ifdef RT_HW_TEST_PERMIT_SHT3x
//- - - - - - - - - - - - - - - - - - - - - - - - - - - - - - - - - - - - - - - - - - - - - - - - -
RT_HW_SHT3x_DEV   dvSHT3x;      RT_HW_STRUCT_SHED_TASK shSHT3x;
//-------------------------------------------------------------------------------------------------
void snsSHT3x(){
//-------------------------------------------------------------------------------------------------
if(dvSHT3x.custom==0) {dvSHT3x.mi='I';          
                       dvSHT3x.custom=RT_HW_Base.i2cSetParam(dvSHT3x.dvI,i2cAdrSHT3x,0,0); //--adr,bus,speed;
                       shSHT3x.periodLimit=50;  RT_HW_Base.setTaskID  (shSHT3x,'P',1200); }    //--modeTask='P',period=1200; 
//-------------------------------------------------------------------------------------------------
RT_HW_Base.directTask(shSHT3x);           //--Launching AHTXX task; 
RT_HW_sht3x.direct(dvSHT3x,shSHT3x.run);  //--Sensor control; AHTxx;
//-------------------------------------------------------------------------------------------------
if(dvSHT3x.fresh){dvSHT3x.fresh=0; vSHT3x_ok=dvSHT3x.ok; vSHT3x_Temp=dvSHT3x.vTemp; vSHT3x_Hum=dvSHT3x.vHum;}  //--Updating measured data;
};
//- - - - - - - - - - - - - - - - - - - - - - - - - - - - - - - - - - - - - - - - - - - - - - - - -
#else
void snsSHT3x(){;};
#endif
//=================================================================================================
//                                      1.5.BH1750
//  Setting task:   'P'-periodic call, no more than 5 cycles, period 2200ms;
//  Setting sensor: adr=i2cAdrBH1750, bus=0, speed=0;
//=================================================================================================
#ifdef RT_HW_TEST_PERMIT_BH1750
//- - - - - - - - - - - - - - - - - - - - - - - - - - - - - - - - - - - - - - - - - - - - - - - - -
RT_HW_BH1750_DEV  dvBH1750;     RT_HW_STRUCT_SHED_TASK shBH1750; 
//-------------------------------------------------------------------------------------------------
void snsBH1750(){
//-------------------------------------------------------------------------------------------------
if(dvBH1750.custom==0) {dvBH1750.custom=RT_HW_Base.i2cSetParam(dvBH1750.dvI,i2cAdrBH1750,0,0);  //--adr,bus,speed;
                        dvBH1750.mi='I';
                        shBH1750.periodLimit=50;  RT_HW_Base.setTaskID  (shBH1750,'P',500);}    //--modeTask='P',period=500; 
//----------------------------------------------------------------------
RT_HW_Base.directTask(shBH1750);                        //--Launching AHTXX task; 
RT_HW_bh1750.direct(dvBH1750,shBH1750.run);             //--Sensor control; AHTxx;
//-------------------------------------------------------------------------------------------------
if(dvBH1750.fresh){dvBH1750.fresh=0; vBH1750Lux=dvBH1750.vLux; vBH1750ok=dvBH1750.ok;} //--Updating measured data;
};
//- - - - - - - - - - - - - - - - - - - - - - - - - - - - - - - - - - - - - - - - - - - - - - - - -
#else
void snsBH1750(){;};
#endif

//+++++++++++++++++++++++++++++++++++++++++++++++++++++++++++++++++++++++++++++++++++++++++++++++++
//                                     2. РАСШИРИТЕЛИ
//+++++++++++++++++++++++++++++++++++++++++++++++++++++++++++++++++++++++++++++++++++++++++++++++++
//=================================================================================================
//                                     2.1. 74HC595.SPI Ввывод бегущей '1'
//=================================================================================================
RT_HW_74HC595_DEV           dv74HC595;    RT_HW_STRUCT_SHED_TASK sh74HC595;
RT_HW_GENERATOR_EVENT_ID idGen74HC595;    RT_HW_COUNTER_ID    idCnt74HC595;   uint32_t vCnt74HC595=0;    uint32_t vGen74HC595=0;  
RT_HW_GENERATOR_RUN_ID  idRun;  
//-------------------------------------------------------------------------------------------------
#ifdef RT_HW_TEST_PERMIT_74HC595
//- - - - - - - - - - - - - - - - - - - - - - - - - - - - - - - - - - - - - - - - - - - - - - - - -
void exp74HC595(){   
//------------------------------------------------------------------------------------------------
if(idCnt74HC595.reset){RT_HW_Base.counterReset(idCnt74HC595,8,0,1,0);}      //--Инициализация счетчика: top=8, bottom=0, шаг изменения=1, начальное значение=0;
if(RT_HW_Base.generatorEvent(idGen74HC595,100)) {vCnt74HC595=RT_HW_Base.counterS(idCnt74HC595);  vGen74HC595=RT_HW_Base.dc8(vCnt74HC595);}; //--Пилa, бегущая "1", 32 разряда;
//------------------------------------------------------------------------------------------------
if(dv74HC595.custom==0){dv74HC595.custom=RT_HW_Base.spiSetParam(dv74HC595.dvS,cs74HC595,0,4000000);
                        dv74HC595.mi='S'; dv74HC595.qnt=1;  //--Кол-во регистров 74HC595(1-4);
                        dv74HC595.bitOrder=0;               //--Последовательность вывода: =1 - впереди старший бит;
                        RT_HW_Base.setTaskID(sh74HC595, 'Q',5); //--Вывод по изменениям с проверкой каждые 5 циклов программы; 
}
//-------------------------------------------------------------------------------------------------
RT_HW_Base.directTask(sh74HC595);
RT_HW_74hc595.direct(dv74HC595,vGen74HC595,sh74HC595.run);};
#else
void exp74HC595(){;};
#endif
//=================================================================================================
//                                     2.2. 74HC165.SPI
//=================================================================================================
RT_HW_74HC165_DEV dv74HC165;    RT_HW_STRUCT_SHED_TASK sh74HC165;  uint32_t v74HC165,  ago74HC165;
//-------------------------------------------------------------------------------------------------
#ifdef RT_HW_TEST_PERMIT_74HC165
//- - - - - - - - - - - - - - - - - - - - - - - - - - - - - - - - - - - - - - - - - - - - - - - - -
void exp74HC165(){  
if(dv74HC165.custom==0){dv74HC165.custom=RT_HW_Base.spiSetParam(dv74HC165.dvS,cs74HC165,0,4000000);
                        dv74HC165.mi='S'; dv74HC165.qnt=1; dv74HC165.bitOrder=1;  //--qnt=Кол-во регистров 74HC595(1-4);
                        RT_HW_Base.setTaskID(sh74HC165,'P',50);                   //--Периодический вызов задачи: 'P';                      
                        }                  
//-------------------------------------------------------------------------------------------------
RT_HW_Base.directTask(sh74HC165); 
//-------------------------------------------------------------------------------------------------
RT_HW_74hc165.direct(dv74HC165,sh74HC165.run); 
if(dv74HC165.fresh) {dv74HC165.fresh=0;  v74HC165=dv74HC165.var;
};
}; //--END void exp74HC165()
#else
void exp74HC165(){;};
#endif
//=================================================================================================
//                                     2.3.ADS1115.i2c;
//=================================================================================================
#ifdef RT_HW_TEST_PERMIT_ADS1115
//- - - - - - - - - - - - - - - - - - - - - - - - - - - - - - - - - - - - - - - - - - - - - - - - -
RT_HW_ADS1115_DEV  dvADS1115;   RT_HW_STRUCT_SHED_TASK shADS1115;
//-------------------------------------------------------------------------------------------------
void expADS1115(){ 
if(dvADS1115.custom==0){dvADS1115.custom=RT_HW_Base.i2cSetParam(dvADS1115.dvI,i2cAdrADS1115,0,800000);
                        dvADS1115.mi='I';RT_HW_Base.setTaskID(shADS1115,'P',200);}
//------------------------------------------------------------------------------------------------
RT_HW_Base.directTask(shADS1115);                         //--Launching task; 
RT_HW_ads1115.direct(dvADS1115,shADS1115.run );           //--Direct ADS1115;
//-------------------------------------------------------------------------------------------------
if(dvADS1115.fresh){dvADS1115.fresh=0;                  vADS1115_ok=dvADS1115.ok; 
vADS1115_A0f=RT_HW_ads1115.getVar_V(dvADS1115,dvADS1115.vA0);  
vADS1115_A1f=RT_HW_ads1115.getVar_V(dvADS1115,dvADS1115.vA1); 
vADS1115_A2f=RT_HW_ads1115.getVar_V(dvADS1115,dvADS1115.vA2);  
vADS1115_A3f=RT_HW_ads1115.getVar_V(dvADS1115,dvADS1115.vA3);
}};
//- - - - - - - - - - - - - - - - - - - - - - - - - - - - - - - - - - - - - - - - - - - - - - - - -
#else
void expADS1115(){;};
#endif
//=================================================================================================


//=================================================================================================
