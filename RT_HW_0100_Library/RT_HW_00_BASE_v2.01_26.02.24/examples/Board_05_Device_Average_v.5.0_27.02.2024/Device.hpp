//+++++++++++++++++++++++++++++++++++++++++++++++++++++++++++++++++++++++++++++++++++++++++++++++++
//                                    2. РАСШИРИТЕЛИ через i2c
//+++++++++++++++++++++++++++++++++++++++++++++++++++++++++++++++++++++++++++++++++++++++++++++++++
//=================================================================================================
//                                    2.1. MCP4725.i2c;
//=================================================================================================
#ifdef RT_HW_TEST_PERMIT_MCP4725
RT_HW_MCP4725_DEV        dvMCP4725;     RT_HW_STRUCT_SHED_TASK shMCP4725;
RT_HW_GENERATOR_EVENT_ID idGenMCP4725;  RT_HW_COUNTER_ID idCntMCP4725;      uint16_t vGenMCP4725=0;  //--Для генератора 0-4095 MCP4725;
//- - - - - - - - - - - - - - - - - - - - - - - - - - - - - - - - - - - - - - - - - - - - - - - - -
void genMCP4725(){                                                                //==Функция: Генератор для DAC MCP4725;
   if(idCntMCP4725.reset){RT_HW_Base.counterReset(idCntMCP4725,4095,0,10,0);}     //--Инициал.счетчика: Upper limit=4095, Down limit=0, Change step=10, Initial value=0;
   if(RT_HW_Base.generatorEvent(idGenMCP4725,10)) {vMCP4725_vr=vGenMCP4725=RT_HW_Base.counterT(idCntMCP4725);}}; //--Генератор треугольника 10ms;
//-------------------------------------------------------------------------------------------------
void expMCP4725(){                                                                //==Функция: Управление    DAC MCP4725;  
if(dvMCP4725.custom==0){                                                          //--Настройка параметров устройства и задачи;
   dvMCP4725.custom=RT_HW_Base.i2cSetParam(dvMCP4725.dvI,i2cAdrMCP4725,0,800000); //  Настройка параметров: адрес i2c, номер шины, скорость;
                    RT_HW_Base.setTaskID(shMCP4725,'Q'); shMCP4725.period=0;}     //  Настройка задачи:  в каждом цикле при изменении во внешней функции; 
   RT_HW_Base.directTask(shMCP4725);                                              //--Управление задачей; 
   RT_HW_mcp4725.direct(dvMCP4725,vMCP4725_vr,shMCP4725.run );}                   //--Управление устройством;
//- - - - - - - - - - - - - - - - - - - - - - - - - - - - - - - - - - - - - - - - - - - - - - - - -
#else
void genMCP4725(){;};                                                             //==Функция: Заглушка вместо функции генератора для DAC MCP4725;
void expMCP4725(){;};                                                             //==Функция: Заглушка вместо функции управления     DAC MCP4725;  
#endif
//=================================================================================================
//                                     2.3. ADS1115.i2c;
//=================================================================================================
#ifdef RT_HW_TEST_PERMIT_ADS1115
//- - - - - - - - - - - - - - - - - - - - - - - - - - - - - - - - - - - - - - - - - - - - - - - - -
RT_HW_ADS1115_DEV  dvADS1115;   RT_HW_STRUCT_SHED_TASK shADS1115;
//-------------------------------------------------------------------------------------------------
void expADS1115(){                                                                //==Функция: Управление ADS1115; 
if(dvADS1115.custom==0){                                                          //--Настройка параметров устройства и задачи;
   dvADS1115.custom=RT_HW_Base.i2cSetParam(dvADS1115.dvI,i2cAdrADS1115,0,800000); //  Настройка параметров: адрес i2c, номер шины, скорость;
   RT_HW_Base.setTaskID(shADS1115,'P',200);}                                      //  Настройка задачи: периодически='P', период=200ms; 
//------------------------------------------------------------------------------------------------
RT_HW_Base.directTask(shADS1115);                                                 //--Управление задачей;  
RT_HW_ads1115.direct(dvADS1115,shADS1115.run );                                   //--Управление устройством;
//-------------------------------------------------------------------------------------------------
if(dvADS1115.fresh){dvADS1115.fresh=0;                  vADS1115_ok=dvADS1115.ok; //--Обновление результатов измерения;
vADS1115_A0f=RT_HW_ads1115.getVar_V(dvADS1115,dvADS1115.vA0);  
vADS1115_A1f=RT_HW_ads1115.getVar_V(dvADS1115,dvADS1115.vA1); 
vADS1115_A2f=RT_HW_ads1115.getVar_V(dvADS1115,dvADS1115.vA2);  
vADS1115_A3f=RT_HW_ads1115.getVar_V(dvADS1115,dvADS1115.vA3);}};
//- - - - - - - - - - - - - - - - - - - - - - - - - - - - - - - - - - - - - - - - - - - - - - - - -
#else
void expADS1115(){;};
#endif

//+++++++++++++++++++++++++++++++++++++++++++++++++++++++++++++++++++++++++++++++++++++++++++++++++
//
//                                    3. РАСШИРИТЕЛИ через SPI
//
//+++++++++++++++++++++++++++++++++++++++++++++++++++++++++++++++++++++++++++++++++++++++++++++++++
//=================================================================================================
//                                     3.1. 74HC595.SPI Ввывод бегущей '1'
//=================================================================================================
#ifdef RT_HW_TEST_PERMIT_74HC595
RT_HW_74HC595_DEV           dv74HC595;      RT_HW_STRUCT_SHED_TASK sh74HC595;
RT_HW_GENERATOR_EVENT_ID    id74HC595_gen;  RT_HW_COUNTER_ID       id74HC595_cnt;   uint32_t v74HC595_cnt=0;    uint32_t v74HC595_gen=0, v74HC595_ago;  
RT_HW_GENERATOR_RUN_ID  idRun;  
//- - - - - - - - - - - - - - - - - - - - - - - - - - - - - - - - - - - - - - - - - - - - - - - - -
void gen74HC595(){                                                              //==Функция: Генератор для 74HC595;
  if(id74HC595_cnt.reset){RT_HW_Base.counterReset(id74HC595_cnt,8,0,1,0);}      //--Инициализация счетчика: top=8, bottom=0, шаг изменения=1, начальное значение=0;
  if(RT_HW_Base.generatorEvent(id74HC595_gen,100)) {v74HC595_cnt=RT_HW_Base.counterS(id74HC595_cnt);  v74HC595_vr=v74HC595_gen=RT_HW_Base.dc8(v74HC595_cnt);}}; //--Пилa, бегущая "1", 32 разряда;
void exp74HC595(){                                                              //==Функция: Управление    74HC595; 
if(dv74HC595.custom==0){                                                        //--Настройка параметров устройства и задачи;
   dv74HC595.custom=RT_HW_Base.spiSetParam(dv74HC595.dvS,cs74HC595,0,4000000);  //  Настройка параметров: cs, номер шины SPI, скорость;
   dv74HC595.mi='S'; dv74HC595.qnt=1;                                           //  Кол-во регистров 74HC595(1-4);
   dv74HC595.bitOrder=0;                                                        //  Последовательность вывода: =1 - впереди старший бит;
   RT_HW_Base.setTaskID(sh74HC595, 'Q',5);}                                     //  Вывод по изменениям с проверкой каждые 5 циклов программы; 
   RT_HW_Base.directTask(sh74HC595);                                            //--Управление задачей; 
   RT_HW_74hc595.direct(dv74HC595,v74HC595_vr,sh74HC595.run);};                 //--Управление устройством; 
//- - - - - - - - - - - - - - - - - - - - - - - - - - - - - - - - - - - - - - - - - - - - - - - - -
#else
void gen74HC595(){;};                                                           //==Функция: Заглушка вместо функции генератора для 74HC595;
void exp74HC595(){;};                                                           //==Функция: Заглушка вместо функции управления для 74HC595; 
#endif
//=================================================================================================
//                                     3.2. 74HC165.SPI
//=================================================================================================
#ifdef RT_HW_TEST_PERMIT_74HC165
RT_HW_74HC165_DEV dv74HC165;    RT_HW_STRUCT_SHED_TASK sh74HC165;
//- - - - - - - - - - - - - - - - - - - - - - - - - - - - - - - - - - - - - - - - - - - - - - - - -
void exp74HC165(){                                                              //==Функция: Управление    74HC595;
if(dv74HC165.custom==0){                                                        //--Настройка параметров устройства и задачи;
   dv74HC165.custom=RT_HW_Base.spiSetParam(dv74HC165.dvS,cs74HC165,0,4000000);  //  Настройка параметров: cs, номер шины SPI, скорость;
   dv74HC165.mi='S'; dv74HC165.qnt=1; dv74HC165.bitOrder=1;                     //  qnt=Кол-во регистров 74HC595(1-4);
   RT_HW_Base.setTaskID(sh74HC165,'P',50);}                                     //--Периодический вызов задачи: 'P';                      
   RT_HW_Base.directTask(sh74HC165);                                            //--Управление задачей; 
   RT_HW_74hc165.direct(dv74HC165,sh74HC165.run);                               //--Управление устройством;
   if(dv74HC165.fresh) {dv74HC165.fresh=0;  v74HC165_vr=dv74HC165.var;}};       //--Обновление принятого значения;
#else
void exp74HC165(){;};                                                           //==Функция: Заглушка вместо функции управления для 74HC165;
#endif
//=================================================================================================
