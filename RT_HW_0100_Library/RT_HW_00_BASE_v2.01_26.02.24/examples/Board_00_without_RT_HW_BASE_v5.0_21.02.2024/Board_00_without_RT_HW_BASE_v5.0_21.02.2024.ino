//+++++++++++++++++++++++++++++++++++++++++++++++++++++++++++++++++++++++++++++++++++++++++++++++++
//                                  BASIC TEST №00 v.5.0 21.01.2024  
// 								Проверка устройства без использования функций системной библиотеки RT_HW_BASE.h
// 	1. Мерцание светодиодом 1000мс;
//  2. Вывод в стандартный порт Serial:
//     2.1.Каждую секунду выводится  ON + номер пина Led / OFF + мотосекунды;
//     2.2.Каждые пять секунд выводится имя платы выбранной в Arduino, имя платы из RT_HW_BASE.h (если это возможно); 
//-------------------------------------------------------------------------------------------------
// ecoins@mail.ru 27.04.2024.
//-------------------------------------------------------------------------------------------------
#include "RT_HW_BASE.h"
//-------------------------------------------------------------------------------------------------
#if defined(LED_BUILTIN)
uint8_t pinLed=LED_BUILTIN;
#else
uint8_t pinLed=255;
#endif
//-------------------------------------------------------------------------------------------------
uint8_t debugCnt=0,timeCnt=0, dirUART=0, readUART=0;
//=================================================================================================
//                                    Секция SETUP()
//=================================================================================================
void setup(){
#if defined(RT_HW_BASE_h)
     pinLed=RT_HW_Base.vPinLed();      //--Установка пина Led;
#endif
//-------------------------------------------------------------------------------------------------
//pinLed=16;      //--Здесь можно изменить номер пина;
}
//=================================================================================================
//                                    Секция LOOP()
//=================================================================================================
void loop(){
//-------------------------------------------------------------------------------------------------
if(dirUART==0){if(pinLed!=255){pinMode(pinLed, OUTPUT);} Serial.begin(115200);                      debugCnt=0; dirUART++;}
if(dirUART==1){if(Serial){readUART=1;      Serial.println(String(F("Start ALL test with Serial"))); debugCnt=0; dirUART++;}}
//-------------------------------------------------------------------------------------------------
if(pinLed!=255){digitalWrite(pinLed, HIGH);}   
if(readUART){Serial.print("Led ON  pin="); Serial.println(pinLed);}
delay(1000);  timeCnt++;                    
//-------------------------------------------------------------------------------------------------
if(pinLed!=255){digitalWrite(pinLed, LOW);}    
if(readUART){Serial.print("Led OFF time="); Serial.println(timeCnt);} 
delay(1000);  timeCnt++;                 
//-------------------------------------------------------------------------------------------------
if(readUART && !debugCnt){
#if defined(RT_HW_BASE_h)
Serial.print(String(F("BOARD:: ")));
#if defined(RT_HW_BOARD_NAME)
Serial.print(String(F("IDE->")));    Serial.print(String(F(RT_HW_BOARD_NAME)));   //--Name of the selected Arduino IDE board;
#endif
#if defined(RT_HW_BOARD_SELECT)
Serial.print(String(F("; Base->"))); Serial.print(String(F(RT_HW_BOARD_SELECT))); //--Name of the selected board RT_HW_BASE.h;
#endif
Serial.print(';'); Serial.print(' '); 
#endif
//-------------------------------------------------------------------------------------------------
#if defined(ARDUINO_ARCH_AVR)
Serial.print(String(F("ARCH AVR;")));
#endif
//-------------------------------------------------------------------------------------------------
#if defined(__SAM3X8E__)
Serial.print(String(F("ARCH SAM3X8E;")));
#endif
//-------------------------------------------------------------------------------------------------
#if defined(__SAMD21__)			//--???
Serial.print(String(F("ARCH SAMD21;")));
#endif
//-------------------------------------------------------------------------------------------------
#if defined(__SAMD51__)			//--???
Serial.print(String(F("ARCH SAMD51;")));
#endif
//-------------------------------------------------------------------------------------------------
#if (defined(ESP8266) || ESP8266 )
Serial.print(String(F("ARCH ESP826;")));
#endif
//-------------------------------------------------------------------------------------------------
#if (defined(ESP32) || ESP32 )
Serial.print(String(F("ARCH ESP32;")));
#endif
//-------------------------------------------------------------------------------------------------
#if defined(ARDUINO_ARCH_RASPBERRY_PI_PICO)
Serial.print(String(F("ARCH Rasberry Pi Pico;")));
#endif
//-------------------------------------------------------------------------------------------------
#if defined(ARDUINO_ARCH_RP2040)
Serial.print(String(F("ARCH RP2040;")));
#endif

//-------------------------------------------------------------------------------------------------
#if defined(ARDUINO_ARCH_STM32)
Serial.print(String(F("ARCH STM32;")));
#endif
//-------------------------------------------------------------------------------------------------
Serial.println('\n');               
}
//-------------------------------------------------------------------------------------------------
if(++debugCnt>=3){debugCnt=0;}
}; //+++END loop();
//=================================================================================================
