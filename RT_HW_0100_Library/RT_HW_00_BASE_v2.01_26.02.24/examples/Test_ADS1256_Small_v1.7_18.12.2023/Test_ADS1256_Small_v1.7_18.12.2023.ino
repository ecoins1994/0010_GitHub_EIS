//+++++++++++++++++++++++++++++++++++++++++++++++++++++++++++++++++++++++++++++++++++++++++++++++++ 
//                                  BASIC TEST №04 ver.2.0 14.10.2023  
//                              ТЕСТИРОВАНИЕ УСТРОЙСТВ С ВЫВОДОМ НА ДИСПЛЕИ
//                        (совместим с визуальной системой программирования FLProg)
//    1.1.Настройка параметров в т.ч. тестовые пины, которые могут быть изменены.
//    1.2.В каждом цикле loop() вызывается "Диспетчер задач".
//    1.3.Каждую секунду обрабатываюся секундные параметры - быстродействие проекта, время наработки).
//    2.1.Инициализируется консоль (в терминах Arduino IDE - монитор порта). 
//    2.2.После готовности консоли (проверка консоли особо критична для контроллеров с USB на кристалле - STM32,Raspberry Pi,ESP32-C3,S2,S3),
//        в монитор порта однократно выводяся отчет о проекте (пины, наличие коммуникаций и др.),
//        сканируется шина i2c (SDA,SCL необходимо подтянуть к Vcc резисторами 10-47к).
//    3.1.В каждом цикле loop() меняется значение на пине Control (для логического анализатора).
//    3.2.На пин Led выводится меандр 500ms.
//    4.1.Периодически читается пин ADC(period 100ms). Отфильтрованное значение ADC выводится на пин PWM.
//    4.2.Читается значение пина "Кнопка" с защитой от дребезга 50ms.
//    6.  Сенсоры      через i2c:  AHTxx(T,H),); 
//    8.  Расширители  через SPI: 74HC595 "Бегущая 1" ; ADC ADS1256; 
//    10. Дисплей Lcd1 через i2c(0x27);
//                     строка 1:Button,ADC,,Speed/1000.
//                     строка 2:Сенсор AHTxx-ok,Temp,Hum.  
//    Подключение к выполнению различных устройств выполняется через снятие символов комментариев(//) с соответствующего макроса.
//-------------------------------------------------------------------------------------------------
// ecoins@mail.ru 22.11.23
//+++++++++++++++++++++++++++++++++++++++++++++++++++++++++++++++++++++++++++++++++++++++++++++++++
//                    Разрешения использования устройств
//+++++++++++++++++++++++++++++++++++++++++++++++++++++++++++++++++++++++++++++++++++++++++++++++++  
#ifndef    RT_HW_ADS1256_DEBUG
  #define  RT_HW_ADS1256_DEBUG    //--Разрешение вывода отладочных сообщений;
#endif
//-------------------------------------------------------------------------------------------------  
  #define RT_HW_TEST_PERMIT_AHTx        //--Разрешение использования сенсора AHTx;
  #define RT_HW_TEST_PERMIT_74HC595     //--Разрешение использования расширителя 74HC595;  
  #define RT_HW_TEST_PERMIT_ADS1256     //--Разрешение использования расширителя ADS1256; 
  #define RT_HW_TEST_PERMIT_LCD1_i2c    //--Разрешение подключения дисплея Lcd1.i2c  16x2;
  #define RT_HW_TEST_PERMIT_LCD2_i2c    //--Разрешение подключения дисплея Lcd2.i2c  20x4;  
//=================================================================================================
//                    Подключение библиотек
//=================================================================================================
  #include "RT_HW_BASE.h"               //--Подключение базовой библиотеки;
  #include "RT_HW_LCD44780.h"           //--Подключение библиотеки дисплея HD44780;  
  #include "RT_HW_SENSORS.h"            //--Подключение библиотек сенсоров;
  #include "RT_HW_EXPANDERS.h"          //--Подключение библиотек расширителей;
  #include "RT_HW_ADS1256.h"            //--Подключение библиотеки ADS1256;
//=================================================================================================
//                    Подключение внутренних вкладок
//=================================================================================================
  #include "Asystem.hpp"                //--Системные параметры и функции (ADC,PWM,Кнопка,DHT22,DS1820,HC-SR04,AHTxx);
  #include "Fads1256.hpp"               //--ADS1256;
//-------------------------------------------------------------------------------------------------
  #include "Lcd1.hpp"                   //--Подключение вкладки Lcd1(i2c) 16x2; 
  #include "Lcd2.hpp"                   //--Подключение вкладки Lcd2(i2c) 20x4;
//=================================================================================================
//                                    Секция SETUP()
//=================================================================================================
void setup(){}
//=================================================================================================
//                                    Секция SETUP()
//=================================================================================================
void loop(){
//================================================================================================= 
//                                    1.1.Инициализация параметров и диспетчер
//================================================================================================= 
initProject();                                  //--Инициализация параметров;
RT_HW_Base.sheduler(shed);                      //--Диспетчер задач(CORE0);
//================================================================================================= 
//                                    1.2.Обработка секундных событий
//=================================================================================================
if(shed.eventSec){                              //--Обработка секундных событий:
vSpeedMCU=shed.cycle;                           //  кол-во циклов в сек;
vSpeedMCUF=FilterSpeed.filtered(vSpeedMCU);     //  кол-во циклов в сек с фильтром; 
vSpeedSmall=round(((float)vSpeedMCUF)/1000);    //  кол-во циклов в сек с фильтром/1000;
vMotorSec=shed.cntSec;                          //  кол-во секунд с начала работы программы;
}
//================================================================================================= 
//                                    1.3.Управление консолью
//=================================================================================================
RT_HW_Base.consoleBegin();                     //--Инициализация консоли;
if(RT_HW_Base.console.head){consoleHead();}    //--Однократный вывод отчета по MC;
//================================================================================================= 
//                                    1.4.Работа системными пинами
//=================================================================================================
if(shed.frdm.num==31){vDebug=1;} else {vDebug=0;}
RT_HW_Base.pinDigitalWrite(idPinControl,pinControl,shed.control);   //--Вывод цикла loop() на контрольный пин; 
RT_HW_Base.pinDigitalWrite(idPinLed,    pinLed,    shed.blink500);  //--Вывод меандра 500 ms на светодиод; 
RT_HW_Base.pinDigitalWrite(idPinDebug,  pinDebug,  vDebug);         //--Вывод значения vDebug на пин Debug; 
  if(shed.quick.num==1){fncADC();                                   //--Чтение ADC; 
                        fncButton();}                               //--Чтение кнопки с защитой от дребезга;
//================================================================================================= 
  if(shed.frdm.num==1){snsAHTxx();}              //--AHTxx;
  if(shed.frdm.num==2){exp74HC595();}            //--Вывод на 74HC595;
//-------------------------------------------------------------------------------------------------
  if(shed.frdm.num==4){Lcd1();}                  //--Вывод Lcd1(16x2,i2c,0x27);
  if(shed.frdm.num==5){Lcd2();}                  //--Вывод Lcd2(20x4,i2c,0x3E);
//-------------------------------------------------------------------------------------------------
//  if(shed.frdm.num!=0){expADS1256();}            //--Ввод  с  ADS1256;
                      expADS1256();             //--Ввод  с  ADS1256;  
//-------------------------------------------------------------------------------------------------
}; //++++END loop()================================================================================
