//+++++++++++++++++++++++++++++++++++++++++++++++++++++++++++++++++++++++++++++++++++++++++++++++++
//                                 Тест платы №03 ver.5.0 21.02.2024  
//                                           СКАНИРОВАНИЕ ШИНЫ i2c
//                  (совместим с визуальной системой программирования FLProg)
//    1.1.Инициализируется консоль (в терминах Arduino IDE - монитор порта). 
//    1.2.После готовности консоли (проверка консоли особо критична для контроллеров с USB на кристалле,
//        в монитор порта однократно выводится отчет о проекте (пины, наличие коммуникаций и др.),
//        сканируется шина i2c (SDA,SCL необходимо подтянуть к Vcc резисторами 10-47к).
//    3.1.В каждом цикле loop() меняется значение на пине Control (для логического анализатора).
//    3.2.На пин Led выводится меандр 500ms.
//    4.  Периодически сканируется шина i2c (можно сканировать несколько шин).
//-------------------------------------------------------------------------------------------------
// ecoins@mail.ru 21.02.2024
//+++++++++++++++++++++++++++++++++++++++++++++++++++++++++++++++++++++++++++++++++++++++++++++++++
//=================================================================================================
//                                 Подключение библиотек
//=================================================================================================
  #include "RT_HW_BASE.h"   //--Базовая библиотека;
//=================================================================================================
//                                  Объекты и параметры,функции 
//=================================================================================================
//-------------------------------------------------------------------------------------------------
//                                  1.Пины Контроль,Led,PWM
//------------------------------------------------------------------------------------------------- 
  RT_HW_PIN_DIR_ID   idPinControl; uint8_t pinControl=255;                      //--Пин контроль loop()[для логического анализатора];
  RT_HW_PIN_DIR_ID   idPinLed;     uint8_t pinLed=255;                          //--Пин Led на плате;                    
//-------------------------------------------------------------------------------------------------
//                                  2.Параметры сканирования
//-------------------------------------------------------------------------------------------------
RT_HW_GENERATOR_EVENT_ID idGenScan;                                             //--Генератор для санирования i2c;
uint8_t idx;                                                                    //--Рабочий индекс;
//----------------------------------------------------------------------------------------------------
//void consoleHead();   //--Предопределение функции;

//=================================================================================================
//                                    Секция SETUP()
//=================================================================================================
void setup(){}
//=================================================================================================
//                                    Секция LOOP()
//=================================================================================================
void loop(){
//+++++++++++++++++++++++++++++++++++++++++++++++++++++++++++++++++++++++++++++++++++++++++++++++++
//                                    1.СИСТЕМНЫЕ ФУНКЦИИ
//+++++++++++++++++++++++++++++++++++++++++++++++++++++++++++++++++++++++++++++++++++++++++++++++++

//================================================================================================= 
//                                    1.1.Инициализация параметров
//=================================================================================================
  if(RT_HW_Base.isInit==0){
     RT_HW_Base.isInit=1;
     pinControl  =RT_HW_Base.vPinControl();  //--Установка пина Control;
     pinLed      =RT_HW_Base.vPinLed();      //--Установка пина Led; 
//-------------------------------------------------------------------------------------------------
//   RT_HW_Base.i2cSetPins(28,29,0);}   //--pinSDA,pinSCL,bus- Здесь можно перенастроить номера пинов для контроллеров, в которых это возможно.
//   RT_HW_Base.i2cSetPins(28,29,1);}   //--pinSDA,pinSCL,bus- Здесь можно перенастроить номера пинов для контроллеров, в которых это возможно.
//-------------------------------------------------------------------------------------------------
}
//================================================================================================= 
//                                    1.2.Диспетчер задач
//=================================================================================================
RT_HW_Base.sheduler();                  
//================================================================================================= 
//                                    1.3.Однократный вывод на консоль параметров проекта;
//=================================================================================================
if(RT_HW_Base.shed.frdm.num==1){
   RT_HW_Base.consoleBegin();               //--Инициализация консоли;
if(RT_HW_Base.console.head){consoleHead();} //--Однократный вывод отчета по MCU;
}
//=================================================================================================
//                                    1.4.Вывод на контрольный пин
//=================================================================================================
//if(idPinControl.dir==0){RT_HW_PIN_DIR_SET_ID(idPinControl,pinControl); idPinControl.mode='N';} 
//RT_HW_Base.pinDigitalWrite(idPinControl,RT_HW_Base.shed.control);  
//================================================================================================= 
//                                    1.5.Вывод на светодиод
//=================================================================================================
  if(RT_HW_Base.shed.frdm.num==1) {
    RT_HW_Base.pinDigitalWrite(idPinLed,pinLed,RT_HW_Base.shed.blink500);    
}
//=================================================================================================
//                                    1.6.Сканирование i2c
//=================================================================================================
if(RT_HW_Base.shed.quick.num==1){
  if(RT_HW_Base.generatorEvent(idGenScan,1200)){      //--Генератор событий с периодом 1200 ms;
     RT_HW_Base.i2cScanBus(0);
//   RT_HW_Base.i2cScanBus(1);
  }
}
}; //++++END loop()================================================================================


//+++++++++++++++++++++++++++++++++++++++++++++++++++++++++++++++++++++++++++++++++++++++++++++++++
//                                    ВНЕШНИЕ ФУНКЦИИ
//+++++++++++++++++++++++++++++++++++++++++++++++++++++++++++++++++++++++++++++++++++++++++++++++++
//=================================================================================================
//                                  1.Функция: Вывод на консоль параметров контроллера
//=================================================================================================
void consoleHead(){
  RT_HW_Base.consoleHead(String(F("Тест Board_03_Simple_Scan_i2c_v5.0")),'=');
  RT_HW_Base.consoleHead(String(F("Основные параметры")));         RT_HW_Base.mess.modePin='T';  RT_HW_Base.consoleBoardGeneral();           
  #if !defined(RT_HW_PERMIT_COMPACT)
  RT_HW_Base.consoleHead(String(F("Дополнительные параметры")));   RT_HW_Base.mess.modePin='T';  RT_HW_Base.consoleBoardAdd();  
  RT_HW_Base.consoleHead(String(F("Разрешение устройств")));       RT_HW_Base.mess.modePin='T';  RT_HW_Base.consoleBoardDepth();
                                                                                                 RT_HW_Base.consoleBoardSpecific();                                                                                            
  RT_HW_Base.consoleHead(String(F("Параметры диспетчера задач")));                               RT_HW_Base.consoleShedulerParameters();
  RT_HW_Base.consoleHead(String(F("Доступные пины")));             RT_HW_Base.mess.modePin='A';  RT_HW_Base.consolePinsAll();    
  RT_HW_Base.consoleHead(String(F("Интерфейсы")));                 RT_HW_Base.mess.modePin='T';  RT_HW_Base.consoleInterface(); 
  RT_HW_Base.consoleHead(String(F("Системные,тестовые,cs пины"))); RT_HW_Base.mess.modePin='T';  
  RT_HW_Base.consolePinsSystem(); RT_HW_Base.consolePinsTest();    RT_HW_Base.consolePinsCS();     
  #else
  RT_HW_Base.consoleHead(String(F("Интерфейсы")));                 RT_HW_Base.mess.modePin='T';  RT_HW_Base.consoleInterface(); 
  #endif  
//-------------------------------------------------------------------------------------------------
  RT_HW_Base.consoleHead(String(F("Параметры шин(bus) i2c")));  RT_HW_Base.mess.modePin='T';  
  for(idx=0; idx<3; idx++){RT_HW_Base.i2cHeadInterface(idx);}
//-------------------------------------------------------------------------------------------------
  RT_HW_Base.consoleHead(String(F("Сканирование i2c(bus=0)"))); RT_HW_Base.mess.modeAdr='A';  
                                                                RT_HW_Base.i2cScanBus(0);  
//-------------------------------------------------------------------------------------------------   
  RT_HW_Base.consoleLine('+');  
};
//=================================================================================================
   
