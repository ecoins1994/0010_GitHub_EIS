//+++++++++++++++++++++++++++++++++++++++++++++++++++++++++++++++++++++++++++++++++++++++++++++++++ 
//                                 Тест платы №02 v.5.0 23.02.2024  
//                   ВЫВОД НА КОНСОЛЬ ПАРАМЕТРОВ КОНТРОЛЛЕРА, ADC, "Кнопки"
//                  (совместим с визуальной системой программирования FLProg)
//    1.1.Настройка параметров в т.ч. тестовые пины, которые могут быть изменены.
//    1.2.В каждом цикле loop() вызывается "Диспетчер задач".
//    1.3.Каждую секунду обрабатываюся секундные параметры - быстродействие проекта, время наработки).
//    2.1.Инициализируется консоль (в терминах Arduino IDE - монитор порта). 
//    2.2.После готовности консоли (проверка консоли особо критична для контроллеров с USB на кристалле - STM32,Raspberry Pi,ESP32-C3,S2,S3),
//        в монитор порта однократно выводяся отчет о проекте (пины, наличие коммуникаций и др.),
//        сканируется шина i2c (SDA,SCL необходимо подтянуть к Vcc резисторами 10-47к).
//    3.1.В каждом цикле loop() меняется значение на пине Control (для логического анализатора).
//    3.2.На пин Led выводится меандр 500ms.
//    4.1.Периодически читается пин ADC(period 100ms). Отфильтрованное значение ADC выводится на пин PWM.
//    4.2.Читается значение пина "Кнопка" с защитой от дребезга 50ms.
//    5.0. Или каждые 30сек, или по изменению состоянию ADC и кнопки, 
//         на консоль выводятся параметры ADC, Button, быстродействия.
//-------------------------------------------------------------------------------------------------
//    Перечень поддерживаемых плат размещен во вкладке Readme.hpp.
//    Там же размещены инструкции по настройке Arduino IDE, 
//    для ESP32 дополнительная инструкция для достижения большего удобства.
//-------------------------------------------------------------------------------------------------
// ecoins@mail.ru 21.02.24
//+++++++++++++++++++++++++++++++++++++++++++++++++++++++++++++++++++++++++++++++++++++++++++++++++

//+++++++++++++++++++++++++++++++++++++++++++++++++++++++++++++++++++++++++++++++++++++++++++++++++
//                                    0. Секция DECLARE
//+++++++++++++++++++++++++++++++++++++++++++++++++++++++++++++++++++++++++++++++++++++++++++++++++
//=================================================================================================
//                      1. Разрешения использования пинов и устройств
//=================================================================================================  
  #define RT_HW_TEST_PERMIT_CONTROL     //--pin.Разрешение вывода на пин Контроль; 
  #define RT_HW_TEST_PERMIT_CNS_HEAD    //--Консоль.Разрешение вывода заголовков;
//=================================================================================================
//                                2. Подключение библиотек
//=================================================================================================
  #include "RT_HW_BASE.h"               //--Базовая библиотека;
//=================================================================================================
//                                  Объекты и параметры,функции 
//=================================================================================================
//-------------------------------------------------------------------------------------------------
//                                  1. Пины Контроль,Led,PWM
//------------------------------------------------------------------------------------------------- 
  RT_HW_PIN_DIR_ID   idPinControl; uint8_t pinControl=255;                      //--Пин контроль loop()[для логического анализатора];
  RT_HW_PIN_DIR_ID   idPinLed;     uint8_t pinLed=255;                          //--Пин Led на плате;                    
  RT_HW_PIN_PWM_ID   idPinPWM;     uint8_t pinPWM=255;     uint32_t vPWM;       //--Пин PWM, значение для вывода на PWM;
//-------------------------------------------------------------------------------------------------
//                                  2. Пины Кнопка
//-------------------------------------------------------------------------------------------------
  RT_HW_PIN_DIR_ID   idPinButton;  uint8_t pinButton=255;  uint8_t  vButton;    //--Пин Кнопка, значение с кнопки;
  RT_HW_FILTER_CHATTER<uint8_t>    filterButton;           uint8_t  vButtonF;   //--Фильтр дребезга кнопки, значение после фильтра;
//-------------------------------------------------------------------------------------------------
//                                  3. Пин ADC
//-------------------------------------------------------------------------------------------------
  RT_HW_PIN_ADC_ID   idPinADC;     uint8_t pinADC=255;     uint16_t vADC;       //--Пин ADC, значение с пина;  
  RT_HW_FILTER_RING_AVERAGE<uint16_t,10> filterADC;        uint16_t vADCF;      //--Фильтр ADC(median 5-го порядка), значение после фильтра;
//-------------------------------------------------------------------------------------------------
//                                  4. Системные параметры
//-------------------------------------------------------------------------------------------------
  RT_HW_FILTER_RING_AVERAGE<uint32_t,5>  filterSpeed;      uint16_t vspeedF0;   //--Фильтр быстродействия CORE 0;
//-------------------------------------------------------------------------------------------------
//                                  5. Тестовые параметры
//-------------------------------------------------------------------------------------------------
  uint8_t cnsCnt=0, cnsADC=0, first=0, vAgoButton=0;        uint16_t vAgoADC;
//----------------------------------------------------------------------------------------------------
  void consoleHead();   //--Предопределение функции;

//+++++++++++++++++++++++++++++++++++++++++++++++++++++++++++++++++++++++++++++++++++++++++++++++++
//                                    I. Секция SETUP()
//+++++++++++++++++++++++++++++++++++++++++++++++++++++++++++++++++++++++++++++++++++++++++++++++++
void setup(){}
//+++++++++++++++++++++++++++++++++++++++++++++++++++++++++++++++++++++++++++++++++++++++++++++++++
//                                    II. Секция LOOP()
//+++++++++++++++++++++++++++++++++++++++++++++++++++++++++++++++++++++++++++++++++++++++++++++++++
void loop(){
//================================================================================================= 
//                                    1.БАЗОВЫЕ ФУНКЦИИ
//=================================================================================================  
//================================================================================================= 
//                                    1.1. Инициализация параметров
//=================================================================================================
  if(RT_HW_Base.isInit==0){
     RT_HW_Base.isInit=1;
     pinControl  =RT_HW_Base.vPinControl();  //--Установка пина Control;
     pinLed      =RT_HW_Base.vPinLed();      //--Установка пина Led;
     pinButton   =RT_HW_Base.vPinButton();   //--Установка пина Кнопки;
     pinADC      =RT_HW_Base.vPinADC();      //--Установка пина ADC;   
     pinPWM      =RT_HW_Base.vPinPWM();      //--Установка пина PWM;
}
//================================================================================================= 
//                                    1.2. Диспетчер задач
//=================================================================================================
  RT_HW_Base.sheduler();  
//=================================================================================================
//                                    1.3. Вывод на контрольный пин
//=================================================================================================
#if defined(RT_HW_TEST_PERMIT_CONTROL) 
//RT_HW_Base.pinDigitalWrite(idPinControl,pinControl,RT_HW_Base.shed.control); //--Вывод  на пин;
#endif  
//================================================================================================= 
//                                    1.4. Вывод меандра на светодиод
//=================================================================================================
  if(RT_HW_Base.shed.frdm.num==1) {
    RT_HW_Base.pinDigitalWrite(idPinLed,pinLed,RT_HW_Base.shed.blink500);     //--Вывод  на пин;    
  }

//================================================================================================= 
//                                    1.5. Однократный вывод на консоль параметров проекта;
//=================================================================================================
  if(RT_HW_Base.shed.frdm.num==1){
#if defined(RT_HW_TEST_PERMIT_CNS_HEAD) 
     RT_HW_Base.consoleBegin();                   //--Инициализация консоли;
  if(RT_HW_Base.console.head){consoleHead();}     //--Однократный вывод отчета по MCU;
#endif  
}
//================================================================================================= 
//                                    1.6. Обработка секундных событий
//=================================================================================================
  if(RT_HW_Base.shed.eventSec){ 
     filterSpeed.filtered(RT_HW_Base.shed.cycle);     //--Фильтр кол-ва циклов в сек; 
     vspeedF0=round(((float)filterSpeed.vr)/1000);    //--Кол-во циклов в сек/1000 с фильтром CORE0;
     RT_HW_Base.unixIncTime();                        //--Инкремент текущего времени;
}

//================================================================================================= 
//                                    2.ПИНЫ НА ПЛАТЕ
//=================================================================================================
//================================================================================================= 
//                                    2.1. Чтение кнопки с защитой от дребезга
//=================================================================================================
  if(RT_HW_Base.shed.quick.num==1) {
     vButton=!RT_HW_Base.pinDigitalRead(idPinButton,pinButton,'U'); //--Чтение кнопки с подтяжкой пина к Vcc;
     vButtonF=filterButton.filtered(vButton,50);      //--Фильтр защиты от дребезга 50ms; 
}     
//================================================================================================= 
//                                    2.2. Чтение ADC с фильтром
//=================================================================================================    
   if(RT_HW_Base.shed.quick.num==2) {
      RT_HW_Base.pinAnalogRead(idPinADC, pinADC);     //--Чтение с пина ADC;      
      vADCF=filterADC.filtered(idPinADC.vNorm);       //--Фильтр медианный средний ADC;
}
//================================================================================================= 
//                                    2.3. Вывод на пин PWM
//=================================================================================================
  if(RT_HW_Base.shed.quick.num==2) {
     if(idPinPWM.dir==0){idPinPWM.channel=0; idPinPWM.freq=1000; idPinPWM.depth=16;}  //--Инициализация PWM, freq=1000Hz, mode output='N'(normal); depth bit=16;
     RT_HW_Base.pinPWM(idPinPWM, pinPWM, vADCF);  vPWM=idPinPWM.var;                   //--Запись в PWM;
}                  
//================================================================================================= 
//                                    3.0. ТЕСТОВЫЙ ВЫВОД на консоль переменных
//=================================================================================================
  if(RT_HW_Base.shed.fast.num==3) {
     if(cnsCnt++>100)          {cnsCnt=1;}
     if(vAgoButton!=vButtonF)  {cnsCnt=1;}
     if(++cnsADC>5){cnsADC=0; if(vAgoADC!=vADCF)     {cnsCnt=1;}}
     if(first==0)  {if(RT_HW_Base.shed.smallCycle>0) {first=1; cnsCnt=1;}}
     if(cnsCnt==1) 
     {
      if(RT_HW_Base.unixID.fresh){RT_HW_Base.unixID.fresh=0;
      RT_HW_Base.consoleCurrentDate(' ',1);
      }
      RT_HW_Base.consoleCurrentDate(' ',1);     
      RT_HW_Base.consoleCurrentTime(' ',1);
      vAgoButton=vButtonF; vAgoADC=vADCF; cnsADC=0;
      RT_HW_Base.consoleTest(String(F("Button")),(uint8_t)vButtonF,';');
      RT_HW_Base.consoleVar (String(F(" ADC=")));         RT_HW_Base.consoleVar(vADCF,';',5,'U');
      RT_HW_Base.consoleVar (String(F(" Speed/1000->"))); RT_HW_Base.consoleVar(vspeedF0, ';',5,'U');     
      RT_HW_Base.consoleTest(String(F(" motoSec")),       RT_HW_Base.shed.cntSec,'E');
     }   
}
}; //++++END loop() or loop1=======================================================================

//+++++++++++++++++++++++++++++++++++++++++++++++++++++++++++++++++++++++++++++++++++++++++++++++++
//                                    ВНЕШНИЕ ФУНКЦИИ
//+++++++++++++++++++++++++++++++++++++++++++++++++++++++++++++++++++++++++++++++++++++++++++++++++
//=================================================================================================
//                                  1. Функция: Вывод на консоль параметров контроллера
//=================================================================================================
void consoleHead(){
#if defined(RT_HW_TEST_PERMIT_CNS_HEAD)    //--Консоль.Разрешение вывода заголовков;
  RT_HW_Base.consoleHead(String(F("Тест Board_03_Simple_Console_v4.0")),'=');
  RT_HW_Base.unixSetSystemTimeDate(); 
  RT_HW_Base.unixSetSTAMP(); 
  RT_HW_Base.unixSetTotal();   
  RT_HW_Base.consoleHead(String(F("Основные параметры")));         RT_HW_Base.mess.modePin='T';  RT_HW_Base.consoleBoardGeneral();            
  RT_HW_Base.consoleHead(String(F("Дополнительные параметры")));   RT_HW_Base.mess.modePin='T';  RT_HW_Base.consoleBoardAdd();  
  RT_HW_Base.consoleHead(String(F("Разрешение устройств")));       RT_HW_Base.mess.modePin='T';  RT_HW_Base.consoleBoardDepth();
                                                                                                 RT_HW_Base.consoleBoardSpecific();                                                                                            
  RT_HW_Base.consoleHead(String(F("Параметры диспетчера задач")));                               RT_HW_Base.consoleShedulerParameters();
  RT_HW_Base.consoleHead(String(F("Доступные пины")));             RT_HW_Base.mess.modePin='A';  RT_HW_Base.consolePinsAll();    
  RT_HW_Base.consoleHead(String(F("Интерфейсы")));                 RT_HW_Base.mess.modePin='T';  RT_HW_Base.consoleInterface(); 
  RT_HW_Base.consoleHead(String(F("Системные,тестовые,cs пины"))); RT_HW_Base.mess.modePin='T';  
  RT_HW_Base.consolePinsSystem(); RT_HW_Base.consolePinsTest();    RT_HW_Base.consolePinsCS();     
#endif
//-------------------------------------------------------------------------------------------------   
 RT_HW_Base.consoleLine('+');  
};
//=================================================================================================


   
