//+++++++++++++++++++++++++++++++++++++++++++++++++++++++++++++++++++++++++++++++++++++++++++++++++ 
//                                  TEST Modbus Slave RTU (HardWare)
//     *** Пояснения по Modbus в Gmodbus.hpp
//-------------------------------------------------------------------------------------------------
//    1.1.Настройка параметров в т.ч. тестовые пины, которые могут быть изменены.
//    1.2.В каждом цикле loop() вызывается "Диспетчер задач".
//    1.3.Каждую секунду обрабатываюся секундные параметры - быстродействие проекта, время наработки).
//    2.1.Инициализируется консоль (в терминах Arduino IDE - монитор порта). 
//    2.2.После готовности консоли (проверка консоли особо критична для контроллеров с USB на кристалле - STM32,Raspberry Pi,ESP32-C3,S2,S3),
//        в монитор порта однократно выводяся отчет о проекте (пины, наличие коммуникаций и др.),
//        сканируется шина i2c (SDA,SCL необходимо подтянуть к Vcc резисторами 10-47к).
//    3.1.В каждом цикле loop() меняется значение на пине Control (для логического анализатора).
//    3.2.На пин Led выводится меандр 500ms.
//    4.1.Периодически читается пин ADC(period 100ms). Отфильтрованное значение ADC выводится на пин PWM.
//    4.2.Читается значение пина "Кнопка" с защитой от дребезга 50ms.
//    5.  Сенсоры через пины: DS1820,HC-SR04;
//    6.  Сенсоры через i2c:  AHTxx(T,H),SHT3x(T,H); 
//    7.  Расширитель выходов через SPI 74HC595 "Бегущая 1" ;
//    8.  Расширитель входов  через SPI 74HC165, чтение в переменную v74HC165;
//    10. Вывод на Lcd1.i2c(0x27)
//          Кнопка=0:  строка 1:Blink(*),ADC, Регистр Holding=40, ,Speed.
//                     строка 2:AHTxx.ok,AHTxx.Temp,AHTxx.Hum.  
//          Кнопка=1:  строка 1:Blink(#),DS1820.ok,DS1280.Temp,HC-SR04.ok,HC-SR04.Len;
//                     строка 2:SHT3x.ok,SHT3x.Temp,SHT3x.Hum. 
//    11.Устройства могут отключаться через комментирование(//) определений RT_HW_TEST_PERMIT_xxx.
//-------------------------------------------------------------------------------------------------
// ecoins@mail.ru 20.01.2024
//+++++++++++++++++++++++++++++++++++++++++++++++++++++++++++++++++++++++++++++++++++++++++++++++++
//                    0.Разрешения использования устройств
//+++++++++++++++++++++++++++++++++++++++++++++++++++++++++++++++++++++++++++++++++++++++++++++++++ 
  #define RT_HW_TEST_PERMIT_MB_MASTER_RTU //--Разрешение использования MasterRTU;
  #define RT_HW_TEST_PERMIT_MB_SLAVE_RTU  //--Разрешение использования MasterRTU;  
//-------------------------------------------------------------------------------------------------
  #define RT_HW_TEST_PERMIT_AHTx          //--Разрешение использования сенсора AHTx; 
  #define RT_HW_TEST_PERMIT_SHT3x         //--Разрешение использования сенсора SHT3x;
  #define RT_HW_TEST_PERMIT_BH1750        //--Разрешение использования сенсора BH1750;
  #define RT_HW_TEST_PERMIT_DS1820        //--Разрешение использования сенсора DS1820;
  #define RT_HW_TEST_PERMIT_SR04          //--Разрешение использования сенсора HC-SR04;
  #define RT_HW_TEST_PERMIT_74HC595       //--Разрешение использования расширителя 74HC595; 
  #define RT_HW_TEST_PERMIT_74HC165       //--Разрешение использования расширителя 74HC165;  
  #define RT_HW_TEST_PERMIT_ADS1115       //--Разрешение использования расширителя ADS1115(i2c);
//-------------------------------------------------------------------------------------------------    
  #define RT_HW_TEST_PERMIT_LCD1_i2c      //--Разрешение подключения дисплея Lcd1.i2c  16x2;
//=================================================================================================
//                    1.Подключение библиотек
//=================================================================================================
  #include "flprogModbusRTU.h"          //--Подключение библиотеки ModBus RTU (Включает #include RT_HW_BASE.h");
  #include "RT_HW_LCD44780.h"           //--Подключение библиотеки дисплеев типа HD44780;
  #include "RT_HW_SENSORS.h"            //--Подключение библиотек базовых сенсоров(DS1820,HC-SR04,AHTx,BH1750,SHT3x);
  #include "RT_HW_EXPANDERS.h"          //--Подключение библиотек базовых расширителей(ADS1115,74HC595,74HC165);
//=================================================================================================
//                    2.Подключение внутренних вкладок
//=================================================================================================
  #include "Asys.hpp"                   //--Системные объекты,параметры,функции; 
  #include "Cdevice.hpp"                //--Устройства(сенсоры, расширители);  
  #include "Lcd1.hpp"                   //--Подключение вкладки Lcd1(i2c) 16x2;         
//=================================================================================================

//=================================================================================================
//                                    I.Секция SETUP()
//=================================================================================================
void setup(){}
//=================================================================================================
//                                    II.Секция LOOP()
//=================================================================================================
void loop(){
//================================================================================================= 
//                     2.1.Инициализация параметров и диспетчер
//================================================================================================= 
  initProject();                                //--Инициализация параметров;
  RT_HW_Base.sheduler(shed);                    //--Диспетчер задач(CORE0);
//================================================================================================= 
//                     2.2.Управление консолью
//=================================================================================================
if(shed.frdm.num==1){ 
  RT_HW_Base.consoleBegin();                    //--Инициализация консоли;
  if(RT_HW_Base.console.head){consoleHead();}   //--Однократный вывод отчета по MC;  
}
//================================================================================================= 
//                    2.3.Обработка секундных событий
//=================================================================================================
if(shed.eventSec){                              //--Обработка секундных событий:
  vSpeedMCU=shed.cycle;                         //  кол-во циклов в сек;
  vSpeedMCUF=FilterSpeed.filtered(vSpeedMCU);   //  кол-во циклов в сек с фильтром; 
  vSpeedSmall=round(((float)vSpeedMCUF)/1000);  //  кол-во циклов в сек с фильтром/1000;
  vMotorSec=shed.cntSec;                        //  кол-во секунд с начала работы программы;
  RT_HW_Base.unixID.timeUNIX++;                 //--Инкремент UNIX времени;
  RT_HW_Base.unixGetTotal();                    //--Получение времени,даты,дня недели;
} //--END if(shed.eventSec);
//================================================================================================= 
//                    2.4.Системные пины (console,Led,Button,ADC,флаги системные и устройств)
//=================================================================================================
  RT_HW_Base.pinDigitalWrite(idPinControl,pinControl,shed.control); //--Вывод цикла loop() на контрольный пин; 
  RT_HW_Base.pinDigitalWrite(idPinLed,    pinLed,    shed.blink500);//--Вывод меандра 500 ms на светодиод; 
  if(shed.quick.num==1) {fncButton();}                              //--Чтение кнопки с защитой от дребезга;
  if(shed.quick.num==2) {fncADC();}                                 //--Чтение ADC;  
  if(shed.frdm.num==4)  {fncSetStatus();}                           //--Установка флагов системных и устройств; 
  if(shed.slow.num==1)  {fncCounter();}                             //--Тестовый счетчик;
//================================================================================================= 
//                    2.5.Устройства (сенсоры,расширители)
//=================================================================================================
  if(shed.frdm.num==20){snsDS1820();}             //--pin.DS1820. При опросе задержка 4-6 ms;   
  if(shed.frdm.num==22){snsSR04();}               //--pin.HC-SR04(по прерываниям); 
  if(shed.frdm.num==24){snsAHTxx();}              //--i2c.AHTxx;
  if(shed.frdm.num==26){snsSHT3x();}              //--i2c.SHT3x;
  if(shed.frdm.num==28){snsBH1750();}             //--i2c.BH1750
  if(shed.frdm.num==30){expADS1115();}            //--i2c.Аналоговый ввод  с  ADS1115 (16-разрядный ADC, 4 канала);
  if(shed.frdm.num==32){exp74HC595();}            //--SPI.Дискретный вывод на 74HC595;  
  if(shed.frdm.num==34){exp74HC165();}            //--SPI.Дискретный ввод  с  74HC165; 
//=================================================================================================
//                   2.6.ДИСПЛЕИ
//=================================================================================================
  if(shed.frdm.num==40){Lcd1();}                 //--Output Lcd1(16x2,i2c,0x27);

//+++++++++++++++++++++++++++++++++++++++++++++++++++++++++++++++++++++++++++++++++++++++++++++++++ 
//                            3.Modbus
//+++++++++++++++++++++++++++++++++++++++++++++++++++++++++++++++++++++++++++++++++++++++++++++++++
  #include "MBmasterRTU.hpp"    //==Modbus Master RTU1;
  #include "MBslaveRTU.hpp"     //==Modbus Slave  RTU1;

//-------------------------------------------------------------------------------------------------
//  lastError = SlaveRTU1.getLastError();  //--Получение последней ошибки MB SlaveRTU1;
//
};    //--End loop();
