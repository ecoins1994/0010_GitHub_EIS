//+++++++++++++++++++++++++++++++++++++++++++++++++++++++++++++++++++++++++++++++++++++++++++++++++ 
//                                 Тест платы №04 v.5.0 23.02.2024  
//                              ТЕСТИРОВАНИЕ УСТРОЙСТВ С ВЫВОДОМ НА ДИСПЛЕИ Lcd
//                            (совместим с визуальной системой программирования FLProg)
//    1.1.Инициализация параметров в т.ч. тестовые пины, которые могут быть изменены.
//    1.2.В каждом цикле loop() вызывается "Диспетчер задач" и выполняется дискретный вывод на пины:
//            control - изменяется 0/1 в каждом цикле loop() для лог.анализатора),
//            Led на плате - меандр 500ms;
//    1.3.Инициализируется консоль (в терминах Arduino IDE - монитор порта). 
//        После готовности консоли (проверка консоли особо критична для контроллеров с USB на кристалле - STM32,Raspberry Pi,ESP32-C3,S2,S3),
//        в монитор порта однократно выводится отчет о проекте (пины, наличие коммуникаций и др.),
//        сканируется шина i2c (SDA,SCL необходимо подтянуть к Vcc резисторами 10-47к).
//    1.4.Каждую секунду обрабатываются секундные параметры - быстродействие проекта, время наработки).
//    2.1.Выполняется чтение пина "Кнопка"(период 50ms) с защитой от дребезга 50ms.
//    2.2.Выполняется чтение пина   ADC   (период 50ms) с фильтром медианным 5-го порядка;
//    2.3.Выполняется запись на пин PWM значение ADC;
//    3.1.Сенсоры через пины: DS1820,HC-SR04;
//    3.2.Сенсоры через i2c: AHTxx(T,H),SHT3x(T,H); 
//    4.1.Расширители через SPI: 74HC595 "Бегущая 1";
//    5.1.Вывод на Lcd1.i2c(0x27)
//          Кнопка=0:  строка 1:Blink(*),ADC,74HC165(HEX.2), быстродействие CORE0/1000, флаг CORE1(+), быстродействие CORE1/1000;
//                     строка 2:AHTxx.ok,AHTxx.Temp,AHTxx.Hum;  
//          Кнопка=1:  строка 1:Blink(#),DS1820.ok,DS1280.Temp,HC-SR04.ok,HC-SR04.Len;
//                     строка 2:SHT3x.ok,SHT3x.Temp,SHT3x.Hu;.  
//=================================================================================================
//    Подключение к выполнению различных устройств выполняется через снятие символов комментариев(//) 
//    с соответствующего макроса.
//-------------------------------------------------------------------------------------------------
// ecoins@mail.ru 28.01.2024
//+++++++++++++++++++++++++++++++++++++++++++++++++++++++++++++++++++++++++++++++++++++++++++++++++

//+++++++++++++++++++++++++++++++++++++++++++++++++++++++++++++++++++++++++++++++++++++++++++++++++
//                                    0. Секция DECLARE
//+++++++++++++++++++++++++++++++++++++++++++++++++++++++++++++++++++++++++++++++++++++++++++++++++
//=================================================================================================
//                      1. Разрешения использования пинов и устройств
//=================================================================================================  
  #define RT_HW_TEST_PERMIT_BUTTON      //--pin.Разрешение использования пина        Button; 
  #define RT_HW_TEST_PERMIT_ADC         //--pin.Разрешение использования пина        ADC;
  #define RT_HW_TEST_PERMIT_PWM         //--pin.Разрешение использования пина        PWM;      
  #define RT_HW_TEST_PERMIT_SR04        //--pin.Разрешение использования сенсора     SR04x;
  #define RT_HW_TEST_PERMIT_AHTx        //--i2c.Разрешение использования сенсора     AHTx(T,H); 
  #define RT_HW_TEST_PERMIT_MCP4725     //--i2c.Разрешение использования расширителя MCP4725(DAC);
  #define RT_HW_TEST_PERMIT_74HC595     //--SPI.Разрешение использования расширителя 74HC595;
  #define RT_HW_TEST_PERMIT_LCD1        //--i2c.Разрешение использования Lcd1 (16x);
  #define RT_HW_TEST_PERMIT_CNS_HEAD    //--Консоль.Разрешение вывода заголовков;
//=================================================================================================
//                                  2. Подключение библиотек
//=================================================================================================
  #include "RT_HW_BASE.h"               //--Подключение базовой библиотеки;
  #include "RT_HW_LCD44780.h"           //--Подключение библиотеки дисплеев типа HD44780;
  #include "RT_HW_SENSORS.h"            //--Подключение библиотек базовых сенсоров    (DS1820, HC-SR04,AHTx,   SHT3x,  BH1750,  BME/BMP,etc);
  #include "RT_HW_EXPANDERS.h"          //--Подключение библиотек базовых расширителей(MCP4725,ADS1115,74HC595,74HC165,MCP23x17,PCF8575,etc);
//=================================================================================================
//                            4.Подключение внутренних вкладок
//=================================================================================================
  #include "Asystem.hpp"                //--Пины; 
  #include "Bconsole.hpp"               //--Вывод на консоль; 
  #include "Csensor.hpp"                //--Сенсоры; 
  #include "Device.hpp"                 //--Расширители; 
  #include "Lcd1.hpp"                   //--Lcd1 16x2,i2c,0x27;       
//+++++++++++++++++++++++++++++++++++++++++++++++++++++++++++++++++++++++++++++++++++++++++++++++++
//                                    I. Секция SETUP()
//+++++++++++++++++++++++++++++++++++++++++++++++++++++++++++++++++++++++++++++++++++++++++++++++++
void setup(){}
//+++++++++++++++++++++++++++++++++++++++++++++++++++++++++++++++++++++++++++++++++++++++++++++++++
//                                    II. Секция LOOP()
//+++++++++++++++++++++++++++++++++++++++++++++++++++++++++++++++++++++++++++++++++++++++++++++++++
void loop(){
//================================================================================================= 
//                                    1.1. Инициализация параметров
//=================================================================================================
  fncInitParam();                                                              // [Asystem.hpp];
//================================================================================================= 
//                                    1.2. Диспетчер задач
//=================================================================================================
  RT_HW_Base.sheduler();                                                      //--Диспетчер;
//================================================================================================= 
//                                    1.3. Вывод на контрольный пин
//=================================================================================================
  #if defined(RT_HW_TEST_PERMIT_CONTROL)
    RT_HW_Base.pinDigitalWrite(idPinControl, pinControl, RT_HW_Base.shed.control); //--Вывод  на пин;
  #endif  
//================================================================================================= 
//                                    1.4. Вывод меандра на светодиод
//=================================================================================================
  if(RT_HW_Base.shed.frdm.num==1) {
    RT_HW_Base.pinDigitalWrite(idPinLed,pinLed, RT_HW_Base.shed.blink500);            //--Вывод  на пин;    
  }
//================================================================================================= 
//                                    1.5. Однократный вывод на консоль параметров проекта;
//=================================================================================================
  if(RT_HW_Base.shed.frdm.num==1){
    #if defined(RT_HW_TEST_PERMIT_CNS_HEAD) 
       RT_HW_Base.consoleBegin();                   //--Инициализация консоли;
    if(RT_HW_Base.console.head){consoleHead();}     //--Однократный вывод отчета по MCU;
    #endif  
  }
//================================================================================================= 
//                                    1.6. Обработка секундных событий
//=================================================================================================
  if(RT_HW_Base.shed.eventSec){                               //--Обработка секундных событий:
     vspeedMCUF0=round(((float)RT_HW_Base.shed.cycle)/1000);  //--Кол-во циклов в сек/1000 CORE0;  
     RT_HW_Base.unixIncTime();                                //--Инкремент текущего времени;
  }
//================================================================================================= 
//                                    1.7. Тестовые генераторы
//=================================================================================================


//================================================================================================= 
//                                    2. ПИНЫ Button,ADC,PWM
//=================================================================================================
  if(RT_HW_Base.shed.quick.num==1) {fncButton();}   //--Чтение кнопки с защитой от дребезга(50ms);    
  if(RT_HW_Base.shed.quick.num==2) {fncADC();}      //--Чтение с  пина ADC с усреднением фильтром медианным 5-го порядка;
  if(RT_HW_Base.shed.quick.num==3) {fncPWM();}      //--Запись на пин  PWM значения с ADC;
//================================================================================================= 
//                                   3. СЕНСОРЫ через пины
//=================================================================================================
  if(RT_HW_Base.shed.frdm.num==10) {snsSR04();}     //--pin.HC-SR04;   
//================================================================================================= 
//                                   4. СЕНСОРЫ через i2c
//=================================================================================================
  if(RT_HW_Base.shed.frdm.num==12) {snsAHTxx();}    //--i2c.AHTxx;
//================================================================================================= 
//                                   5. СЕНСОРЫ через SPI
//=================================================================================================
//                                                  //--Не задействованы;
//================================================================================================= 
//                                   6. РАСШИРИТЕЛИ через i2c
//=================================================================================================
  if(RT_HW_Base.shed.frdm.num==20) {genMCP4725(); expMCP4725();}   //--i2c.MCP4725; 
//================================================================================================= 
//                                   7. РАСШИРИТЕЛИ через SPI
//================================================================================================= 
  if(RT_HW_Base.shed.frdm.num==22) {gen74HC595(); exp74HC595();}   //--Вывод на 74HC595 (v74HC595_vr);   
//=================================================================================================
//                                   8. ДИСПЛЕИ
//=================================================================================================
  if(RT_HW_Base.shed.frdm.num==40) {Lcd1();}        //--Output Lcd1(16x2,i2c,0x27);
//-------------------------------------------------------------------------------------------------
}; //++++END loop() or loop1=======================================================================
