//+++++++++++++++++++++++++++++++++++++++++++++++++++++++++++++++++++++++++++++++++++++++++++++++++
//
//							1.Базовые функции обмена с аппаратным каналом коммуникаций
//								(пока только Serial[UART])
//
//+++++++++++++++++++++++++++++++++++++++++++++++++++++++++++++++++++++++++++++++++++++++++++++++++
//=================================================================================================
//								1.1. Настройка консоли
//  Последовательность установки флагов:
//  1.Сброс всех флагов;
//	2.Ожидание готовности;
//  3.run=head=1;
//  4.Событие;
//  5.head=0; ok=1;
//  6.Событие;
//	7.all=1;
//=================================================================================================
uint8_t consoleBegin()
{
#if defined(RT_HW_LINK_UART)
//-------------------------------------------------------------------------------------------------
//								1.1.1. "Пустой" вход в консоль 
//						(переходит в это состояние после настройки консоли)
//-------------------------------------------------------------------------------------------------
  if(console.dir==5) {return 1;}				
//-------------------------------------------------------------------------------------------------
//								1.1.2. Очистка/инициализация параметров  
//-------------------------------------------------------------------------------------------------
  if(console.dir==0) 
  {	
	console.run=console.ok=0;					//--Сброс run,ok;
	console.head=console.all=0; 				//--Сброс head,all;	
	messDefault();								//--Инициализация параметров для работы с сообщениями;
	console.dir++;  							//--Переход на следующий этап;
  }
//-------------------------------------------------------------------------------------------------
//								1.1.2. Очистка/инициализация параметров  
//-------------------------------------------------------------------------------------------------  
  if(console.dir==1)
  { 
	if(!uartBegin(console.numUart)){return 0;}	//--Ожидание настройки консоли;							  	
	console.dir++; 								//--Переход на следующий этап;  	 
  }			
//-------------------------------------------------------------------------------------------------
//								1.1.3. Ожидание готовности консоли  
//------------------------------------------------------------------------------------------------- 
  if(console.dir==2)
  {			
    if(uartSerial(console.numUart)==0){return 0;}//-Ожидание готовности;
    console.run=console.head=1;					//--Установка флагов: run(консоль запущена), head-событие для вывода на консоль заголовков;  
    consoleBlank(10);     consoleCR();			//--Очистка консоли(в Arduino IDE пока не удалось обнаружить функцию очистки консоли);	   
    console.dir++; 								//--Переход на следующий этап; 
	return 0;									//--Переход через return для форимирования события head;	
  }						 				
//-------------------------------------------------------------------------------------------------
   if(console.dir==3) 
   {
	console.head=0; console.ok=1; 
	console.dir++; 
	return 1;
   }
//-------------------------------------------------------------------------------------------------
   if(console.dir==4) 
   {							
    console.all=1;								//--Установка флага all; 
    console.dir=5;								//--Переход на "Пустой вход в консоль";
   } 						
//-------------------------------------------------------------------------------------------------
   return console.ok;
#endif
};

//=================================================================================================
// 								1.2.Запись байта(кода символа)
// 								[применен patch for RP2040!!!]
//=================================================================================================
uint8_t consoleWrite(uint8_t v){
#if defined(RT_HW_LINK_UART)
//-------------------------------------------------------------------------------------------------
#if defined(RT_HW_CORE_RP2040)
  if(console.run & Serial){Serial.print(char(v)); return 1;}
#else
  if(console.run)  {uartWrite(v,console.numUart); return 1;} 	
#endif
//-------------------------------------------------------------------------------------------------
#endif		//--END if defined(RT_HW_PERMIT_UART)
return 0;}


//+++++++++++++++++++++++++++++++++++++++++++++++++++++++++++++++++++++++++++++++++++++++++++++++++
//
//							2.Функции проверки состояния консоли
//
//+++++++++++++++++++++++++++++++++++++++++++++++++++++++++++++++++++++++++++++++++++++++++++++++++
//=================================================================================================
//								2.1.Получение состояния Ok(готовность консоли)
//=================================================================================================
uint8_t consoleOk()
{
#if defined(RT_HW_LINK_UART)
//-------------------------------------------------------------------------------------------------
  if(!console.run){consoleBegin();}
//-------------------------------------------------------------------------------------------------
#if defined(RT_HW_CORE_RP2040)
  if(console.ok & Serial){return 1;}
//-------------------------------------------------------------------------------------------------
#else
  if(console.ok)         {return 1;} 
#endif
//-------------------------------------------------------------------------------------------------
#endif
  return 0;
};

//=================================================================================================
//								2.2.Получение состояния Head(событие для вывода заголовка проекта)
//=================================================================================================
uint8_t consoleHead()
{
#if defined(RT_HW_LINK_UART)
//-------------------------------------------------------------------------------------------------	
  if(!console.run){consoleBegin();}
//-------------------------------------------------------------------------------------------------
#if defined(RT_HW_CORE_RP2040)
  if(console.head & Serial){return 1;} 
//-------------------------------------------------------------------------------------------------
#else
  if(console.head)         {return 1;} 
#endif
//-------------------------------------------------------------------------------------------------
#endif
  return 0;
};
//=================================================================================================
//								2.3.Получение состояния Head(событие для вывода заголовка проекта)
//=================================================================================================
uint8_t consoleRun(){
#if defined(RT_HW_LINK_UART)
//-------------------------------------------------------------------------------------------------
  if(!console.run){consoleBegin();}
//-------------------------------------------------------------------------------------------------
#if defined(RT_HW_CORE_RP2040)
  if(console.run & Serial){return 1;} 
//-------------------------------------------------------------------------------------------------
#else
  if(console.run)         {return 1;} 
#endif
//-------------------------------------------------------------------------------------------------
#endif
  return 0;
};


//+++++++++++++++++++++++++++++++++++++++++++++++++++++++++++++++++++++++++++++++++++++++++++++++++
//
//											3.Базовые стандартные функции вывода
// Суффикс(suff): '~'-не выводится, G-пробел,  L-перевод строки, E-';'+перевод строки, 
//                 S-вывод ';',     V-вывод',' или вывод любого иного символа;	
//
//+++++++++++++++++++++++++++++++++++++++++++++++++++++++++++++++++++++++++++++++++++++++++++++++++
//=================================================================================================
//								3.1.Вывод суффикса
//=================================================================================================
void consoleSuff(char suff)
{
  if(consoleRun())
  {
	 messSuff(mess,suff); 
	 if(mess.lenSuff){consoleWrite(mess.suff);} 
	 if(mess.lenCR){consoleWrite('\n');}
  }
};
//=================================================================================================
//								3.2.Вывод символа с суффиксом
//=================================================================================================
void consoleChar(char v=' ', char suff='~')
{
  if(consoleRun())
  {
	 consoleWrite(v); 
	 consoleSuff(suff);		//---Вывод символа с суффиксом [~,G,L,E,S,V или любой другой символ];
  }
 };																	
//=================================================================================================
//								3.3.Вывод qnt переводов строки
//=================================================================================================
void consoleCR(uint8_t qnt=1)
{
  if(consoleRun())
  {
	 for(console.idx=0; console.idx<qnt; console.idx++){consoleWrite('\n');}
  }
};									//++++Вывод нескольких переводoв строки;
//=================================================================================================
//								3.4.Вывод qnt заполнителей(пробелов)
//=================================================================================================
void consoleBlank(uint8_t qnt)   
{
  if(consoleRun())
  {
	 for(console.idx=0; console.idx<qnt; console.idx++){consoleWrite((uint8_t)(mess.blank));}
  }
};				
//=================================================================================================
//								3.5.Вывод qnt заполнителей char=v
//=================================================================================================
void consoleBlank(char v, uint8_t qnt)
{
  if(consoleRun())
  {
	for(console.idx=0; console.idx<qnt; console.idx++){consoleWrite((uint8_t)v);};
  }
};								 															//++++Вывод sz заполнителей=v с суффиксом; 
//=================================================================================================
//								3.6.Вывод линии с char=v длиной qnt в конце перевод строки
//=================================================================================================
void consoleLine(char v='=', uint8_t qnt=80)
{
	if(consoleRun())
	{
		for(console.idx=0; console.idx<qnt; console.idx++){consoleWrite((uint8_t)v);} 
		consoleWrite('\n');
	}
}; 						   
//=================================================================================================
