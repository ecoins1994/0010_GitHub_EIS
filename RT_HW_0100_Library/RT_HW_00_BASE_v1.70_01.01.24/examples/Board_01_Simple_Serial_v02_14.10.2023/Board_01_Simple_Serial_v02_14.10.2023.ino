//+++++++++++++++++++++++++++++++++++++++++++++++++++++++++++++++++++++++++++++++++++++++++++++++++ 
//                                  BASIC TEST №01 ver.3 14.10.2023  
//                  (совместим с визуальной системой программирования FLProg)
// Используются только стандартные функции Arduino IDE.
// Тест предназначен для тестирования программной совместимости новых типов контроолеров и их отладки.
//================================================================================================
// 1.1.Настраиваются параметры, в т.ч. тестовые пины из параметров контроллера, которые могут быть изменены.
// 1.2.В каждом цикле цикла() выполняется «Диспетчер задач».
// 1.3.Каждую секунду подсчитывается производительность проекта.
// 2.1.Консоль инициализируется (после инициализации время на выполнение не тратится).
// 2.2.После готовности консоли один раз отображается заголовок с параметрами контроллера,
//     включая сканирование шины i2c. 
//     ВНИМАНИЕ: Если на шине i2c до Vcc нет подтягивающих резисторов или устройства i2c, 
//               возможно зависание программы из-за осообенностей реализации стандартной библиотеки Wire.h.
// 3.1.В каждом цикле loop() меняется значение на пине Control(для логического анализатора).
// 3.2.Выводится меандр на пин Led длительность 500ms/250ms в зависимости от значения на пин button (0/1).
// 4.1.На консоли (мониторе порта) отображается время работы (сек) и значения АЦП (1 раз в секунду),
//     название платы, скорость, номера пинов (1 раз в 5 секунд);
//-------------------------------------------------------------------------------------------------
//    Перечень поддерживаемых плат размещен во вкладке Readme.hpp.
//    Там же размещены инструкции по настройке Arduino IDE, 
//    для ESP32 дополнительная инструкция для достижения большего удобства.
//-------------------------------------------------------------------------------------------------
// ecoins@mail.ru 14.10.23
//+++++++++++++++++++++++++++++++++++++++++++++++++++++++++++++++++++++++++++++++++++++++++++++++++
//=================================================================================================
//                                Подключение библиотек
//=================================================================================================
  #include "RT_HW_BASE.h"               //--Базовая библиотека;
//=================================================================================================
//                                Определение управляющих макросов
//=================================================================================================
#define  RT_HW_TEST_PERMIT_PINS       	//--Для блокирования работы с пинами данную строку следует закомментировать;
//=================================================================================================
//                                Определение тестовых переменных;
//=================================================================================================
uint8_t vInit=0;                      	//--Флаг иниицализации параметров;
uint8_t debugCnt=0;                   	//--Тестовый счетчик;
uint8_t pinControl;                   	//--пин control;
uint8_t pinLed;                       	//--пин Led on Board;                   
uint8_t pinButton; uint8_t vButton=0; 	//--пин Button on Board;        
RT_HW_PIN_ADC_ID   idPinADC; uint8_t pinADC; uint16_t vADC;     	//--пин ADC;
RT_HW_STRUCT_SHED  shed;                //--Объект для диспетчера задач;  
//-------------------------------------------------------------------------------------------------

//=================================================================================================
//                                    Секция SETUP()
//=================================================================================================
void setup(){}
//=================================================================================================
//                                    Секция LOOP()
//=================================================================================================
void loop(){
//=================================================================================================
//									            1.Установка системных параметров и настройку Serial.
//=================================================================================================
if(!vInit){vInit=1;  Serial.begin(115200);
pinControl    =RT_HW_Base.device.pin.control;   //--Установка значения пина Control;
pinLed        =RT_HW_Base.device.pin.led;       //--Установка значения пина Led on Board;
pinButton     =RT_HW_Base.device.pin.button;    //--Установка значения пина Button;
pinADC        =RT_HW_Base.device.pin.adc;       //--Установка значения пина ADC;  
#if defined(RT_HW_TEST_PERMIT_PINS)             //--Проверка разрешения работы с пинами;
  if(pinControl!=255){pinMode(pinControl,OUTPUT);}
  if(pinLed!=255)    {pinMode(pinLed,OUTPUT);}
  if(pinButton!=255) {pinMode(pinButton,INPUT_PULLUP);}
#endif  
} 
//-------------------------------------------------------------------------------------------------
RT_HW_Base.sheduler(shed);                      //--Диспетчер задач(CORE0);
//=================================================================================================
//						                2.Работа с пинами
//=================================================================================================
#if defined(RT_HW_TEST_PERMIT_PINS)             //--Проверка разрешения работы с пинами;
//-------------------------------------------------------------------------------------------------
  if(pinControl!=255){digitalWrite(pinControl,shed.control);}        //--вывод на пин Control; 
//-------------------------------------------------------------------------------------------------
  if(shed.frdm.num==1){                                              //--Вывод на Led;
   if(pinLed!=255){if(vButton){digitalWrite(pinLed,shed.blink250);}  //--Вывод меандра 250ms; 
                   else       {digitalWrite(pinLed,shed.blink500);}}}//  или 	меандра 500ms; 
//-------------------------------------------------------------------------------------------------
  if(shed.frdm.num==5){if(pinButton!=255){vButton=!digitalRead(pinButton);}} //--Чтение пина button;
//-------------------------------------------------------------------------------------------------
  if(shed.quick.num==5){RT_HW_Base.pinAnalogRead(idPinADC,pinADC);  vADC=idPinADC.vPin;} //--Чтение ADC в единицах ADC;    
//-------------------------------------------------------------------------------------------------
#endif  //---END if  defined(RT_HW_TEST_PERMIT_PINS)
//=================================================================================================
//								          3.Периодический вывод на консоль
//=================================================================================================
if(shed.slow.num==1) {if(Serial){
  if(!debugCnt){Serial.print(String(F("IDE->")));    Serial.print(String(F(RT_HW_BOARD_NAME)));   //--Вывод имени контроллера из Arduino IDE board;
                Serial.print(String(F("; Base->"))); Serial.print(String(F(RT_HW_BOARD_SELECT))); //--Вывод имени контроллера из RT_HW_BASE.h;
                Serial.print(String(F("; Speed="))); Serial.print(shed.cycle);                    //--Вывод быстродействия контроллера в циклах loop()/сек;
                Serial.println(';');
                Serial.print(String(F("pins-> control,Led,Button,ADC=")));                        //--Вывод заголовков для пинов; 
                Serial.print(pinControl); Serial.print(',');                                      //--Вывод номера пина Control;
                Serial.print(pinLed);     Serial.print(',');                                      //--Вывод номера пина Led on Board;
                Serial.print(pinButton);  Serial.print(',');                                      //--Вывод номера пина Button on Board;
                Serial.print(pinADC);     Serial.println(';');                                    //--Вывод номера пина ADC;           
                }    
                Serial.print(String(F("Time=")));  Serial.print(shed.cntSec);                     //--Вывод мотосекунд; 
                Serial.print(String(F("; ADC="))); Serial.print(vADC);        			              //--Вывод значение ADC в единицах ADC (зависят от контроллера);
                Serial.println(';');
  if(++debugCnt>=5){debugCnt=0;}}
}
//=================================================================================================
}; //++++END loop()================================================================================
//=================================================================================================   
