//==================================================================================================
//          Параметры времени из часов Nextion (для моделей K,P)
//==================================================================================================
nYear=rtc0    	//--Год 
nYear2=rtc0%100	//--Выделение двух младших разрядов года
nMonth=rtc1		//--
nDay=rtc2		//--
nHour=rtc3		//--
nMin=rtc4		//
nSec=rtc5		//
nWeek=rtc6		//
//vPage=dp

//==================================================================================================
//               Формирование параметров платы для txtBoard.txt
//==================================================================================================
txtBoard.txt="Core0:"
//-------------------------------------
covx mSP0,vSTR.txt,0,0
txtBoard.txt+=vSTR.txt+" Core1:"
//-------------------------------------
covx mSP1,vSTR.txt,0,0
txtBoard.txt+=vSTR.txt+" Sec:"
//-------------------------------------
covx mSW,vSTR.txt,0,0
txtBoard.txt+=vSTR.txt+" ID:"
//-------------------------------------
covx mID,vSTR.txt,0,0
txtBoard.txt+=vSTR.txt

//==================================================================================================
//               Формирование IP для поля txtIP.txt
//==================================================================================================
txtIP.txt="IP:"
sys0=mIP
//-------------------------------------
sys1=sys0 
sys1=sys1&0xFF
covx sys1,vSTR.txt,0,0
txtIP.txt+=vSTR.txt+"."
//-------------------------------------
sys1=sys0>>8 
sys1=sys1&0xFF
covx sys1,vSTR.txt,0,0
txtIP.txt+=vSTR.txt+"."
//-------------------------------------
sys1=sys0>>16
sys1=sys1&0xFF
covx sys1,vSTR.txt,0,0
txtIP.txt+=vSTR.txt+"."
//-------------------------------------
sys1=sys0>>24
sys1=sys1&0xFF
covx sys1,vSTR.txt,0,0
txtIP.txt+=vSTR.txt

//==================================================================================================
//               Формирование параметров платы для txtMac.txt
//==================================================================================================
txtMAC.txt="MAC: "
sys0=mMAC1
//-------------------------------------
sys1=sys0>>16
sys1=sys1&0xFF
covx sys1,vSTR.txt,0,2   		//--Преобразование в HEX-формат
txtMAC.txt+=vSTR.txt+":"		
//-------------------------------------
sys1=sys0>>8
sys1=sys1&0xFF
covx sys1,vSTR.txt,0,2   		//--Преобразование в HEX-формат
txtMAC.txt+=vSTR.txt+":"		
//-------------------------------------
sys1=sys0
sys1=sys1&0xFF
covx sys1,vSTR.txt,0,2   		//--Преобразование в HEX-формат
txtMAC.txt+=vSTR.txt+":"		
//-------------------------------------
sys0=mMAC2
//-------------------------------------
sys1=sys0>>16
sys1=sys1&0xFF
covx sys1,vSTR.txt,0,2   		//--Преобразование в HEX-формат
txtMAC.txt+=vSTR.txt+":"		
//-------------------------------------
sys1=sys0>>8
sys1=sys1&0xFF
covx sys1,vSTR.txt,0,2   		//--Преобразование в HEX-формат
txtMAC.txt+=vSTR.txt+":"		
//-------------------------------------
sys1=sys0
sys1=sys1&0xFF
covx sys1,vSTR.txt,0,2   		//--Преобразование в HEX-формат
txtMAC.txt+=vSTR.txt		
//-------------------------------------


//==================================================================================================
//               Формирование DS1820 для txtDS1820.txt
//==================================================================================================
sys0=nDev>>1
sys0&=1
if(sys0==1)
{
txtDS1820.txt="+"
txtDS1820.bco=nDevOk
}else
{
txtDS1820.txt="-"
txtDS1820.bco=nDevNo
}
txtDS1820.txt+="DS1820 T="
sys0=nDS1820
covx sys0,vSTR.txt,0,1   		//--Преобразование в float-формат
txtDS1820.txt+=vSTR.txt
//--------------------------------------------------------------------------------------------------	








//==================================================================================================
//               Формирование даты     для поля txtData.txt
//==================================================================================================
cov    nDay,  vSTR.txt,2
txtData.txt  =vSTR.txt+"."
cov    nMonth,vSTR.txt,2
txtData.txt +=vSTR.txt+"."
cov    nYear, vSTR.txt,4
txtData.txt +=vSTR.txt
//==================================================================================================
//               Формирование времени для поля txtTime.txt
//==================================================================================================
cov     nHour,vSTR.txt,2
txtTime.txt  =vSTR.txt+"."
cov     nMin, vSTR.txt,2
txtTime.txt +=vSTR.txt+"."
cov     nSec, vSTR.txt,2
txtTime.txt +=vSTR.txt
//==================================================================================================
//               Формирование времени для поля txtWeek.txt
//==================================================================================================
sys0=nWeek
txtWeek.txt="день"
if(sys0==0)
{
  txtWeek.txt="Воскресение"
}
if(sys0==1)
{
  txtWeek.txt="Понедельник"
}
if(sys0==2)
{
  txtWeek.txt="Вторник"
}
if(sys0==3)
{
  txtWeek.txt="Среда"
}
if(sys0==4)
{
  txtWeek.txt="Четверг"
}
if(sys0==5)
{
  txtWeek.txt="Пятница"
}
if(sys0==6)
{
  txtWeek.txt="Суббота"
}




//----------------------------------------------------------------------------------------------------
//                           Отправка времени в MCU
//----------------------------------------------------------------------------------------------------
//head=0x3A           //--Заголовок
//func=0x56            //--Отправка нескольких регистров байтовых регистров
//adr=1                    //--Адрес первого отправляемого регистра
//qntReg=7            //--Кол-во отправляемых регистров
//qntByte=7           //--Кол-во отправляемых байт
//-----Расчет контрольной суммы------------------------------------------------------------
//crc=head
//crc+=func
//crc+=adr
//crc+=qntReg
//crc+=qntByte
//crc+=vYear
//crc+=vMonth
//crc+=vDay
//crc+=vHour
//crc+=vMin
//crc+=vSec
//crc+=vWeek
//crc=crc&0xFF
//crc=0xFF-crc
//crc+=1
//crc&=0xFF
//-------------------------------------------------------------------------------------------------------------------
//prints head,1
//prints func,1
//prints adr,1
//prints qntReg,1
//prints qntByte,1
//prints vYear,1
//prints vMonth,1
//prints vDay,1
//prints vHour,1
//prints vMin,1
//prints vSec,1
//prints vWeek,1
//prints crc,1
//printh FF FF FF
//=================================================================
