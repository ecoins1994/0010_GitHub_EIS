//=====================================================
//            УПРАВЛЕНИE  ВРЕМЕНЕМ (только для N extion K,P)
//======================================================
vYear=rtc0%100    //--Выделение двух младших разрядов года
vMonth=rtc1
vDay=rtc2
vHour=rtc3
vMin=rtc4
vSec=rtc5
vWeek=rtc6
//vPage=dp
//---------------------------------------------------------------------------------------------------------------
//                      Формированиие времени и даты для вывода на страницу
// vSTR - переменная на странице, определенная на странице компонетом Variable;
// txtWeek- поле, определенное компонентом Text с параметрами: txt_maxl=15;
// txtData - поле, определенное компонентом Text с параметрами: txt_maxl=10;
// txtTime - поле, определенное компонентом Text с параметрами: txt_maxl=10.
//---------------------------------------------------------------------------------------------------------------
//-------------------------------------------------------------------
//               Формирование даты     для поля txtData.txt
//-------------------------------------------------------------------
cov    vDay,  vSTR.txt,2
txtData.txt  =vSTR.txt+"."
cov    vMonth,vSTR.txt,2
txtData.txt +=vSTR.txt+"."
cov    vYear, vSTR.txt,4
txtData.txt +=vSTR.txt
//-------------------------------------------------------------------
//               Формирование времени для поля txtTime.txt
//-------------------------------------------------------------------
cov     vHour,vSTR.txt,2
txtTime.txt  =vSTR.txt+"."
cov      vMin,vSTR.txt,2
txtTime.txt +=vSTR.txt+"."
cov vSec,     vSTR.txt,2
txtTime.txt +=vSTR.txt
//-------------------------------------------------------------------
//               Формирование времени для поля txtWeek.txt
//-------------------------------------------------------------------
sys0=vWeek
txtWeek.txt="день"
if(sys0==0)
{
  txtWeek.txt="Воскресение"
}
if(sys0==1)
{
  txtWeek.txt="Понедельник"
}
if(sys0==2)
{
  txtWeek.txt="Вторник"
}
if(sys0==3)
{
  txtWeek.txt="Среда"
}
if(sys0==4)
{
  txtWeek.txt="Четверг"
}
if(sys0==5)
{
  txtWeek.txt="Пятница"
}
if(sys0==6)
{
  txtWeek.txt="Суббота"
}
//----------------------------------------------------------------------------------------------------
//                           Отправка времени в MCU
//----------------------------------------------------------------------------------------------------
//head=0x3A           //--Заголовок
//func=0x56            //--Отправка нескольких регистров байтовых регистров
//adr=1                    //--Адрес первого отправляемого регистра
//qntReg=7            //--Кол-во отправляемых регистров
//qntByte=7           //--Кол-во отправляемых байт
//-----Расчет контрольной суммы------------------------------------------------------------
//crc=head
//crc+=func
//crc+=adr
//crc+=qntReg
//crc+=qntByte
//crc+=vYear
//crc+=vMonth
//crc+=vDay
//crc+=vHour
//crc+=vMin
//crc+=vSec
//crc+=vWeek
//crc=crc&0xFF
//crc=0xFF-crc
//crc+=1
//crc&=0xFF
//-------------------------------------------------------------------------------------------------------------------
//prints head,1
//prints func,1
//prints adr,1
//prints qntReg,1
//prints qntByte,1
//prints vYear,1
//prints vMonth,1
//prints vDay,1
//prints vHour,1
//prints vMin,1
//prints vSec,1
//prints vWeek,1
//prints crc,1
//printh FF FF FF
//=================================================================
