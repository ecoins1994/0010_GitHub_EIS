//+++++++++++++++++++++++++++++++++++++++++++++++++++++++++++++++++++++++++++++++++++++++++++++++++
//
//            					HTU21 (Sensor Temperatute, Humidity)
//
//+++++++++++++++++++++++++++++++++++++++++++++++++++++++++++++++++++++++++++++++++++++++++++++++++
//  ecoins (ecoins@mail.ru) 
//  21.05.2023: Begin version
//+++++++++++++++++++++++++++++++++++++++++++++++++++++++++++++++++++++++++++++++++++++++++++++++++
#ifndef RT_HW_HTU21_h
#define RT_HW_HTU21_h
#define RT_HW_HTU21_VER 	10		//--Library version number;
#include "RT_HW_BASE.h"				//--Connecting the base library;
//+++++++++++++++++++++++++++++++++++++++++++++++++++++++++++++++++++++++++++++++++++++++++++++++++
struct RT_HW_HTU21_DEV{
RT_HW_STRUCT_I2C_DEV dvI;
//-------------------------------------------------------------------------------------------------
char     mi='I';					//--0.Mode interface;
uint8_t  custom=0;					//--1.Setting option;	
uint8_t  status=0;					//--2.Status device: =0 no init; =1 Master.MCU->Slave.device; =2 Slave;
uint8_t  link=0;					//--3.Completed transaction flag;
uint8_t  codeErr=0;					//--4.Code error;
//--------------------------------------------------------------------------------------------------
uint8_t  dir;						//--5.Working  dir for direct();
uint8_t  step;						//--6.Working step for add function;
//-------------------------------------------------------------------------------------------------
uint8_t  cnt,cntErr;				//--8.Counters;
uint8_t  err:1,action:1;			//--9.Working flags;
//-------------------------------------------------------------------------------------------------
uint8_t  workDelay=0;				//--10.Working register; 
uint8_t  pointDelay;				//--11.Return point from a function;
uint16_t sizeDelay;					//--12.Size delay;	
uint32_t startDelay;		    	//--13.Working register;
//-------------------------------------------------------------------------------------------------
uint8_t  run=0,  runTemp,  runHum;	//--14.Command run;
uint8_t  ok=0,   okTemp,   okHum;	//--15.Device ok;
uint8_t  fresh=1,freshTemp,freshHum;//--16.Fresh data;
uint8_t  permitTemp=1,permitHum=1;	//--17.Permit parameteres;
//--------------------------------------------------------------------------------------------------
float    vTemp, vHum;				//--18.Measured values;		    		    
//-------------------------------------------------------------------------------------------------
uint8_t  bf8;						//--Buffer for reading byte;
uint8_t  arr[8];              		//--Buffer for temporary data storage
uint8_t  crc;						//--CRC8;
uint8_t  idx;						//--Index;
uint16_t raw;						//--Buffer;
uint32_t cmd=0x988000;				//--Polynomial 0x0131 = x^8 + x^5 + x^4 + 1;
uint32_t divisor;
uint32_t remainder;
//-------------------------------------------------------------------------------------------------
};
//+++++++++++++++++++++++++++++++++++++++++++++++++++++++++++++++++++++++++++++++++++++++++++++++++

//=================================================================================================
//                            		CLASS HTU21
//=================================================================================================
class RT_HW_HTU21{
public:
//=================================================================================================
//									1.Device management
//=================================================================================================
void direct(RT_HW_HTU21_DEV &id, uint8_t &runTemp, uint8_t &runHum){
//-------------------------------------------------------------------------------------------------
if(runTemp>0){                 id.run=1; id.runTemp=1; runTemp=5;}; 
if(runHum>0) {if(id.permitHum){id.run=1; id.runHum =1; runHum =5;}}; 
//-------------------------------------------------------------------------------------------------
//									1.0.Setting parameters
//-------------------------------------------------------------------------------------------------
if(id.dir==0){	
getParamDevice(id);
id.step=id.workDelay=0; id.ok=0; id.fresh=1; id.vTemp=0.1; id.vHum=0.2;
if(id.custom==0){return;} 								id.dir=10;} 
//-------------------------------------------------------------------------------------------------
//									1.10.Calling the init function
//-------------------------------------------------------------------------------------------------
if(id.dir==10){
if(!id.run){return;}
init(id);  
if(id.err){		id.pointDelay=0;	id.sizeDelay=1000; 	id.dir=200;  return;} 
if(!id.action){	id.step=0; 								id.dir=20;}}
//-------------------------------------------------------------------------------------------------
//									1.20.Waiting to run
//-------------------------------------------------------------------------------------------------
if(id.dir==20){
if(!id.run){return;} id.run=0; 							id.dir=30;}
//-------------------------------------------------------------------------------------------------
//									1.30.Calling the process(Temp) function
//-------------------------------------------------------------------------------------------------
if(id.dir==30){if(id.runTemp) {id.runTemp=0; id.step=0; id.dir=31;} else {id.dir=40;}}
//-------------------------------------------------------------------------------------------------
if(id.dir==31){
processTemp(id);	
if(id.err){		id.pointDelay=0;	id.sizeDelay=1000;	id.dir=200; return;} 
if(!id.action){	id.step=0; 								id.dir=40;  return;}}
//-------------------------------------------------------------------------------------------------
//									1.30.Calling the process(Hum) function
//-------------------------------------------------------------------------------------------------
if(id.dir==40){if(id.runHum && id.okTemp){id.runHum=0; id.step=0; id.dir=41;} else {id.dir=50;}}
//-------------------------------------------------------------------------------------------------
if(id.dir==41){
processHum(id);  
if(id.err){		id.pointDelay=0;	id.sizeDelay=1000;	id.dir=200; return;} 
if(!id.action){	id.step=0; 								id.dir=50;  return;}}
//-------------------------------------------------------------------------------------------------
if(id.dir==50){	id.dir=90;}
//-------------------------------------------------------------------------------------------------
//									1.90.End device management 
//-------------------------------------------------------------------------------------------------
if(id.dir==90){
if(id.okTemp)                  {id.ok=1;} else {id.ok=0;}
if(id.permitHum){if(id.okHum)  {id.ok=1;} else {id.ok=0;}}
if(id.freshTemp || id.freshHum){id.fresh=1;} else {id.fresh=0;} id.freshTemp=id.freshHum=0;
id.pointDelay=20; id.sizeDelay=50;id.dir=200; return;}
//-------------------------------------------------------------------------------------------------
//									1.200.Dynamic Delay
//-------------------------------------------------------------------------------------------------
if(id.dir==200){
if(!RT_HW_Base.timeDelay(id.startDelay,id.workDelay,id.sizeDelay)){return;} id.dir=id.pointDelay;}	
//-------------------------------------------------------------------------------------------------
};	//====END direct()=============================================================================

//=================================================================================================
//									2.Device initialization
//=================================================================================================
void init(RT_HW_HTU21_DEV &id){
//-------------------------------------------------------------------------------------------------
//									2.0.Setting parameters with continue after 50 ms	
//-------------------------------------------------------------------------------------------------
if(id.step==0){
id.cnt=id.cntErr=id.err=0; id.action=1; 
id.pointDelay=10; id.sizeDelay=50; id.step=200; return;}
//-------------------------------------------------------------------------------------------------
//									2.10.Device initialization	
//-------------------------------------------------------------------------------------------------
if(id.step==10) {	
xxxInitDevice(id);	if(!id.link)	{return;}
if(id.status!=1){id.err=1; id.step=0;return;} 
id.cnt=id.cntErr=0; 
if(id.mi=='I')  {id.step=20;} else {id.step=30;}}	
//-------------------------------------------------------------------------------------------------
//									2.20.Address search		
//-------------------------------------------------------------------------------------------------
if(id.step==20) {
xxxFindAdr(id);   	if(!id.link){return;}	
//-------------------------------------------------------------------------------------------------
if(id.codeErr){
id.cnt=0; id.cntErr++;
if(id.cntErr<=3){id.pointDelay=id.step;	id.sizeDelay=100+(250*id.cntErr); id.step=200; return;}	
if(id.cntErr==3){id.pointDelay=id.step; id.sizeDelay=2000; 				  id.step=200; return;}
				 id.codeErr=id.step;    id.err=1; 						  id.step=0;   return;}
//-------------------------------------------------------------------------------------------------
id.cnt++; id.cntErr=0;	
if(id.cnt<5){   id.pointDelay=id.step; 	id.sizeDelay=50;	id.step=200; return;}				
				id.pointDelay=30;	  	id.sizeDelay=10;	id.step=200; return;}						
//-------------------------------------------------------------------------------------------------
if(id.step==30){id.step=90;}
//-------------------------------------------------------------------------------------------------
//									2.90.End device init
//-------------------------------------------------------------------------------------------------
if(id.step==90){id.err=id.action=id.step=0; return;}	
//-------------------------------------------------------------------------------------------------
//									2.200.Dynamic Delay
//-------------------------------------------------------------------------------------------------
if(id.step==200){if(!RT_HW_Base.timeDelay(id.startDelay,id.workDelay,id.sizeDelay)){return;} id.step=id.pointDelay;}
};	//====END init()===============================================================================

//=================================================================================================
//									3.Device Process(Temp)
//=================================================================================================
void processTemp(RT_HW_HTU21_DEV &id){        
//-------------------------------------------------------------------------------------------------
//									3.0.Setting parameters with continue after 50 ms
//-------------------------------------------------------------------------------------------------
if(id.step==0) {	
id.cnt=id.cntErr=id.err=0; id.action=1; id.pointDelay=10; id.sizeDelay=50; id.step=200; return;}
//-------------------------------------------------------------------------------------------------
//									3.10.Sending a measurement command
//										[code TRIG_TMP_NOHOLD=0xF3]
//-------------------------------------------------------------------------------------------------
if(id.step==10){
xxxWrite(id,0xF3);	if(checkTransaction(id)){return;}	//--if link ok:: pointDelay=step; step=200; After 3fd error: err=1; step=0; return;
id.pointDelay=20; 	id.sizeDelay=50; 		 return;}	
//-------------------------------------------------------------------------------------------------
//									3.20.Getting measurement results.
//-------------------------------------------------------------------------------------------------
if(id.step==20){
xxxReadArr(id,3);	if(checkTransaction(id)){return;}
//-------------------------------------------------------------------------------------------------
id.crc=id.arr[2];
id.raw=((uint16_t)id.arr[0]<<8)|(uint16_t)id.arr[1]; 
//if(crc8(id.raw,id.crc)!=0){id.sizeDelay=40+(10*id.cntErr); id.cntErr++; if(id.cntErr>3){id.codeErr=44; id.err=1; id.step=0;} return;} 
id.raw&=0xFFFC;  id.vTemp= -46.85 + (175.72 * (id.raw/(float)65536));
id.pointDelay=50; 	id.sizeDelay=20;  		return;} 
//-------------------------------------------------------------------------------------------------
if(id.step==50){id.step=90;}
//-------------------------------------------------------------------------------------------------
//									3.90.End device process	
//-------------------------------------------------------------------------------------------------
if(id.step==90){id.freshTemp=id.okTemp=1; id.err=id.action=0; id.step=0; return;}
//-------------------------------------------------------------------------------------------------
//									3.200.Dynamic Delay
//-------------------------------------------------------------------------------------------------
if(id.step==200){if(!RT_HW_Base.timeDelay(id.startDelay,id.workDelay,id.sizeDelay)){return;} id.step=id.pointDelay;}
};	//====END processTemp()========================================================================

//=================================================================================================
//									4.Device Process(Hum)
//=================================================================================================
void processHum(RT_HW_HTU21_DEV &id){        
//-------------------------------------------------------------------------------------------------
//									4.0.Setting parameters with continue after 50 ms
//-------------------------------------------------------------------------------------------------
if(id.step==0) {	
id.cnt=id.cntErr=id.err=0; id.action=1; id.pointDelay=10; id.sizeDelay=50; id.step=200; return;}
//-------------------------------------------------------------------------------------------------
//									4.10. Sending a measurement command
//										[code TRIG_HUM_NOHOLD=0xF5]
//-------------------------------------------------------------------------------------------------
if(id.step==10){
xxxWrite(id,0xF5);	if(checkTransaction(id)){return;}	//--if link ok:: pointDelay=step; step=200; After 3fd error: err=1; step=0; return;
id.pointDelay=20; 	id.sizeDelay=50;         return;}	
//-------------------------------------------------------------------------------------------------
//									4.40.Getting measurement results
//-------------------------------------------------------------------------------------------------
if(id.step==20){
xxxReadArr(id,3);	if(checkTransaction(id)){return;}
//-------------------------------------------------------------------------------------------------
id.crc=id.arr[2];
id.raw=((uint16_t)id.arr[0]<<8)|(uint16_t)id.arr[1]; 
//if(crc8(id.raw,id.crc)!=0){id.sizeDelay=40+(10*id.cntErr); id.cntErr++; if(id.cntErr>3){id.codeErr=44; id.err=1; id.step=0;} return;} 
id.raw&=0xFFFC;  id.vHum=-6+(125*(id.raw/(float)65536));
id.pointDelay=30; 	id.sizeDelay=20;  		return;} 
//-------------------------------------------------------------------------------------------------
if(id.step==30){id.step=90;}
//-------------------------------------------------------------------------------------------------
//									4.90.End device process	
//-------------------------------------------------------------------------------------------------
if(id.step==90){id.freshHum=id.okHum=1; id.err=id.action=0; id.step=0; return;}
//-------------------------------------------------------------------------------------------------
//									4.200.Fixed Delay.
//-------------------------------------------------------------------------------------------------
if(id.step==200){if(!RT_HW_Base.timeDelay(id.startDelay,id.workDelay,id.sizeDelay)){return;} id.step=id.pointDelay;}
};	//====END meter()===============================================================================

//=================================================================================================
//									5.CRC8.
//=================================================================================================
uint8_t crc8(RT_HW_HTU21_DEV &id, uint16_t dataSensor, uint8_t crcSensor){
id.divisor=id.cmd;
id.remainder =(uint32_t)dataSensor << 8;
id.remainder|= crcSensor; 
for(id.idx=0; id.idx<16; id.idx++){if(id.remainder & (uint32_t)1<<(23-id.idx)) {id.remainder^=id.divisor; id.divisor>>=1;}}
return (uint8_t)id.remainder;
};	//++++END crc8()=============================================================================== 


//+++++++++++++++++++++++++++++++++++++++++++++++++++++++++++++++++++++++++++++++++++++++++++++++++
//
//									7.Device Link Functions.
//
//+++++++++++++++++++++++++++++++++++++++++++++++++++++++++++++++++++++++++++++++++++++++++++++++++
//=================================================================================================
//									7.0.Function error check.
//=================================================================================================
uint8_t checkTransaction(RT_HW_HTU21_DEV &id){
if(!id.link) {return 1;}
id.pointDelay=id.step; id.step=200;
if(id.codeErr!=0){id.sizeDelay=40+(10*id.cntErr); id.cntErr++; 
                  if(id.cntErr>3){id.codeErr=id.pointDelay; id.err=1; id.step=0;} 
				  return 1;}
id.cntErr=0; return 0;};
//=================================================================================================
//									7.1.Getting Interface Device Parameters
//=================================================================================================
void getParamDevice(RT_HW_HTU21_DEV &id){
if(id.mi=='I'){id.custom=id.dvI.custom; id.codeErr=id.dvI.codeErr; id.status=id.dvI.status; id.link=id.dvI.link; id.bf8=id.dvI.bf8; return;}
               id.custom=0;             id.codeErr=0;              id.status=0;             id.link=1;           id.bf8=0;          return;};
//=================================================================================================
//									7.3.Init Device.
//=================================================================================================
void xxxInitDevice(RT_HW_HTU21_DEV &id){
if(id.mi=='I'){RT_HW_Base.i2cInitDevice(id.dvI); 				getParamDevice(id); return;}		
getParamDevice(id);};
//=================================================================================================
//									7.2.Find address Device.
//=================================================================================================
void xxxFindAdr(RT_HW_HTU21_DEV &id){
if(id.mi=='I'){RT_HW_Base.i2cFindAdr(id.dvI); 					getParamDevice(id); return;}	
getParamDevice(id);};
//=================================================================================================
//									7.3.Wtite byte to register.
//=================================================================================================
void xxxWrite(RT_HW_HTU21_DEV &id, uint8_t var){	
if(id.mi=='I'){RT_HW_Base.i2cWrite(id.dvI,var); 	 				getParamDevice(id); return;}
getParamDevice(id);};
//=================================================================================================
//									7.11.Get bytes.
//=================================================================================================
void xxxReadArr(RT_HW_HTU21_DEV &id, uint8_t qnt){	
if(id.mi=='I'){RT_HW_Base.i2cReadArr(id.dvI,id.arr,qnt); 		getParamDevice(id); return;};
getParamDevice(id);};
//=================================================================================================
};		//++++END CLASS HTU21
extern RT_HW_HTU21 	RT_HW_htu21; 						//--Create an object RT_HW_htu21;
#endif
//=================================================================================================
