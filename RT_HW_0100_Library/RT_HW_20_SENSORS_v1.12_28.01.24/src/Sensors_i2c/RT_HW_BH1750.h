//+++++++++++++++++++++++++++++++++++++++++++++++++++++++++++++++++++++++++++++++++++++++++++++++++
//
//            					BH1750 (Lux meter)
//
//+++++++++++++++++++++++++++++++++++++++++++++++++++++++++++++++++++++++++++++++++++++++++++++++++
//  ecoins (ecoins@mail.ru) 
//  21.05.2023: Begin version
//+++++++++++++++++++++++++++++++++++++++++++++++++++++++++++++++++++++++++++++++++++++++++++++++++
#ifndef RT_HW_BH1750_h
#define RT_HW_BH1750_h
#define RT_HW_BH1750_VER 	10		//--Library version number;
#include "RT_HW_BASE.h"				//--Connecting the base library;
//+++++++++++++++++++++++++++++++++++++++++++++++++++++++++++++++++++++++++++++++++++++++++++++++++
struct RT_HW_BH1750_DEV{
RT_HW_STRUCT_I2C_DEV dvI;
//-------------------------------------------------------------------------------------------------
char     mi='I';				//--0.Mode interface;
uint8_t  custom=0;				//--1.Setting option;	
uint8_t  status=0;				//--2.Status device: =0 no init; =1 Master.MCU->Slave.device; =2 Slave;
uint8_t  link=0;				//--3.Completed transaction flag;
uint8_t  codeErr=0;				//--4.Code error;
//--------------------------------------------------------------------------------------------------
uint8_t  dir;					//--5.Working  dir for direct();
uint8_t  step;					//--6.Working step for add function;
//-------------------------------------------------------------------------------------------------
uint8_t  cnt,cntErr;			//--8.Counters;
uint8_t  err:1,action:1;		//--9.Working flags;
//-------------------------------------------------------------------------------------------------
uint8_t  workDelay=0;			//--10.Working register; 
uint8_t  pointDelay;			//--11.Return point from a function;
uint16_t sizeDelay;				//--12.Size delay;	
uint32_t startDelay;		    //--13.Working register;
//-------------------------------------------------------------------------------------------------	
uint8_t  run;					//--14.Command run;
uint8_t  ok;					//--15.Device ok;
uint8_t  fresh;					//--16.Fresh data; 
//-------------------------------------------------------------------------------------------------
uint16_t vLux;					//--Measured value;
//-------------------------------------------------------------------------------------------------
uint8_t  bf8;					//--Working buffer; 
uint8_t  arr[2];				//--Buffer;
//-------------------------------------------------------------------------------------------------lue;
};
//+++++++++++++++++++++++++++++++++++++++++++++++++++++++++++++++++++++++++++++++++++++++++++++++++



//=================================================================================================
//                            			CLASS BH1750x
//=================================================================================================
class RT_HW_BH1750{
public:
//=================================================================================================
//									1.Device management
//=================================================================================================
void direct(RT_HW_BH1750_DEV &id, uint8_t &run){
//-------------------------------------------------------------------------------------------------
if(run>0){id.run=1; run=5;}; 
//-------------------------------------------------------------------------------------------------
//									1.0.Setting parameters
//-------------------------------------------------------------------------------------------------
if(id.dir==0){	
getParamDevice(id);
id.step=id.workDelay=0; id.ok=0; id.fresh=1; id.vLux=15;
if(id.custom==0){return;} 								id.dir=10;} 
//-------------------------------------------------------------------------------------------------
//									1.10.Calling the init function
//-------------------------------------------------------------------------------------------------
if(id.dir==10){
if(!id.run){return;}
init(id);  
if(id.err){		id.pointDelay=0;	id.sizeDelay=1000; 	id.dir=200;  return;} 
if(!id.action){	id.step=0; 								id.dir=20;}}
//-------------------------------------------------------------------------------------------------
//									1.20.Waiting run.
//-------------------------------------------------------------------------------------------------
if(id.dir==20){
if(!id.run){return;} id.run=0; 							id.dir=30;}
//-------------------------------------------------------------------------------------------------
//									1.30.Call process device.
//-------------------------------------------------------------------------------------------------
if(id.dir==30){
process(id);  
if(id.err){		id.pointDelay=0;	id.sizeDelay=1000;	id.dir=200; return;} 
if(!id.action){	id.step=0; 								id.dir=40;  return;}}	
//-------------------------------------------------------------------------------------------------
if(id.dir==40){id.dir=90;}
//-------------------------------------------------------------------------------------------------
//									1.90.End device management 
//-------------------------------------------------------------------------------------------------
if(id.dir==90){
id.ok=1; id.fresh=1;
				id.pointDelay=20;	id.sizeDelay=50;  	id.dir=200; return;}
//-------------------------------------------------------------------------------------------------
//									1.200.Dynamic Delay
//-------------------------------------------------------------------------------------------------
if(id.dir==200){
if(!RT_HW_Base.timeDelay(id.startDelay,id.workDelay,id.sizeDelay)){ return;} id.dir=id.pointDelay;}	
//-------------------------------------------------------------------------------------------------
};	//====END direct()=============================================================================

//=================================================================================================
//									2.Device setup.
//===================================================================================================
void init(RT_HW_BH1750_DEV &id){
//-------------------------------------------------------------------------------------------------
//									2.0.Setting parameters with continue after 50 ms
//-------------------------------------------------------------------------------------------------
if(id.step==0){
id.cnt=id.cntErr=id.err=0; id.action=1; 
id.pointDelay=10; id.sizeDelay=50; id.step=200; return;}
//-------------------------------------------------------------------------------------------------
//									2.10.Initting device.	
//-------------------------------------------------------------------------------------------------
if(id.step==10) {	
xxxInitDevice(id);	if(!id.link)	{return;}
if(id.status!=1){id.err=1; id.step=0;return;} 
id.cnt=id.cntErr=0; 
if(id.mi=='I')  {id.step=20;} else {id.step=30;}}	
//-------------------------------------------------------------------------------------------------
//									2.20.Address search		
//-------------------------------------------------------------------------------------------------
if(id.step==20) {
xxxFindAdr(id);   	if(!id.link){return;}	
//-------------------------------------------------------------------------------------------------
if(id.codeErr){
id.cnt=0; id.cntErr++;
if(id.cntErr<=3){id.pointDelay=id.step;	id.sizeDelay=100+(250*id.cntErr); id.step=200; return;}	
if(id.cntErr==3){id.pointDelay=id.step; id.sizeDelay=2000; 				  id.step=200; return;}
				 id.codeErr=id.step;    id.err=1; 						  id.step=0;   return;}
//-------------------------------------------------------------------------------------------------
id.cnt++; id.cntErr=0;	
if(id.cnt<5){   id.pointDelay=id.step; 	id.sizeDelay=50;	id.step=200; return;}				
				id.pointDelay=30;	  	id.sizeDelay=10;	id.step=200; return;}		
//-------------------------------------------------------------------------------------------------
//									2.30.Power on [code=0x01]	
//-------------------------------------------------------------------------------------------------
if(id.step==30){
xxxWrite(id,0x01);	if(checkTransaction(id)){return;}	//--if link ok:: pointDelay=step; step=200; After 3fd error: err=1; step=0; return; 
id.pointDelay=40;	id.sizeDelay=10;         return;}
//-------------------------------------------------------------------------------------------------
if(id.step==40){id.step=90;}
//-------------------------------------------------------------------------------------------------
//									2.90.End device init
//-------------------------------------------------------------------------------------------------
if(id.step==90){id.err=id.action=id.step=0; return;}
//-------------------------------------------------------------------------------------------------
//									2.200.Fixed Delay
//-------------------------------------------------------------------------------------------------
if(id.step==200){if(!RT_HW_Base.timeDelay(id.startDelay,id.workDelay,id.sizeDelay)){return;} id.step=id.pointDelay;}
};	//====END init()===============================================================================

//=================================================================================================
//									3. Process device
//=================================================================================================
void process(RT_HW_BH1750_DEV &id){									 
//-------------------------------------------------------------------------------------------------
//									3.0.Setting parameters with continue after 50 ms
//-------------------------------------------------------------------------------------------------
if(id.step==0) {	
id.cnt=id.cntErr=id.err=0; id.action=1; id.pointDelay=10; id.sizeDelay=50; id.step=200; return;}
//-------------------------------------------------------------------------------------------------
//									3.10. Start measurement [code=0x10]
//-------------------------------------------------------------------------------------------------
if(id.step==10){
xxxWrite(id,0x10);	if(checkTransaction(id)){return;}	//--if link ok:: pointDelay=step; step=200; After 3fd error: err=1; step=0; return;
id.pointDelay=30; 	id.sizeDelay=20;  		 return;} 	 	
//-------------------------------------------------------------------------------------------------
//									3.30. Device status query [code=0x71]
//-------------------------------------------------------------------------------------------------
if(id.step==30){
xxxReadArr(id,2);	if(checkTransaction(id)){return;}	 	
//-------------------------------------------------------------------------------------------------
id.vLux=((uint16_t)(id.arr[0]<<8) | id.arr[1])/1.2; 
id.fresh=id.ok=1; id.codeErr=id.action=id.step=0;	
//-------------------------------------------------------------------------------------------------
id.pointDelay=40; 	id.sizeDelay=30;  		 return;} 
//-------------------------------------------------------------------------------------------------
if(id.step==40){id.step=90;}
//-------------------------------------------------------------------------------------------------
//									3.90.End device process
//-------------------------------------------------------------------------------------------------
if(id.step==90){id.err=id.action=id.step=0; return;}
//-------------------------------------------------------------------------------------------------
//									3.200.Dynamic Delay
//-------------------------------------------------------------------------------------------------
if(id.step==200){if(!RT_HW_Base.timeDelay(id.startDelay,id.workDelay,id.sizeDelay)){return;} id.step=id.pointDelay;}
};	//====END process()============================================================================	

//+++++++++++++++++++++++++++++++++++++++++++++++++++++++++++++++++++++++++++++++++++++++++++++++++
//
//									7.Device Link Functions.
//
//+++++++++++++++++++++++++++++++++++++++++++++++++++++++++++++++++++++++++++++++++++++++++++++++++
//=================================================================================================
//									7.0.Function error check.
//=================================================================================================
uint8_t checkTransaction(RT_HW_BH1750_DEV &id){
if(!id.link) {return 1;}
id.pointDelay=id.step; id.step=200;
if(id.codeErr!=0){id.sizeDelay=40+(10*id.cntErr); id.cntErr++; 
                  if(id.cntErr>3){id.codeErr=id.pointDelay; id.err=1; id.step=0;} 
				  return 1;}
id.cntErr=0; return 0;};
//=================================================================================================
//									7.1.Getting Interface Device Parameters
//=================================================================================================
void getParamDevice(RT_HW_BH1750_DEV &id){
if(id.mi=='I'){id.custom=id.dvI.custom; id.codeErr=id.dvI.codeErr; id.status=id.dvI.status; id.link=id.dvI.link; id.bf8=id.dvI.bf8; return;}
               id.custom=0;             id.codeErr=0;              id.status=0;             id.link=1;           id.bf8=0;          return;};
//=================================================================================================
//									7.3.Init Device.
//=================================================================================================
void xxxInitDevice(RT_HW_BH1750_DEV &id){
if(id.mi=='I'){RT_HW_Base.i2cInitDevice(id.dvI); 				getParamDevice(id); return;}		
getParamDevice(id);};
//=================================================================================================
//									7.2.Find address Device.
//=================================================================================================
void xxxFindAdr(RT_HW_BH1750_DEV &id){
if(id.mi=='I'){RT_HW_Base.i2cFindAdr(id.dvI); 					getParamDevice(id); return;}	
getParamDevice(id);};
//=================================================================================================
//									7.3.Wtite byte to register.
//=================================================================================================
void xxxWrite(RT_HW_BH1750_DEV &id, uint8_t var){	
if(id.mi=='I'){RT_HW_Base.i2cWrite(id.dvI,var); 	 			getParamDevice(id); return;}
getParamDevice(id);};
//=================================================================================================
//									7.11.Get bytes.
//=================================================================================================
void xxxReadArr(RT_HW_BH1750_DEV &id, uint8_t qnt){	
if(id.mi=='I'){RT_HW_Base.i2cReadArr(id.dvI,id.arr,qnt); 		getParamDevice(id); return;};
getParamDevice(id);};
//=================================================================================================
};	//++++END class RT_HW_BH1750===================================================================
extern RT_HW_BH1750 	RT_HW_bh1750; 						//--Create an object RT_HW_bh1750;
#endif
//=================================================================================================
