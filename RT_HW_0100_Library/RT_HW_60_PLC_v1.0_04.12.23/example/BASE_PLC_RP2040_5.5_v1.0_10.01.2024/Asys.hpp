//+++++++++++++++++++++++++++++++++++++++++++++++++++++++++++++++++++++++++++++++++++++++++++++++++
//                                    1.Системные параметры
//+++++++++++++++++++++++++++++++++++++++++++++++++++++++++++++++++++++++++++++++++++++++++++++++++
//=================================================================================================
//                                   1.1.Параметры для работы с диспетчером задач
//=================================================================================================
uint8_t isInit=0;                                                                 //--Состояние инициализации параметров;
//------------------------------------------------------------------------------------------------
RT_HW_STRUCT_SHED shed;  uint32_t vSpeedMCU=0;      uint16_t vSpeedSmall=0;       //--Диспетчер для ядра CORE 0;
RT_HW_FILTER_RING_AVERAGE<uint32_t,5> FilterSpeed;  uint32_t vSpeedMCUF;          //--Фильтр для быстройдествия CORE 0;
uint32_t vMotorSec=0;                                                             //--Мотосекунды;
//-------------------------------------------------------------------------------------------------
RT_HW_STRUCT_SHED shed1;  uint32_t vspeedMCU=0;     uint16_t vspeedSmall=0;       //--Диспетчер для ядра CORE 1 (RP2040);
RT_HW_FILTER_RING_AVERAGE<uint32_t,5> filterSpeed;  uint32_t vspeedMCUF;          //--Фильтр для быстройдествия CORE 1;
RT_HW_GENERATOR_EVENT_ID coreGen;  RT_HW_COUNTER_ID coreCnt; uint8_t vcoreOk=0; uint8_t  vcoreCnt;    //--Параметры для тестирования CORE 1;
//------------------------------------------------------------------------------------------------
uint32_t  flagSystem=0, flagDevice=0;                                                                  //--Флаги системные и устройств;
//------------------------------------------------------------------------------------------------
uint8_t   agoDir=255, agoStep=255, agoCodeErr=255; char sign; bool  blink;                             //--Рабочие регистры для отладки;
uint32_t  timeUNIX=0,timeUNIX_Ago=0;
uint8_t   timeHour,timeMin,timeSec,timeZone=3;
IPAddress ethIP{0,0,0,0};   //--IP адрес Ethernet;
uint8_t   ethServerCnt=0;   //--Кол-во соединений с WEB-сервером;
uint8_t   ethNtpCntTo=0,ettNtpCntFrom=0;   //--Кол-во соединений с NTP-сервером;
//-------------------------------------------------------------------------------------------------
RT_HW_GENERATOR_EVENT_ID genDAC;  RT_HW_COUNTER_ID cntDAC; uint16_t vDAC;
RT_HW_GENERATOR_EVENT_ID idGenDAC;    RT_HW_COUNTER_ID idCntDAC;      uint16_t vGenDAC=0;                //--For generator 0-4095 DAC;
//=================================================================================================
//                                   1.2.Системные пины
//=================================================================================================
                   
//-------------------------------------------------------------------------------------------------
uint8_t vButton=0;    //--Пин Кнопка, значение с кнопки;
uint8_t vChatBut=0;   //--Параметры для защиты кнопки от дребезга;
RT_HW_PIN_DIR_ID  idDOUT_0; uint8_t pinDOUT_0=2;
RT_HW_PIN_DIR_ID  idDOUT_1; uint8_t pinDOUT_1=3;
RT_HW_PIN_DIR_ID  idDOUT_2; uint8_t pinDOUT_2=24;
RT_HW_PIN_DIR_ID  idDOUT_3; uint8_t pinDOUT_3=23;
uint8_t pinDIN_0=10;
uint8_t pinDIN_1=11;
uint8_t pinDIN_2=28;
uint8_t pinDIN_3=29;

RT_HW_74HC595_DEV        dv595PLC;        RT_HW_STRUCT_SHED_TASK sh595PLC; 
//------------------------------------------------------------------------------------------------
RT_HW_GENERATOR_EVENT_ID idGenPLC;        RT_HW_COUNTER_ID       idCntPLC;   uint16_t vCntPLC=0;    uint16_t vGenPLC=0;   
RT_HW_GENERATOR_RUN_ID   idRunPLC;
//=================================================================================================
//                                   1.3.Параметры тестовых устройств через пины
//=================================================================================================
uint32_t pinDIN=0x55555555;   uint32_t pinDOT=0xAAAAAAAA;
//=================================================================================================
//                                   1.4.Параметры тестовых устройств через i2c
//=================================================================================================
uint8_t i2cAdrAHTxx=0x38;     uint8_t vAHTxx_ok;  float    vAHTxx_Temp,  vAHTxx_Hum; //--Сенсор AHTxx;
uint8_t i2cAdrMCP4725=0x60, i2cAdrMCP4725x=0x61; 
uint8_t i2cAdrMCP23017=0x21;  
uint8_t i2cAdrPCF8575=0x20;  
uint8_t i2cAdrADS1115=0x48;   uint8_t vADS1115_ok; float vADS1115_A0f,vADS1115_A1f,vADS1115_A2f,vADS1115_A3f;
//-------------------------------------------------------------------------------------------------
uint8_t i2cAdrSHT3x=0x44;     uint8_t vSHT3x_ok;  float    vSHT3x_Temp,  vSHT3x_Hum; 
uint8_t i2cAdrHTU21=0x40;     uint8_t vHTU21_ok;  float    vHTU21_Temp,  vHTU21_Hum;
uint8_t i2cAdrBME280=0x77;    uint8_t vBME280_ok; float    vBME280_Temp, vBME280_Hum, vBME280_Press;
uint8_t i2cAdrBMP180=0x77;    uint8_t vBMP180_ok; float    vBMP180_Temp, vBMP180_Press;
                              uint8_t vBMP_ok;    float    vBMP_Temp,    vBMP_Hum, vBMP_Press;
uint8_t i2cAdrBH1750=0x23;    uint8_t vBH1750ok;  uint16_t vBH1750Lux;
//=================================================================================================
//                                   1.5.Параметры тестовых устройств через SPI
//=================================================================================================
uint8_t cs74HC165=255;      //--[cs0];
uint8_t cs74HC595=255;      //--[cs1];
uint8_t csEthernet=255;     //--[cs2];
uint8_t csCAN=255;          //--[cs3];
uint8_t csTFT=255;          //--[cs4];
uint8_t csDM13C=255;        //--[cs5];
uint8_t csMAX6675=255;  uint8_t vMAX6675ok; float vMAX6675Temp; //--[cs5]       
uint8_t csDEV=255;          //--[cs5];
uint8_t cs595PLC=255;
//================================================================================================
//                                   1.6.Параметры тестовых дисплеев
//=================================================================================================
uint8_t i2cAdrLcd1=0x27;      uint8_t i2cAdrLcd2=0x3E;  uint8_t csLcdSPI=255;
uint8_t i2cAdrLcd6=0x26;
//=================================================================================================
//                                   1.7.Параметры тестовых UART
//=================================================================================================
uint8_t uartModbusMaster=255; 
uint8_t uartModbusSlave=255;   
uint8_t uartNextion=255;      uint8_t nxtPage=0; uint8_t nxtVr1,nxtVr2,nxtVr3,nxtVr4;
uint8_t uartWiFi=255;
//-------------------------------------------------------------------------------------------------
uint8_t vPCF8575inA=0, vPCF8575inB=0; uint8_t mcp23x17inA,mcp23x17inB;
//=================================================================================================
//                                   1.8.Параметры тестовые для ModBus
//=================================================================================================
uint16_t rg0=0,rg1=0,rg2=0,rg3=0,rg4=0,rg5=0,rg6=0,rg7=0;
uint16_t wg0=0,wg1=0,wg2=0,wg3=0,wg4=0,wg5=0,wg6=0,wg7=0;
//=================================================================================================

//+++++++++++++++++++++++++++++++++++++++++++++++++++++++++++++++++++++++++++++++++++++++++++++++++
//                                     2.СИСТЕМНЫЕ ФУНКЦИИ
//+++++++++++++++++++++++++++++++++++++++++++++++++++++++++++++++++++++++++++++++++++++++++++++++++
//=================================================================================================
//                                    2.1.Инициализация параметров
//=================================================================================================
void initProject(){
if(isInit==1){return;} isInit=1;
//-------------------------------------------------------------------------------------------------
shed.quick.qnt =5; shed.fast.qnt =4; shed.slow.qnt =4; shed.back.qnt=5;  shed.frdm.qnt =50;
shed1.quick.qnt=5; shed1.fast.qnt=4; shed1.slow.qnt=4; shed1.back.qnt=5; shed1.frdm.qnt=50;
RT_HW_Base.unixID.zone=3;                     //--Установка часового пояса(default=3);
//-------------------------------------------------------------------------------------------------
//                                    2.1.1. UART
//-------------------------------------------------------------------------------------------------
 uartModbusMaster=RT_HW_Base.device.uart.modbus1;
 uartModbusSlave =RT_HW_Base.device.uart.modbus2; 
 uartNextion     =RT_HW_Base.device.uart.nextion; 
 uartWiFi        =RT_HW_Base.device.uart.wifi;   
//-------------------------------------------------------------------------------------------------
//                                    2.1.5 Устройства через i2c
//-------------------------------------------------------------------------------------------------
i2cAdrLcd1    =0x27;                        //--Adress Lcd1;
i2cAdrLcd2    =0x3E;                        //--Adress Lcd2;
i2cAdrLcd6    =0x26;                        //--Adress Lcd6 ;
i2cAdrAHTxx   =0x38;                        //--Adress AHTXX;       
i2cAdrMCP4725 =0x60;                        //--Adress MCP4725;  
i2cAdrMCP4725x=0x61;                        //--Adress MCP4725; 
i2cAdrMCP23017=0x21;                        //--Adress MCP23017; 
i2cAdrPCF8575 =0x20;                        //--Adress PCF8575;   
i2cAdrADS1115 =0x48;                        //--Adress ADS1115; 
//-------------------------------------------------------------------------------------------------
//                                    2.1.6 Устройства через SPI
//-------------------------------------------------------------------------------------------------
cs74HC595   =RT_HW_Base.device.spi.cs0;     //--cs 74HC595; 
cs74HC165   =RT_HW_Base.device.spi.cs1;     //--cs 74HC165;
csEthernet  =RT_HW_Base.device.spi.cs2;     //--cs Ethernet W5x00;
csCAN       =RT_HW_Base.device.spi.cs3;     //--cs CAN;
csTFT       =RT_HW_Base.device.spi.cs4;     //--cs TFT;
}

//=================================================================================================
//                                     4.1. 74HC595PLC.SPI Ввывод бегущей '1'
//=================================================================================================

//-------------------------------------------------------------------------------------------------
#if defined(RT_HW_TEST_PERMIT_PLC_DOT)
//- - - - - - - - - - - - - - - - - - - - - - - - - - - - - - - - - - - - - - - - - - - - - - - - -
//================================================================================================
void expDotPLC(){   
//------------------------------------------------------------------------------------------------
if(idCntPLC.reset){RT_HW_Base.counterReset(idCntPLC,12,0,1,0);}      //--Инициализация счетчика: top=8, bottom=0, шаг изменения=1, начальное значение=0;
if(RT_HW_Base.generatorEvent(idGenPLC,200)) {
vCntPLC=RT_HW_Base.counterT(idCntPLC);  vGenPLC=RT_HW_Base.dc16(vCntPLC);}; //--Пилa, бегущая "1", 32 разряда;
//------------------------------------------------------------------------------------------------
  RT_HW_Base.pinDigitalWrite(idDOUT_0,pinDOUT_0,  vGenPLC    &1); //--Вывод цикла бита 0;
  RT_HW_Base.pinDigitalWrite(idDOUT_1,pinDOUT_1,((vGenPLC>>1)&1));//--Вывод цикла бита 1;
  RT_HW_Base.pinDigitalWrite(idDOUT_2,pinDOUT_2,((vGenPLC>>2)&1));//--Вывод цикла бита 2;
  RT_HW_Base.pinDigitalWrite(idDOUT_3,pinDOUT_3,((vGenPLC>>3)&1));//--Вывод цикла бита 3;  
//------------------------------------------------------------------------------------------------
if(dv595PLC.custom==0){dv595PLC.custom=RT_HW_Base.spiSetParam(dv595PLC.dvS,cs595PLC,0,4000000);
                       dv595PLC.mi='S'; dv595PLC.qnt=1;       //--Кол-во регистров 74HC595(1-4);
                       dv595PLC.bitOrder=0;                  //--Последовательность вывода: =1 - впереди старший бит;
                       RT_HW_Base.setTaskID(sh595PLC, 'Q',5); //--Вывод по изменениям с проверкой каждые 5 циклов программы; 
}
//-------------------------------------------------------------------------------------------------
RT_HW_Base.directTask(sh595PLC);
RT_HW_74hc595.direct(dv595PLC,(vGenPLC>>4),sh595PLC.run);};
#else
void expDotPLC(){;};
#endif
//=================================================================================================
//                                     4.1. 74HC165.SPI
//=================================================================================================
RT_HW_74HC165_DEV dv74HC165;    RT_HW_STRUCT_SHED_TASK sh74HC165;  uint32_t v74HC165,  ago74HC165;
//-------------------------------------------------------------------------------------------------
#ifdef RT_HW_TEST_PERMIT_74HC165
//- - - - - - - - - - - - - - - - - - - - - - - - - - - - - - - - - - - - - - - - - - - - - - - - -
void exp74HC165(){  
if(dv74HC165.custom==0){dv74HC165.custom=RT_HW_Base.spiSetParam(dv74HC165.dvS,cs74HC165,0,4000000);
                        dv74HC165.mi='S'; dv74HC165.qnt=1; dv74HC165.bitOrder=1;  //--qnt=Кол-во регистров 74HC595(1-4);
                        RT_HW_Base.setTaskID(sh74HC165,'P',500);                  //--Периодический вызов задачи: 'P';                      
                        }                  
//-------------------------------------------------------------------------------------------------
RT_HW_Base.directTask(sh74HC165); 
//-------------------------------------------------------------------------------------------------
RT_HW_74hc165.direct(dv74HC165,sh74HC165.run); 
if(dv74HC165.fresh) {dv74HC165.fresh=0;  v74HC165=dv74HC165.var;
//RT_HW_Base.consoleTest(String(F("74HC165 cs")),dv74HC165.dvS.cs,';','P');
//RT_HW_Base.consoleTest(String(F(" vr")),(uint16_t)v74HC165,'E','H');
};
}; //--END void exp74HC165()
#else
void exp74HC165(){;};
#endif



//=================================================================================================
//                                    2.6.Счетчик для тестирования DAC
//=================================================================================================
void fncDAC(){         
if(cntDAC.reset)                          {RT_HW_Base.counterReset (cntDAC,4095,0,20,0);} //--Инициализация счетчика: верхний предел, нижний предел, шаг изменения, начальное значение;
if(RT_HW_Base.generatorEvent(genDAC,100)) {vDAC=RT_HW_Base.counterT(cntDAC);};            //--Генератор "Треугольник",100 ms;
};
//=================================================================================================
//                                    2.7.Формирование вектора состояний устройств
//=================================================================================================
void fncSetStatus(){
//------------------------------------------------------------------------------------------------
bitWrite(flagSystem,1,shed.blink500);
bitWrite(flagSystem,2,vChatBut);
//------------------------------------------------------------------------------------------------
bitWrite(flagDevice,0,vAHTxx_ok);
bitWrite(flagDevice,1,vSHT3x_ok);
bitWrite(flagDevice,7,vBH1750ok);
bitWrite(flagDevice,8,vDS1820ok);
bitWrite(flagDevice,9,vSR04ok);
bitWrite(flagDevice,10,vMAX6675ok);
bitWrite(flagDevice,30,vADS1115_ok);
};
//=================================================================================================
//                                  2.8.Счетчик для тестирования CORE1
//=================================================================================================
void coreGenCnt(){         
if(coreCnt.reset){RT_HW_Base.counterReset(coreCnt,99,0,1,0);}  //--init counter: Upper limit, Down limit, Change step, Initial value;
if(RT_HW_Base.generatorEvent(coreGen,100)) {vcoreCnt=RT_HW_Base.counterS(coreCnt);}; //--Генератор "Треугольник",100 ms;
};
//=================================================================================================
