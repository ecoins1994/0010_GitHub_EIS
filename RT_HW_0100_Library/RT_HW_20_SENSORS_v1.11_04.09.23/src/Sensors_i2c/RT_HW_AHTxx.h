//+++++++++++++++++++++++++++++++++++++++++++++++++++++++++++++++++++++++++++++++++++++++++++++++++
//
//            					AHTXX (Sensor Temperatute, Humidity)
//
//+++++++++++++++++++++++++++++++++++++++++++++++++++++++++++++++++++++++++++++++++++++++++++++++++
//  ecoins (ecoins@mail.ru) 
//  21.05.2023: Begin version
//+++++++++++++++++++++++++++++++++++++++++++++++++++++++++++++++++++++++++++++++++++++++++++++++++
#ifndef RT_HW_AHTxx_h
#define RT_HW_AHTxx_h
#define RT_HW_AHTxx_VER 	10		//--Library version number;
#include "RT_HW_BASE.h"				//--Connecting the base library;
//+++++++++++++++++++++++++++++++++++++++++++++++++++++++++++++++++++++++++++++++++++++++++++++++++
struct RT_HW_AHTxx_DEV{
RT_HW_STRUCT_I2C_DEV dvI;
//-------------------------------------------------------------------------------------------------
char     mi='x';					//--0.Mode interface;
uint8_t  custom=0;					//--1.Setting option;	
uint8_t  status=0;					//--2.Status device: =0 no init; =1 Master.MCU->Slave.device; =2 Slave;
uint8_t  link=0;					//--3.Completed transaction flag;
uint8_t  codeErr=0;					//--4.Code error;
//--------------------------------------------------------------------------------------------------;
uint8_t  dir;						//--5.Working  dir for direct();
uint8_t  step;						//--6.Working step for add function;
//-------------------------------------------------------------------------------------------------
uint8_t  cnt,cntErr;				//--8.Counters;
uint8_t  err:1,action:1;			//--9.Working flags;
//-------------------------------------------------------------------------------------------------
uint8_t  workDelay=0;				//--10.Working register; 
uint8_t  pointDelay;				//--11.Return point from a function;
uint16_t sizeDelay;					//--12.Size delay;	
uint32_t startDelay;		    	//--13.Working register;
//-------------------------------------------------------------------------------------------------
uint8_t  run;						//--14.Command run;
uint8_t  ok;						//--15.Device ok;
uint8_t  fresh;						//--16.Fresh data;
//-------------------------------------------------------------------------------------------------
float    vTemp, vHum;				//--17.Measured values;
//-------------------------------------------------------------------------------------------------
uint8_t  bf8;						//--Buffer for reading byte;
uint8_t  arr[8];              		//--Buffer for temporary data storage
uint8_t  crc;						//--CRC8;
uint8_t  idx,idx1;					//--Index;
uint32_t temp;						//--Buffer;
//-------------------------------------------------------------------------------------------------
};
//+++++++++++++++++++++++++++++++++++++++++++++++++++++++++++++++++++++++++++++++++++++++++++++++++


//=================================================================================================
//                            		CLASS AHTxx
//=================================================================================================
class RT_HW_AHTxx{
public:
//=================================================================================================
//									1.Device management
//=================================================================================================
void direct(RT_HW_AHTxx_DEV &id, uint8_t &run){
//-------------------------------------------------------------------------------------------------
if(run>0){id.run=1; run=5;}; 
//-------------------------------------------------------------------------------------------------
//									1.0.Setting parameters
//-------------------------------------------------------------------------------------------------
if(id.dir==0){	
getParamDevice(id);
id.step=id.workDelay=0; id.ok=0; id.fresh=1; id.vTemp=0.1; id.vHum=0.2;
if(id.custom==0){return;} 								id.dir=10;} 
//-------------------------------------------------------------------------------------------------
//									1.10.Calling the init function
//-------------------------------------------------------------------------------------------------
if(id.dir==10){
if(!id.run){return;}
init(id);  
if(id.err){		id.pointDelay=0;	id.sizeDelay=1000; 	id.dir=200;  return;} 
if(!id.action){	id.step=0; 								id.dir=20;}}
//-------------------------------------------------------------------------------------------------
//									1.20.Waiting to run
//-------------------------------------------------------------------------------------------------
if(id.dir==20){
if(!id.run){return;} id.run=0; 							id.dir=30;}
//-------------------------------------------------------------------------------------------------
//									1.30.Calling the process function
//-------------------------------------------------------------------------------------------------
if(id.dir==30){
process(id);  
if(id.err){		id.pointDelay=0;	id.sizeDelay=1000;	id.dir=200; return;} 
if(!id.action){	id.step=0; 								id.dir=40;  return;}}	
//-------------------------------------------------------------------------------------------------
if(id.dir==40){											id.dir=90;}
//-------------------------------------------------------------------------------------------------
//									1.90.End device management 
//-------------------------------------------------------------------------------------------------
if(id.dir==90){
id.ok=1; id.fresh=1;
				id.pointDelay=20;	id.sizeDelay=50;  	id.dir=200; return;}
//-------------------------------------------------------------------------------------------------
//									1.200.Dynamic Delay
//-------------------------------------------------------------------------------------------------
if(id.dir==200){
if(!RT_HW_Base.timeDelay(id.startDelay,id.workDelay,id.sizeDelay)){ return;} id.dir=id.pointDelay;}	
//-------------------------------------------------------------------------------------------------
};	//====END direct()=============================================================================

//=================================================================================================
//									2.Device initialization
//=================================================================================================
void init(RT_HW_AHTxx_DEV &id){
//-------------------------------------------------------------------------------------------------
//									2.0.Setting parameters with continue after 50 ms	
//-------------------------------------------------------------------------------------------------
if(id.step==0){
id.cnt=id.cntErr=id.err=0; id.action=1; 
id.pointDelay=10; id.sizeDelay=50; id.step=200; return;}
//-------------------------------------------------------------------------------------------------
//									2.10.Device initialization	
//-------------------------------------------------------------------------------------------------
if(id.step==10) {	
xxxInitDevice(id);	if(!id.link)	{return;}
if(id.status!=1){id.err=1; id.step=0;return;} 
id.cnt=id.cntErr=0; 
if(id.mi=='I')  {id.step=20;} else {id.step=30;}}	
//-------------------------------------------------------------------------------------------------
//									2.20.Address search		
//-------------------------------------------------------------------------------------------------
if(id.step==20) {
xxxFindAdr(id);   	if(!id.link){return;}	
//-------------------------------------------------------------------------------------------------
if(id.codeErr){
id.cnt=0; id.cntErr++;
if(id.cntErr<=3){id.pointDelay=id.step;	id.sizeDelay=100+(250*id.cntErr); id.step=200; return;}	
if(id.cntErr==3){id.pointDelay=id.step; id.sizeDelay=2000; 				  id.step=200; return;}
				 id.codeErr=id.step;    id.err=1; 						  id.step=0;   return;}
//-------------------------------------------------------------------------------------------------
id.cnt++; id.cntErr=0;	
if(id.cnt<5){   id.pointDelay=id.step; 	id.sizeDelay=50;	id.step=200; return;}				
				id.pointDelay=30;	  	id.sizeDelay=10;	id.step=200; return;}	
//-------------------------------------------------------------------------------------------------
//									2.30.Soft reset device [code=0xBA]	
//-------------------------------------------------------------------------------------------------
if(id.step==30){
xxxWrite(id,0xBA);	if(checkTransaction(id)){return;}	//--if link ok:: pointDelay=step; step=200; After 3fd error: err=1; step=0; return; 
id.pointDelay=40;	id.sizeDelay=10;         return;}	
//-------------------------------------------------------------------------------------------------
//									2.40.Device init [code=0xBE]	 
//-------------------------------------------------------------------------------------------------
if(id.step==40){
xxxWrite(id,0xBE);	if(checkTransaction(id)){return;}
id.pointDelay=50;	id.sizeDelay=10;  	     return;}
//-------------------------------------------------------------------------------------------------
//									2.50.Device status query [code=0x71]
//-------------------------------------------------------------------------------------------------
if(id.step==50){
xxxWrite(id,0x71);	if(checkTransaction(id)){return;}  
id.pointDelay=60;	id.sizeDelay=20;  	     return;} 
//-------------------------------------------------------------------------------------------------
//									2.60.Read Status Word and Check Calibration Bit(3)
//-------------------------------------------------------------------------------------------------
if(id.step==60){
xxxRead(id);		if(checkTransaction(id)){return;} 
if(!bitRead(id.bf8,3)){id.err=1; id.step=0;  return;}
id.pointDelay=70; 	id.sizeDelay=10;  	     return;} 
//-------------------------------------------------------------------------------------------------
if(id.step==70){id.step=90;}
//-------------------------------------------------------------------------------------------------
//									2.90.End device init
//-------------------------------------------------------------------------------------------------
if(id.step==90){id.err=id.action=id.step=0; return;}
//-------------------------------------------------------------------------------------------------
//									2.200.Dynamic Delay
//-------------------------------------------------------------------------------------------------
if(id.step==200){if(!RT_HW_Base.timeDelay(id.startDelay,id.workDelay,id.sizeDelay)){return;} id.step=id.pointDelay;}
};	//====END init()===============================================================================

//=================================================================================================
//									3.Device Process
//=================================================================================================
void process(RT_HW_AHTxx_DEV &id){
//-------------------------------------------------------------------------------------------------
//									3.0.Setting parameters with continue after 50 ms
//-------------------------------------------------------------------------------------------------
if(id.step==0) {	
id.cnt=id.cntErr=id.err=0; id.action=1; id.pointDelay=10; id.sizeDelay=50; id.step=200; return;}
//-------------------------------------------------------------------------------------------------
//									3.10.Start measurement	
//-------------------------------------------------------------------------------------------------
if(id.step==10){id.arr[0]=0xAC; id.arr[1]=0x33; id.arr[2]=0x00; id.step=11;}		
//-------------------------------------------------------------------------------------------------
if(id.step==11){
xxxWriteArr(id,3);	if(checkTransaction(id)){return;}	//--if link ok:: pointDelay=step; step=200; After 3fd error: err=1; step=0; return;
id.pointDelay=30; 	id.sizeDelay=30;  		 return;} 
//-------------------------------------------------------------------------------------------------
//									3.30.Device status query [code=0x71]
//-------------------------------------------------------------------------------------------------
if(id.step==30){
xxxWrite(id,0x71);	if(checkTransaction(id)){return;} 
id.pointDelay=40; 	id.sizeDelay=40;  	     return;} 
//-------------------------------------------------------------------------------------------------
//									3.40.Getting measurement results
//-------------------------------------------------------------------------------------------------
if(id.step==40){
xxxReadArr(id,7);	if(checkTransaction(id)){return;} 
//-------------------------------------------------------------------------------------------------
if(!bitRead(id.arr[0],3)){id.sizeDelay=40+(10*id.cntErr);id.cntErr++; if(id.cntErr>3){id.codeErr=45; id.err=1; id.step=0;} return;}
if( bitRead(id.arr[0],7)){id.sizeDelay=40+(10*id.cntErr);id.cntErr++; if(id.cntErr>3){id.codeErr=46; id.err=1; id.step=0;} return;}
crc8(id); 
if(id.crc!=id.arr[6])    {id.sizeDelay=40;               id.cntErr++; if(id.cntErr>3){id.codeErr=47; id.err=1; id.step=0;} return;}
//-------------------------------------------------------------------------------------------------
id.temp=id.arr[1];      id.temp<<=8;  id.temp|=id.arr[2]; id.temp<<=4; id.temp|=id.arr[3]>>4; id.vHum =(float)(id.temp*100)/(float)0x100000;
id.temp=id.arr[3]&0x0F; id.temp<<=8;  id.temp|=id.arr[4]; id.temp<<=8; id.temp|=id.arr[5];    id.vTemp=(float)(id.temp*200)/(float)0x100000 - 50;
//-------------------------------------------------------------------------------------------------
id.pointDelay=50; 	id.sizeDelay=20;  		return;} 
//-------------------------------------------------------------------------------------------------
if(id.step==50){id.step=90;}
//-------------------------------------------------------------------------------------------------
//									3.90.End device process
//-------------------------------------------------------------------------------------------------
if(id.step==90){id.err=id.action=id.step=0; return;}
//-------------------------------------------------------------------------------------------------
//									3.200.Dynamic Delay
//-------------------------------------------------------------------------------------------------
if(id.step==200){if(!RT_HW_Base.timeDelay(id.startDelay,id.workDelay,id.sizeDelay)){return;} id.step=id.pointDelay;}
};	//====END process()============================================================================

//=================================================================================================
//									4.CRC8 polynomial: CRC[7: 0] = X8 + X5 + X4 + 1  -  0x1 0011 0001 - 0x131
//=================================================================================================
void crc8(RT_HW_AHTxx_DEV &id){
id.crc=0xFF;
for(   id.idx1=0; id.idx1<6; id.idx1++){id.crc ^= id.arr[id.idx1];  
   for(id.idx=8;  id.idx>0;  id.idx--) {if(id.crc&0x80){id.crc<<=1; id.crc^= 0x31;} else{id.crc<<=1;}}}
};	//====END crc8()===============================================================================
//=================================================================================================
//+++++++++++++++++++++++++++++++++++++++++++++++++++++++++++++++++++++++++++++++++++++++++++++++++
//
//									7.Device Link Functions.
//
//+++++++++++++++++++++++++++++++++++++++++++++++++++++++++++++++++++++++++++++++++++++++++++++++++
//=================================================================================================
//									7.0.Function error check.
//=================================================================================================
uint8_t checkTransaction(RT_HW_AHTxx_DEV &id){
if(!id.link){return 1;}
id.pointDelay=id.step; id.step=200;
if(id.codeErr!=0){id.sizeDelay=40+(10*id.cntErr); id.cntErr++; 
                  if(id.cntErr>3){id.codeErr=id.pointDelay; id.err=1; id.step=0;} 
			 return 1;}
id.cntErr=0; return 0;};
//=================================================================================================
//									7.1.Getting Interface Device Parameters
//=================================================================================================
void getParamDevice(RT_HW_AHTxx_DEV &id){
if(id.mi=='I'){id.custom=id.dvI.custom; id.codeErr=id.dvI.codeErr; id.status=id.dvI.status; id.link=id.dvI.link; id.bf8=id.dvI.bf8; return;}
               id.custom=0;             id.codeErr=0;              id.status=0;             id.link=1;           id.bf8=0;          return;};
//=================================================================================================
//									7.3.Init Device
//=================================================================================================
void xxxInitDevice(RT_HW_AHTxx_DEV &id){
if(id.mi=='I'){RT_HW_Base.i2cInitDevice(id.dvI); 				getParamDevice(id); return;}		
getParamDevice(id);};
//=================================================================================================
//									7.2.Find address Device
//=================================================================================================
void xxxFindAdr(RT_HW_AHTxx_DEV &id){
if(id.mi=='I'){RT_HW_Base.i2cFindAdr(id.dvI); 					getParamDevice(id); return;}	
getParamDevice(id);};
//=================================================================================================
//									7.3.Wtite byte to register
//=================================================================================================
void xxxWrite(RT_HW_AHTxx_DEV &id, uint8_t var){	
if(id.mi=='I'){RT_HW_Base.i2cWrite(id.dvI,var); 	 			getParamDevice(id); return;}
getParamDevice(id);};
//=================================================================================================
//									7.4.Wtite byte to register
//=================================================================================================
void xxxWriteArr(RT_HW_AHTxx_DEV &id, uint8_t qnt){	
if(id.mi=='I'){RT_HW_Base.i2cWriteArr(id.dvI,id.arr,qnt); 	 	getParamDevice(id); return;}
getParamDevice(id);};
//=================================================================================================
//									7.5.Read byte from register
//=================================================================================================
void xxxREAD(RT_HW_AHTxx_DEV &id, uint8_t reg){
if(id.mi=='I'){RT_HW_Base.i2cREAD(id.dvI,reg); 			 		getParamDevice(id); return;}		
getParamDevice(id);};
//=================================================================================================
//									7.6.Read bytes from register
//=================================================================================================
void xxxREADArr(RT_HW_AHTxx_DEV &id, uint8_t reg, uint8_t qnt){	
//-------------------------------------------------------------------------------------------------
if(id.mi=='I'){RT_HW_Base.i2cREADArr(id.dvI,reg,id.arr,qnt);	getParamDevice(id); return;}
getParamDevice(id);};
//=================================================================================================
//									7.10.Get byte
//=================================================================================================
void xxxRead(RT_HW_AHTxx_DEV &id){	
if(id.mi=='I'){RT_HW_Base.i2cRead(id.dvI); 						getParamDevice(id); return;};
getParamDevice(id);};
//=================================================================================================
//									7.11.Get bytes
//=================================================================================================
void xxxReadArr(RT_HW_AHTxx_DEV &id, uint8_t qnt){	
if(id.mi=='I'){RT_HW_Base.i2cReadArr(id.dvI,id.arr,qnt); 		getParamDevice(id); return;};
getParamDevice(id);};
//=================================================================================================
};		//++++END CLASS AHTxx
extern RT_HW_AHTxx 	RT_HW_ahtxx; 						//--Create an object RT_HW_ahtxx;
#endif
//=================================================================================================